VERSION "$Format:%h$"

NS_ :

BS_:

BU_: APB APP APS BCCEN BDY DAS DBG EAS EPAS EPAS2 EPAS3S EPB EPBM ESP GTW GTWU IBST IC MCU OCS PARK PARK3 RADAR RCM RT3000 SCCM SDM SEC TAS TAS2 TAS2DBG TOOL TPMS VCSEATD VCSEATP

BO_ 1249 RCM2_alertLog: 8 RCM
 SG_ RCM2_alertID M : 0|15@1+ (1,0) [0|0] "" Vector__XXX
 SG_ RCM2_alertState : 15|1@1+ (1,0) [0|0] "" Vector__XXX
 SG_ RCM2_eventArmStatus : 25|1@1+ (1,0) [0|0] "" GTW
 SG_ RCM2_eventFactoryMode : 26|1@1+ (1,0) [0|0] "" GTW
 SG_ RCM2_eventDiagEnabled : 27|1@1+ (1,0) [0|0] "" GTW
 SG_ RCM2_eventdriveOrientation : 28|1@1+ (1,0) [0|0] "" GTW
 SG_ RCM2_eventIDFsignal : 29|1@1+ (1,0) [0|0] "" GTW
 SG_ RCM2_eventFrontLeftSeatbelt : 30|1@1+ (1,0) [0|0] "" GTW
 SG_ RCM2_eventFrontRightSeatbelt : 31|1@1+ (1,0) [0|0] "" GTW
 SG_ RCM2_eventVehicleSpeed : 32|12@1+ (0.08,-40) [-40|285] "kph" GTW
 SG_ RCM2_eventDriverBrakeApply : 44|2@1+ (1,0) [0|3] "" GTW
 SG_ RCM2_eventAccelPedalPos : 56|8@1+ (0.4,0) [0|100] "%" GTW
 SG_ RCM2_000_crashDetectedFrnt m0 : 16|1@1+ (1,0) [0|0] "" GTW
 SG_ RCM2_000_crashDetectedRear m0 : 17|1@1+ (1,0) [0|0] "" GTW
 SG_ RCM2_000_crashDetectedLeft m0 : 18|1@1+ (1,0) [0|0] "" GTW
 SG_ RCM2_000_crashDetectedRight m0 : 19|1@1+ (1,0) [0|0] "" GTW
 SG_ RCM2_000_crashDetectedRoll m0 : 20|1@1+ (1,0) [0|0] "" GTW
 SG_ RCM2_000_crashDetectedPreten m0 : 21|1@1+ (1,0) [0|0] "" GTW
 SG_ RCM2_000_crashDetectedStage1 m0 : 22|1@1+ (1,0) [0|0] "" GTW
 SG_ RCM2_000_crashDetectedStage2 m0 : 23|1@1+ (1,0) [0|0] "" GTW
 SG_ RCM2_000_crashDetectedHVpyro m0 : 24|1@1+ (1,0) [0|0] "" GTW
 SG_ RCM2_001_nearDeployFrnt m1 : 16|1@1+ (1,0) [0|0] "" GTW
 SG_ RCM2_001_nearDeployRear m1 : 17|1@1+ (1,0) [0|0] "" GTW
 SG_ RCM2_001_nearDeployLeft m1 : 18|1@1+ (1,0) [0|0] "" GTW
 SG_ RCM2_001_nearDeployRight m1 : 19|1@1+ (1,0) [0|0] "" GTW
 SG_ RCM2_001_nearDeployRoll m1 : 20|1@1+ (1,0) [0|0] "" GTW
 SG_ RCM2_001_nearDeployPretensioner m1 : 21|1@1+ (1,0) [0|0] "" GTW
 SG_ RCM2_001_nearDeployPedPro m1 : 22|1@1+ (1,0) [0|0] "" GTW
 SG_ RCM2_002_airbagsUnArmed m2 : 16|1@1+ (1,0) [0|0] "" GTW
 SG_ RCM2_003_warningIndicator m3 : 16|1@1+ (1,0) [0|0] "" GTW
 SG_ RCM2_004_crashAlgoWakeup m4 : 16|1@1+ (1,0) [0|0] "" GTW
 SG_ RCM2_005_abuseImmunityThrshold m5 : 16|1@1+ (1,0) [0|0] "" GTW
 SG_ RCM2_006_supplierDiagEnabled m6 : 16|1@1+ (1,0) [0|0] "" GTW
 SG_ RCM2_007_pedProCrashDetected m7 : 16|1@1+ (1,0) [0|0] "" GTW
 SG_ RCM2_008_factoryMode m8 : 16|1@1+ (1,0) [0|0] "" GTW
 SG_ RCM2_009_edrDataAreaLocked m9 : 16|1@1+ (1,0) [0|0] "" GTW
 SG_ RCM2_010_pedProEDRDataLocked m10 : 16|1@1+ (1,0) [0|0] "" GTW
 SG_ RCM2_011_FrntAlgoDisabled m11 : 16|1@1+ (1,0) [0|0] "" GTW
 SG_ RCM2_012_RollAlgoDisabled m12 : 16|1@1+ (1,0) [0|0] "" GTW
 SG_ RCM2_013_SideAlgoDisabled m13 : 16|1@1+ (1,0) [0|0] "" GTW
 SG_ RCM2_014_pedProNearDeploy m14 : 16|1@1+ (1,0) [0|0] "" GTW
 SG_ RCM2_047_batteryESRhigh m47 : 16|1@1+ (1,0) [0|0] "" GTW
 SG_ RCM2_048_batteryVoltageTooHigh m48 : 16|1@1+ (1,0) [0|0] "" GTW
 SG_ RCM2_049_batteryVoltageTooLow m49 : 16|1@1+ (1,0) [0|0] "" GTW
 SG_ RCM2_050_driverABStg1Sht2Gnd m50 : 16|1@1+ (1,0) [0|0] "" GTW
 SG_ RCM2_051_driverABStg1Sht2Bat m51 : 16|1@1+ (1,0) [0|0] "" GTW
 SG_ RCM2_052_driverABStg1Open m52 : 16|1@1+ (1,0) [0|0] "" GTW
 SG_ RCM2_053_driverABStg1Short m53 : 16|1@1+ (1,0) [0|0] "" GTW
 SG_ RCM2_054_driverABStg1CrssCoup m54 : 16|1@1+ (1,0) [0|0] "" GTW
 SG_ RCM2_055_driverABStg1Config m55 : 16|1@1+ (1,0) [0|0] "" GTW
 SG_ RCM2_056_driverABStg2Sht2Gnd m56 : 16|1@1+ (1,0) [0|0] "" GTW
 SG_ RCM2_057_driverABStg2Sht2Bat m57 : 16|1@1+ (1,0) [0|0] "" GTW
 SG_ RCM2_058_driverABStg2Open m58 : 16|1@1+ (1,0) [0|0] "" GTW
 SG_ RCM2_059_driverABStg2Short m59 : 16|1@1+ (1,0) [0|0] "" GTW
 SG_ RCM2_060_driverABStg2CrssCoup m60 : 16|1@1+ (1,0) [0|0] "" GTW
 SG_ RCM2_061_driverABStg2Config m61 : 16|1@1+ (1,0) [0|0] "" GTW
 SG_ RCM2_062_passABStg1Sht2Gnd m62 : 16|1@1+ (1,0) [0|0] "" GTW
 SG_ RCM2_063_passABStg1Sht2Bat m63 : 16|1@1+ (1,0) [0|0] "" GTW
 SG_ RCM2_064_passABStg1Open m64 : 16|1@1+ (1,0) [0|0] "" GTW
 SG_ RCM2_065_passABStg1Short m65 : 16|1@1+ (1,0) [0|0] "" GTW
 SG_ RCM2_066_passABStg1CrssCoup m66 : 16|1@1+ (1,0) [0|0] "" GTW
 SG_ RCM2_067_passABStg1Config m67 : 16|1@1+ (1,0) [0|0] "" GTW
 SG_ RCM2_068_passABStg2Sht2Gnd m68 : 16|1@1+ (1,0) [0|0] "" GTW
 SG_ RCM2_069_passABStg2Sht2Bat m69 : 16|1@1+ (1,0) [0|0] "" GTW
 SG_ RCM2_070_passABStg2Open m70 : 16|1@1+ (1,0) [0|0] "" GTW
 SG_ RCM2_071_passABStg2Short m71 : 16|1@1+ (1,0) [0|0] "" GTW
 SG_ RCM2_072_passABStg2CrssCoup m72 : 16|1@1+ (1,0) [0|0] "" GTW
 SG_ RCM2_073_passABStg2Config m73 : 16|1@1+ (1,0) [0|0] "" GTW
 SG_ RCM2_074_passActiveVentSht2Gnd m74 : 16|1@1+ (1,0) [0|0] "" GTW
 SG_ RCM2_075_passActiveVentSht2Bat m75 : 16|1@1+ (1,0) [0|0] "" GTW
 SG_ RCM2_076_passActiveVentOpen m76 : 16|1@1+ (1,0) [0|0] "" GTW
 SG_ RCM2_077_passActiveVentShort m77 : 16|1@1+ (1,0) [0|0] "" GTW
 SG_ RCM2_078_passActiveVentCrssCoup m78 : 16|1@1+ (1,0) [0|0] "" GTW
 SG_ RCM2_079_passActiveVentConfig m79 : 16|1@1+ (1,0) [0|0] "" GTW
 SG_ RCM2_080_pretenShldLeftSht2Gnd m80 : 16|1@1+ (1,0) [0|0] "" GTW
 SG_ RCM2_081_pretenShldLeftSht2Bat m81 : 16|1@1+ (1,0) [0|0] "" GTW
 SG_ RCM2_082_pretenShldLeftOpen m82 : 16|1@1+ (1,0) [0|0] "" GTW
 SG_ RCM2_083_pretenShldLeftShort m83 : 16|1@1+ (1,0) [0|0] "" GTW
 SG_ RCM2_084_pretenShldLeftCrossC m84 : 16|1@1+ (1,0) [0|0] "" GTW
 SG_ RCM2_085_pretenShldLeftConfig m85 : 16|1@1+ (1,0) [0|0] "" GTW
 SG_ RCM2_086_pretenShldRightSht2Gnd m86 : 16|1@1+ (1,0) [0|0] "" GTW
 SG_ RCM2_087_pretenShldRightSht2Bat m87 : 16|1@1+ (1,0) [0|0] "" GTW
 SG_ RCM2_088_pretenShldRightOpen m88 : 16|1@1+ (1,0) [0|0] "" GTW
 SG_ RCM2_089_pretenShldRightShort m89 : 16|1@1+ (1,0) [0|0] "" GTW
 SG_ RCM2_090_pretenShldRightCrssCou m90 : 16|1@1+ (1,0) [0|0] "" GTW
 SG_ RCM2_091_pretenShldRightConfig m91 : 16|1@1+ (1,0) [0|0] "" GTW
 SG_ RCM2_092_pretenLapLeftSht2Gnd m92 : 16|1@1+ (1,0) [0|0] "" GTW
 SG_ RCM2_093_pretenLapLeftSht2Bat m93 : 16|1@1+ (1,0) [0|0] "" GTW
 SG_ RCM2_094_pretenLapLeftOpen m94 : 16|1@1+ (1,0) [0|0] "" GTW
 SG_ RCM2_095_pretenLapLeftShort m95 : 16|1@1+ (1,0) [0|0] "" GTW
 SG_ RCM2_096_pretenLapLeftCrssCoup m96 : 16|1@1+ (1,0) [0|0] "" GTW
 SG_ RCM2_097_pretenLapLeftConfig m97 : 16|1@1+ (1,0) [0|0] "" GTW
 SG_ RCM2_098_pretenLapRightSht2Gnd m98 : 16|1@1+ (1,0) [0|0] "" GTW
 SG_ RCM2_099_pretenLapRightSht2Bat m99 : 16|1@1+ (1,0) [0|0] "" GTW
 SG_ RCM2_100_pretenLapRightOpen m100 : 16|1@1+ (1,0) [0|0] "" GTW
 SG_ RCM2_101_pretenLapRightShort m101 : 16|1@1+ (1,0) [0|0] "" GTW
 SG_ RCM2_102_pretenLapRightCrssCoup m102 : 16|1@1+ (1,0) [0|0] "" GTW
 SG_ RCM2_103_pretenLapRightConfig m103 : 16|1@1+ (1,0) [0|0] "" GTW
 SG_ RCM2_104_loadLimLeftSht2Gnd m104 : 16|1@1+ (1,0) [0|0] "" GTW
 SG_ RCM2_105_loadLimLeftSht2Bat m105 : 16|1@1+ (1,0) [0|0] "" GTW
 SG_ RCM2_106_loadLimLeftOpen m106 : 16|1@1+ (1,0) [0|0] "" GTW
 SG_ RCM2_107_loadLimLeftShort m107 : 16|1@1+ (1,0) [0|0] "" GTW
 SG_ RCM2_108_loadLimLeftCrssCoup m108 : 16|1@1+ (1,0) [0|0] "" GTW
 SG_ RCM2_109_loadLimLeftConfig m109 : 16|1@1+ (1,0) [0|0] "" GTW
 SG_ RCM2_110_loadLimRightSht2Gnd m110 : 16|1@1+ (1,0) [0|0] "" GTW
 SG_ RCM2_111_loadLimRightSht2Bat m111 : 16|1@1+ (1,0) [0|0] "" GTW
 SG_ RCM2_112_loadLimRightOpen m112 : 16|1@1+ (1,0) [0|0] "" GTW
 SG_ RCM2_113_loadLimRightShort m113 : 16|1@1+ (1,0) [0|0] "" GTW
 SG_ RCM2_114_loadLimRightCrssCoup m114 : 16|1@1+ (1,0) [0|0] "" GTW
 SG_ RCM2_115_loadLimRightConfig m115 : 16|1@1+ (1,0) [0|0] "" GTW
 SG_ RCM2_116_kneeABDrvrSht2Gnd m116 : 16|1@1+ (1,0) [0|0] "" GTW
 SG_ RCM2_117_kneeABDrvrSht2Bat m117 : 16|1@1+ (1,0) [0|0] "" GTW
 SG_ RCM2_118_kneeABDrvrOpen m118 : 16|1@1+ (1,0) [0|0] "" GTW
 SG_ RCM2_119_kneeABDrvrShort m119 : 16|1@1+ (1,0) [0|0] "" GTW
 SG_ RCM2_120_kneeABDrvrCrssCoup m120 : 16|1@1+ (1,0) [0|0] "" GTW
 SG_ RCM2_121_kneeABDrvrConfig m121 : 16|1@1+ (1,0) [0|0] "" GTW
 SG_ RCM2_122_kneeABPassSht2Gnd m122 : 16|1@1+ (1,0) [0|0] "" GTW
 SG_ RCM2_123_kneeABPassSht2Bat m123 : 16|1@1+ (1,0) [0|0] "" GTW
 SG_ RCM2_124_kneeABPassOpen m124 : 16|1@1+ (1,0) [0|0] "" GTW
 SG_ RCM2_125_kneeABPassShort m125 : 16|1@1+ (1,0) [0|0] "" GTW
 SG_ RCM2_126_kneeABPassCrssCoup m126 : 16|1@1+ (1,0) [0|0] "" GTW
 SG_ RCM2_127_kneeABPassConfig m127 : 16|1@1+ (1,0) [0|0] "" GTW
 SG_ RCM2_128_sideAB1stRowLSht2Gnd m128 : 16|1@1+ (1,0) [0|0] "" GTW
 SG_ RCM2_129_sideAB1stRowLSht2Bat m129 : 16|1@1+ (1,0) [0|0] "" GTW
 SG_ RCM2_130_sideAB1stRowLOpen m130 : 16|1@1+ (1,0) [0|0] "" GTW
 SG_ RCM2_131_sideAB1stRowLShort m131 : 16|1@1+ (1,0) [0|0] "" GTW
 SG_ RCM2_132_sideAB1stRowLCrssCoup m132 : 16|1@1+ (1,0) [0|0] "" GTW
 SG_ RCM2_133_sideAB1stRowLConfig m133 : 16|1@1+ (1,0) [0|0] "" GTW
 SG_ RCM2_134_sideAB1stRowRSht2Gnd m134 : 16|1@1+ (1,0) [0|0] "" GTW
 SG_ RCM2_135_sideAB1stRowRSht2Bat m135 : 16|1@1+ (1,0) [0|0] "" GTW
 SG_ RCM2_136_sideAB1stRowROpen m136 : 16|1@1+ (1,0) [0|0] "" GTW
 SG_ RCM2_137_sideAB1stRowRShort m137 : 16|1@1+ (1,0) [0|0] "" GTW
 SG_ RCM2_138_sideAB1stRowRCrssCoup m138 : 16|1@1+ (1,0) [0|0] "" GTW
 SG_ RCM2_139_sideAB1stRowRConfig m139 : 16|1@1+ (1,0) [0|0] "" GTW
 SG_ RCM2_140_hvdPyroSht2Gnd m140 : 16|1@1+ (1,0) [0|0] "" GTW
 SG_ RCM2_141_hvdPyroSht2Bat m141 : 16|1@1+ (1,0) [0|0] "" GTW
 SG_ RCM2_142_hvdPyroOpen m142 : 16|1@1+ (1,0) [0|0] "" GTW
 SG_ RCM2_143_hvdPyroShort m143 : 16|1@1+ (1,0) [0|0] "" GTW
 SG_ RCM2_144_hvdPyroCrssCoup m144 : 16|1@1+ (1,0) [0|0] "" GTW
 SG_ RCM2_145_hvdPyroConfig m145 : 16|1@1+ (1,0) [0|0] "" GTW
 SG_ RCM2_146_curABLeftSht2Gnd m146 : 16|1@1+ (1,0) [0|0] "" GTW
 SG_ RCM2_147_curABLeftSht2Bat m147 : 16|1@1+ (1,0) [0|0] "" GTW
 SG_ RCM2_148_curABLeftOpen m148 : 16|1@1+ (1,0) [0|0] "" GTW
 SG_ RCM2_149_curABLeftShort m149 : 16|1@1+ (1,0) [0|0] "" GTW
 SG_ RCM2_150_curABLeftCrssCoup m150 : 16|1@1+ (1,0) [0|0] "" GTW
 SG_ RCM2_151_curABLeftConfig m151 : 16|1@1+ (1,0) [0|0] "" GTW
 SG_ RCM2_152_curABRightSht2Gnd m152 : 16|1@1+ (1,0) [0|0] "" GTW
 SG_ RCM2_153_curABRightSht2Bat m153 : 16|1@1+ (1,0) [0|0] "" GTW
 SG_ RCM2_154_curABRightOpen m154 : 16|1@1+ (1,0) [0|0] "" GTW
 SG_ RCM2_155_curABRightShort m155 : 16|1@1+ (1,0) [0|0] "" GTW
 SG_ RCM2_156_curABRightCrssCoup m156 : 16|1@1+ (1,0) [0|0] "" GTW
 SG_ RCM2_157_curABRightConfig m157 : 16|1@1+ (1,0) [0|0] "" GTW
 SG_ RCM2_158_preten2ndRowLSht2Gnd m158 : 16|1@1+ (1,0) [0|0] "" GTW
 SG_ RCM2_159_preten2ndRowLSht2Bat m159 : 16|1@1+ (1,0) [0|0] "" GTW
 SG_ RCM2_160_preten2ndRowLOpen m160 : 16|1@1+ (1,0) [0|0] "" GTW
 SG_ RCM2_161_preten2ndRowLShort m161 : 16|1@1+ (1,0) [0|0] "" GTW
 SG_ RCM2_162_preten2ndRowLCrssCoup m162 : 16|1@1+ (1,0) [0|0] "" GTW
 SG_ RCM2_163_preten2ndRowLCgf m163 : 16|1@1+ (1,0) [0|0] "" GTW
 SG_ RCM2_164_preten2ndRowRSht2Gnd m164 : 16|1@1+ (1,0) [0|0] "" GTW
 SG_ RCM2_165_preten2ndRowRSht2Bat m165 : 16|1@1+ (1,0) [0|0] "" GTW
 SG_ RCM2_166_preten2ndRowROpen m166 : 16|1@1+ (1,0) [0|0] "" GTW
 SG_ RCM2_167_preten2ndRowRShort m167 : 16|1@1+ (1,0) [0|0] "" GTW
 SG_ RCM2_168_preten2ndRowRCrssCoup m168 : 16|1@1+ (1,0) [0|0] "" GTW
 SG_ RCM2_169_preten2ndRowRCgf m169 : 16|1@1+ (1,0) [0|0] "" GTW
 SG_ RCM2_170_curAB2ndRowLSht2Gnd m170 : 16|1@1+ (1,0) [0|0] "" GTW
 SG_ RCM2_171_curAB2ndRowLSht2Bat m171 : 16|1@1+ (1,0) [0|0] "" GTW
 SG_ RCM2_172_curAB2ndRowLOpen m172 : 16|1@1+ (1,0) [0|0] "" GTW
 SG_ RCM2_173_curAB2ndRowLShort m173 : 16|1@1+ (1,0) [0|0] "" GTW
 SG_ RCM2_174_curAB2ndRowLCrssCoup m174 : 16|1@1+ (1,0) [0|0] "" GTW
 SG_ RCM2_175_curAB2ndRowLConfig m175 : 16|1@1+ (1,0) [0|0] "" GTW
 SG_ RCM2_176_curAB2ndRowRSht2Gnd m176 : 16|1@1+ (1,0) [0|0] "" GTW
 SG_ RCM2_177_curAB2ndRowRSht2Bat m177 : 16|1@1+ (1,0) [0|0] "" GTW
 SG_ RCM2_178_curAB2ndRowROpen m178 : 16|1@1+ (1,0) [0|0] "" GTW
 SG_ RCM2_179_curAB2ndRowRShort m179 : 16|1@1+ (1,0) [0|0] "" GTW
 SG_ RCM2_180_curAB2ndRowRCrssCoup m180 : 16|1@1+ (1,0) [0|0] "" GTW
 SG_ RCM2_181_curAB2ndRowRConfig m181 : 16|1@1+ (1,0) [0|0] "" GTW
 SG_ RCM2_182_hoodActuatorRSht2Gnd m182 : 16|1@1+ (1,0) [0|0] "" GTW
 SG_ RCM2_183_hoodActuatorRSht2Bat m183 : 16|1@1+ (1,0) [0|0] "" GTW
 SG_ RCM2_184_hoodActuatorROpen m184 : 16|1@1+ (1,0) [0|0] "" GTW
 SG_ RCM2_185_hoodActuatorRShort m185 : 16|1@1+ (1,0) [0|0] "" GTW
 SG_ RCM2_186_hoodActuatorRCrssCoup m186 : 16|1@1+ (1,0) [0|0] "" GTW
 SG_ RCM2_187_hoodActuatorRConfig m187 : 16|1@1+ (1,0) [0|0] "" GTW
 SG_ RCM2_188_hoodActuatorLSht2Gnd m188 : 16|1@1+ (1,0) [0|0] "" GTW
 SG_ RCM2_189_hoodActuatorLSht2Bat m189 : 16|1@1+ (1,0) [0|0] "" GTW
 SG_ RCM2_190_hoodActuatorLOpen m190 : 16|1@1+ (1,0) [0|0] "" GTW
 SG_ RCM2_191_hoodActuatorLShort m191 : 16|1@1+ (1,0) [0|0] "" GTW
 SG_ RCM2_192_hoodActuatorLCrssCoup m192 : 16|1@1+ (1,0) [0|0] "" GTW
 SG_ RCM2_193_hoodActuatorLConfig m193 : 16|1@1+ (1,0) [0|0] "" GTW
 SG_ RCM2_250_ens1Sht2Bat m250 : 16|1@1+ (1,0) [0|0] "" GTW
 SG_ RCM2_251_ens1Sht2Gnd m251 : 16|1@1+ (1,0) [0|0] "" GTW
 SG_ RCM2_252_ens1Config m252 : 16|1@1+ (1,0) [0|0] "" GTW
 SG_ RCM2_253_ens2Sht2Bat m253 : 16|1@1+ (1,0) [0|0] "" GTW
 SG_ RCM2_254_ens2Sht2Gnd m254 : 16|1@1+ (1,0) [0|0] "" GTW
 SG_ RCM2_255_ens2Config m255 : 16|1@1+ (1,0) [0|0] "" GTW
 SG_ RCM2_300_imuAccXHgMonChlPerm m300 : 16|1@1+ (1,0) [0|0] "" GTW
 SG_ RCM2_301_imuAccXHgMonChlTemp m301 : 16|1@1+ (1,0) [0|0] "" GTW
 SG_ RCM2_302_imuAccYHgMonChlPerm m302 : 16|1@1+ (1,0) [0|0] "" GTW
 SG_ RCM2_303_imuAccYHgMonChlTemp m303 : 16|1@1+ (1,0) [0|0] "" GTW
 SG_ RCM2_304_imuYawR8SnsrPermBG m304 : 16|1@1+ (1,0) [0|0] "" GTW
 SG_ RCM2_305_imuYawR8SnsrPermInit m305 : 16|1@1+ (1,0) [0|0] "" GTW
 SG_ RCM2_306_imuYawR8SnsrPermLF m306 : 16|1@1+ (1,0) [0|0] "" GTW
 SG_ RCM2_307_imuYawR8ChnlMonTmpLF m307 : 16|1@1+ (1,0) [0|0] "" GTW
 SG_ RCM2_308_imuPitchR8SnsrPermBG m308 : 16|1@1+ (1,0) [0|0] "" GTW
 SG_ RCM2_309_imuPitchR8SnsrPermInit m309 : 16|1@1+ (1,0) [0|0] "" GTW
 SG_ RCM2_310_imuPitchR8SnsrPermLF m310 : 16|1@1+ (1,0) [0|0] "" GTW
 SG_ RCM2_311_imuPitchR8ChnlMonTmpLF m311 : 16|1@1+ (1,0) [0|0] "" GTW
 SG_ RCM2_312_imuRollR8SnsrPermBG m312 : 16|1@1+ (1,0) [0|0] "" GTW
 SG_ RCM2_313_imuRollR8SnsrPermInit m313 : 16|1@1+ (1,0) [0|0] "" GTW
 SG_ RCM2_314_imuRollR8SnsrPermLF m314 : 16|1@1+ (1,0) [0|0] "" GTW
 SG_ RCM2_315_imuRollR8ChnlMonTmpLF m315 : 16|1@1+ (1,0) [0|0] "" GTW
 SG_ RCM2_316_imuAccXLgMonChlPerm m316 : 16|1@1+ (1,0) [0|0] "" GTW
 SG_ RCM2_317_imuAccXLgMonChlTemp m317 : 16|1@1+ (1,0) [0|0] "" GTW
 SG_ RCM2_318_imuAccYLgMonChlPerm m318 : 16|1@1+ (1,0) [0|0] "" GTW
 SG_ RCM2_319_imuAccYLgMonChlTemp m319 : 16|1@1+ (1,0) [0|0] "" GTW
 SG_ RCM2_320_imuAccZLgMonChlPerm m320 : 16|1@1+ (1,0) [0|0] "" GTW
 SG_ RCM2_321_imuAccZLgMonChlTemp m321 : 16|1@1+ (1,0) [0|0] "" GTW
 SG_ RCM2_322_imuCalibrationFailed m322 : 16|1@1+ (1,0) [0|0] "" GTW
 SG_ RCM2_323_imuCalibrationNotDone m323 : 16|1@1+ (1,0) [0|0] "" GTW
 SG_ RCM2_350_upFrntSnsrLSht2Gnd m350 : 16|1@1+ (1,0) [0|0] "" GTW
 SG_ RCM2_351_upFrntSnsrLSht2Bat m351 : 16|1@1+ (1,0) [0|0] "" GTW
 SG_ RCM2_352_upFrntSnsrLOpen m352 : 16|1@1+ (1,0) [0|0] "" GTW
 SG_ RCM2_353_upFrntSnsrLCrssCoup m353 : 16|1@1+ (1,0) [0|0] "" GTW
 SG_ RCM2_354_upFrntSnsrLCommErr m354 : 16|1@1+ (1,0) [0|0] "" GTW
 SG_ RCM2_355_upFrntSnsrLInitTyp m355 : 16|1@1+ (1,0) [0|0] "" GTW
 SG_ RCM2_356_upFrntSnsrLConfig m356 : 16|1@1+ (1,0) [0|0] "" GTW
 SG_ RCM2_357_upFrntSnsrLDefect m357 : 16|1@1+ (1,0) [0|0] "" GTW
 SG_ RCM2_358_upFrntSnsrLSigMon m358 : 16|1@1+ (1,0) [0|0] "" GTW
 SG_ RCM2_360_upFrntSnsrRSht2Gnd m360 : 16|1@1+ (1,0) [0|0] "" GTW
 SG_ RCM2_361_upFrntSnsrRSht2Bat m361 : 16|1@1+ (1,0) [0|0] "" GTW
 SG_ RCM2_362_upFrntSnsrROpen m362 : 16|1@1+ (1,0) [0|0] "" GTW
 SG_ RCM2_363_upFrntSnsrRCrssCoup m363 : 16|1@1+ (1,0) [0|0] "" GTW
 SG_ RCM2_364_upFrntSnsrRCommErr m364 : 16|1@1+ (1,0) [0|0] "" GTW
 SG_ RCM2_365_upFrntSnsrRInitTyp m365 : 16|1@1+ (1,0) [0|0] "" GTW
 SG_ RCM2_366_upFrntSnsrRConfig m366 : 16|1@1+ (1,0) [0|0] "" GTW
 SG_ RCM2_367_upFrntSnsrRDefect m367 : 16|1@1+ (1,0) [0|0] "" GTW
 SG_ RCM2_368_upFrntSnsrRSigMon m368 : 16|1@1+ (1,0) [0|0] "" GTW
 SG_ RCM2_370_upFrntSnsrMidLSht2Gnd m370 : 16|1@1+ (1,0) [0|0] "" GTW
 SG_ RCM2_371_upFrntSnsrMidLSht2Bat m371 : 16|1@1+ (1,0) [0|0] "" GTW
 SG_ RCM2_372_upFrntSnsrMidLOpen m372 : 16|1@1+ (1,0) [0|0] "" GTW
 SG_ RCM2_373_upFrntSnsrMidLCrssCoup m373 : 16|1@1+ (1,0) [0|0] "" GTW
 SG_ RCM2_374_upFrntSnsrMidLCommErr m374 : 16|1@1+ (1,0) [0|0] "" GTW
 SG_ RCM2_375_upFrntSnsrMidLInitTyp m375 : 16|1@1+ (1,0) [0|0] "" GTW
 SG_ RCM2_376_upFrntSnsrMidLConfig m376 : 16|1@1+ (1,0) [0|0] "" GTW
 SG_ RCM2_377_upFrntSnsrMidLDefect m377 : 16|1@1+ (1,0) [0|0] "" GTW
 SG_ RCM2_378_upFrntSnsrMidLSigMon m378 : 16|1@1+ (1,0) [0|0] "" GTW
 SG_ RCM2_380_upFrntSnsrMidRSht2Gnd m380 : 16|1@1+ (1,0) [0|0] "" GTW
 SG_ RCM2_381_upFrntSnsrMidRSht2Bat m381 : 16|1@1+ (1,0) [0|0] "" GTW
 SG_ RCM2_382_upFrntSnsrMidROpen m382 : 16|1@1+ (1,0) [0|0] "" GTW
 SG_ RCM2_383_upFrntSnsrMidRCrssCoup m383 : 16|1@1+ (1,0) [0|0] "" GTW
 SG_ RCM2_384_upFrntSnsrMidRCommErr m384 : 16|1@1+ (1,0) [0|0] "" GTW
 SG_ RCM2_385_upFrntSnsrMidRInitTyp m385 : 16|1@1+ (1,0) [0|0] "" GTW
 SG_ RCM2_386_upFrntSnsrMidRConfig m386 : 16|1@1+ (1,0) [0|0] "" GTW
 SG_ RCM2_387_upFrntSnsrMidRDefect m387 : 16|1@1+ (1,0) [0|0] "" GTW
 SG_ RCM2_388_upFrntSnsrMidRSigMon m388 : 16|1@1+ (1,0) [0|0] "" GTW
 SG_ RCM2_390_sideAccelBPilLSht2Gnd m390 : 16|1@1+ (1,0) [0|0] "" GTW
 SG_ RCM2_391_sideAccelBPilLSht2Bat m391 : 16|1@1+ (1,0) [0|0] "" GTW
 SG_ RCM2_392_sideAccelBPilLOpen m392 : 16|1@1+ (1,0) [0|0] "" GTW
 SG_ RCM2_393_sideAccelBPilLCLosCoup m393 : 16|1@1+ (1,0) [0|0] "" GTW
 SG_ RCM2_394_sideAccelBPilLCommErr m394 : 16|1@1+ (1,0) [0|0] "" GTW
 SG_ RCM2_395_sideAccelBPilLInitTyp m395 : 16|1@1+ (1,0) [0|0] "" GTW
 SG_ RCM2_396_sideAccelBPilLConfig m396 : 16|1@1+ (1,0) [0|0] "" GTW
 SG_ RCM2_397_sideAccelBPilLDefect m397 : 16|1@1+ (1,0) [0|0] "" GTW
 SG_ RCM2_398_sideAccelBPilLSigMon m398 : 16|1@1+ (1,0) [0|0] "" GTW
 SG_ RCM2_400_sideAccelBPilRSht2Gnd m400 : 16|1@1+ (1,0) [0|0] "" GTW
 SG_ RCM2_401_sideAccelBPilRSht2Bat m401 : 16|1@1+ (1,0) [0|0] "" GTW
 SG_ RCM2_402_sideAccelBPilROpen m402 : 16|1@1+ (1,0) [0|0] "" GTW
 SG_ RCM2_403_sideAccelBPilRCrssCoup m403 : 16|1@1+ (1,0) [0|0] "" GTW
 SG_ RCM2_404_sideAccelBPilRCommErr m404 : 16|1@1+ (1,0) [0|0] "" GTW
 SG_ RCM2_405_sideAccelBPilRInitTyp m405 : 16|1@1+ (1,0) [0|0] "" GTW
 SG_ RCM2_406_sideAccelBPilRConfig m406 : 16|1@1+ (1,0) [0|0] "" GTW
 SG_ RCM2_407_sideAccelBPilRDefect m407 : 16|1@1+ (1,0) [0|0] "" GTW
 SG_ RCM2_408_sideAccelBPilRSigMon m408 : 16|1@1+ (1,0) [0|0] "" GTW
 SG_ RCM2_410_sideAccelCPilLSht2Gnd m410 : 16|1@1+ (1,0) [0|0] "" GTW
 SG_ RCM2_411_sideAccelCPilLSht2Bat m411 : 16|1@1+ (1,0) [0|0] "" GTW
 SG_ RCM2_412_sideAccelCPilLOpen m412 : 16|1@1+ (1,0) [0|0] "" GTW
 SG_ RCM2_413_sideAccelCPilLCrssCoup m413 : 16|1@1+ (1,0) [0|0] "" GTW
 SG_ RCM2_414_sideAccelCPilLCommErr m414 : 16|1@1+ (1,0) [0|0] "" GTW
 SG_ RCM2_415_sideAccelCPilLInitTyp m415 : 16|1@1+ (1,0) [0|0] "" GTW
 SG_ RCM2_416_sideAccelCPilLConfig m416 : 16|1@1+ (1,0) [0|0] "" GTW
 SG_ RCM2_417_sideAccelCPilLDefect m417 : 16|1@1+ (1,0) [0|0] "" GTW
 SG_ RCM2_418_sideAccelCPilLSigMon m418 : 16|1@1+ (1,0) [0|0] "" GTW
 SG_ RCM2_420_sideAccelCPilRSht2Gnd m420 : 16|1@1+ (1,0) [0|0] "" GTW
 SG_ RCM2_421_sideAccelCPilRSht2Bat m421 : 16|1@1+ (1,0) [0|0] "" GTW
 SG_ RCM2_422_sideAccelCPilROpen m422 : 16|1@1+ (1,0) [0|0] "" GTW
 SG_ RCM2_423_sideAccelCPilRCrssCoup m423 : 16|1@1+ (1,0) [0|0] "" GTW
 SG_ RCM2_424_sideAccelCPilRCommErr m424 : 16|1@1+ (1,0) [0|0] "" GTW
 SG_ RCM2_425_sideAccelCPilRInitTyp m425 : 16|1@1+ (1,0) [0|0] "" GTW
 SG_ RCM2_426_sideAccelCPilRConfig m426 : 16|1@1+ (1,0) [0|0] "" GTW
 SG_ RCM2_427_sideAccelCPilRDefect m427 : 16|1@1+ (1,0) [0|0] "" GTW
 SG_ RCM2_428_sideAccelCPilRSigMon m428 : 16|1@1+ (1,0) [0|0] "" GTW
 SG_ RCM2_430_presFrntLDoorSht2Gnd m430 : 16|1@1+ (1,0) [0|0] "" GTW
 SG_ RCM2_431_presFrntLDoorSht2Bat m431 : 16|1@1+ (1,0) [0|0] "" GTW
 SG_ RCM2_432_presFrntLDoorOpen m432 : 16|1@1+ (1,0) [0|0] "" GTW
 SG_ RCM2_433_presFrntLDoorCrssCoup m433 : 16|1@1+ (1,0) [0|0] "" GTW
 SG_ RCM2_434_presFrntLDoorCommErr m434 : 16|1@1+ (1,0) [0|0] "" GTW
 SG_ RCM2_435_presFrntLDoorInitTyp m435 : 16|1@1+ (1,0) [0|0] "" GTW
 SG_ RCM2_436_presFrntLDoorConfig m436 : 16|1@1+ (1,0) [0|0] "" GTW
 SG_ RCM2_437_presFrntLDoorDefect m437 : 16|1@1+ (1,0) [0|0] "" GTW
 SG_ RCM2_438_presFrntLDoorSigMon m438 : 16|1@1+ (1,0) [0|0] "" GTW
 SG_ RCM2_439_presDoorAbsolute1 m439 : 16|1@1+ (1,0) [0|0] "" GTW
 SG_ RCM2_440_presFrntRDoorSht2Gnd m440 : 16|1@1+ (1,0) [0|0] "" GTW
 SG_ RCM2_441_presFrntRDoorSht2Bat m441 : 16|1@1+ (1,0) [0|0] "" GTW
 SG_ RCM2_442_presFrntRDoorOpen m442 : 16|1@1+ (1,0) [0|0] "" GTW
 SG_ RCM2_443_presFrntRDoorCrssCoup m443 : 16|1@1+ (1,0) [0|0] "" GTW
 SG_ RCM2_444_presFrntRDoorCommErr m444 : 16|1@1+ (1,0) [0|0] "" GTW
 SG_ RCM2_445_presFrntRDoorInitTyp m445 : 16|1@1+ (1,0) [0|0] "" GTW
 SG_ RCM2_446_presFrntRDoorConfig m446 : 16|1@1+ (1,0) [0|0] "" GTW
 SG_ RCM2_447_presFrntRDoorDefect m447 : 16|1@1+ (1,0) [0|0] "" GTW
 SG_ RCM2_448_presFrntRDoorSigMon m448 : 16|1@1+ (1,0) [0|0] "" GTW
 SG_ RCM2_449_presDoorAbsolute2 m449 : 16|1@1+ (1,0) [0|0] "" GTW
 SG_ RCM2_450_presPedProLSht2Gnd m450 : 16|1@1+ (1,0) [0|0] "" GTW
 SG_ RCM2_451_presPedProLSht2Bat m451 : 16|1@1+ (1,0) [0|0] "" GTW
 SG_ RCM2_452_presPedProLOpen m452 : 16|1@1+ (1,0) [0|0] "" GTW
 SG_ RCM2_453_presPedProLCrssCoup m453 : 16|1@1+ (1,0) [0|0] "" GTW
 SG_ RCM2_454_presPedProLCommErr m454 : 16|1@1+ (1,0) [0|0] "" GTW
 SG_ RCM2_455_presPedProLInitTyp m455 : 16|1@1+ (1,0) [0|0] "" GTW
 SG_ RCM2_456_presPedProLConfig m456 : 16|1@1+ (1,0) [0|0] "" GTW
 SG_ RCM2_457_presPedProLDefect m457 : 16|1@1+ (1,0) [0|0] "" GTW
 SG_ RCM2_458_presPedProLSigMon m458 : 16|1@1+ (1,0) [0|0] "" GTW
 SG_ RCM2_460_presPedProRSht2Gnd m460 : 16|1@1+ (1,0) [0|0] "" GTW
 SG_ RCM2_461_presPedProRSht2Bat m461 : 16|1@1+ (1,0) [0|0] "" GTW
 SG_ RCM2_462_presPedProROpen m462 : 16|1@1+ (1,0) [0|0] "" GTW
 SG_ RCM2_463_presPedProRCrssCoup m463 : 16|1@1+ (1,0) [0|0] "" GTW
 SG_ RCM2_464_presPedProRCommErr m464 : 16|1@1+ (1,0) [0|0] "" GTW
 SG_ RCM2_465_presPedProRInitTyp m465 : 16|1@1+ (1,0) [0|0] "" GTW
 SG_ RCM2_466_presPedProRConfig m466 : 16|1@1+ (1,0) [0|0] "" GTW
 SG_ RCM2_467_presPedProRDefect m467 : 16|1@1+ (1,0) [0|0] "" GTW
 SG_ RCM2_468_presPedProRSigMon m468 : 16|1@1+ (1,0) [0|0] "" GTW
 SG_ RCM2_469_presPedProAbsolute m469 : 16|1@1+ (1,0) [0|0] "" GTW
 SG_ RCM2_470_upFrntPedProLSht2Gnd m470 : 16|1@1+ (1,0) [0|0] "" GTW
 SG_ RCM2_471_upFrntPedProLSht2Bat m471 : 16|1@1+ (1,0) [0|0] "" GTW
 SG_ RCM2_472_upFrntPedProLOpen m472 : 16|1@1+ (1,0) [0|0] "" GTW
 SG_ RCM2_473_upFrntPedProLCrssCoup m473 : 16|1@1+ (1,0) [0|0] "" GTW
 SG_ RCM2_474_upFrntPedProLCommErr m474 : 16|1@1+ (1,0) [0|0] "" GTW
 SG_ RCM2_475_upFrntPedProLIntTyp m475 : 16|1@1+ (1,0) [0|0] "" GTW
 SG_ RCM2_476_upFrntPedProLConfig m476 : 16|1@1+ (1,0) [0|0] "" GTW
 SG_ RCM2_477_upFrntPedProLDefect m477 : 16|1@1+ (1,0) [0|0] "" GTW
 SG_ RCM2_478_upFrntPedProSht2Gnd m478 : 16|1@1+ (1,0) [0|0] "" GTW
 SG_ RCM2_480_upFrntPedProRSht2Gnd m480 : 16|1@1+ (1,0) [0|0] "" GTW
 SG_ RCM2_481_upFrntPedProRSht2Bat m481 : 16|1@1+ (1,0) [0|0] "" GTW
 SG_ RCM2_482_upFrntPedProROpen m482 : 16|1@1+ (1,0) [0|0] "" GTW
 SG_ RCM2_483_upFrntPedProRCrssCoup m483 : 16|1@1+ (1,0) [0|0] "" GTW
 SG_ RCM2_484_upFrntPedProRCommErr m484 : 16|1@1+ (1,0) [0|0] "" GTW
 SG_ RCM2_485_upFrntPedProRIntTyp m485 : 16|1@1+ (1,0) [0|0] "" GTW
 SG_ RCM2_486_upFrntPedProRConfig m486 : 16|1@1+ (1,0) [0|0] "" GTW
 SG_ RCM2_487_upFrntPedProRDefect m487 : 16|1@1+ (1,0) [0|0] "" GTW
 SG_ RCM2_488_upFrntPedProSht2Gnd m488 : 16|1@1+ (1,0) [0|0] "" GTW
 SG_ RCM2_550_bucklHallLeftSht2Gnd m550 : 16|1@1+ (1,0) [0|0] "" GTW
 SG_ RCM2_551_bucklHallLeftSht2Bat m551 : 16|1@1+ (1,0) [0|0] "" GTW
 SG_ RCM2_552_bucklHallLeftOpen m552 : 16|1@1+ (1,0) [0|0] "" GTW
 SG_ RCM2_553_bucklHallLeftUndef m553 : 16|1@1+ (1,0) [0|0] "" GTW
 SG_ RCM2_554_bucklHallLeftCrssCoup m554 : 16|1@1+ (1,0) [0|0] "" GTW
 SG_ RCM2_555_bucklHallLeftConfig m555 : 16|1@1+ (1,0) [0|0] "" GTW
 SG_ RCM2_556_bucklHallRightSht2Gnd m556 : 16|1@1+ (1,0) [0|0] "" GTW
 SG_ RCM2_557_bucklHallRightSht2Bat m557 : 16|1@1+ (1,0) [0|0] "" GTW
 SG_ RCM2_558_bucklHallRightOpen m558 : 16|1@1+ (1,0) [0|0] "" GTW
 SG_ RCM2_559_bucklHallRightUndef m559 : 16|1@1+ (1,0) [0|0] "" GTW
 SG_ RCM2_560_bucklHallRightCrssCoup m560 : 16|1@1+ (1,0) [0|0] "" GTW
 SG_ RCM2_561_bucklHallRightConfig m561 : 16|1@1+ (1,0) [0|0] "" GTW
 SG_ RCM2_562_seaTrkPosLeftSht2Gnd m562 : 16|1@1+ (1,0) [0|0] "" GTW
 SG_ RCM2_563_seaTrkPosLeftShtBat m563 : 16|1@1+ (1,0) [0|0] "" GTW
 SG_ RCM2_564_seaTrkPosLeftOpen m564 : 16|1@1+ (1,0) [0|0] "" GTW
 SG_ RCM2_565_seaTrkPosLeftUndefined m565 : 16|1@1+ (1,0) [0|0] "" GTW
 SG_ RCM2_566_seaTrkPosLeftCrssCoup m566 : 16|1@1+ (1,0) [0|0] "" GTW
 SG_ RCM2_567_seaTrkPosLeftConfig m567 : 16|1@1+ (1,0) [0|0] "" GTW
 SG_ RCM2_568_occPROSSht2Gnd m568 : 16|1@1+ (1,0) [0|0] "" GTW
 SG_ RCM2_569_occPROSSht2Bat m569 : 16|1@1+ (1,0) [0|0] "" GTW
 SG_ RCM2_570_occPROSOpen m570 : 16|1@1+ (1,0) [0|0] "" GTW
 SG_ RCM2_571_occPROSUndef m571 : 16|1@1+ (1,0) [0|0] "" GTW
 SG_ RCM2_572_occPROSCrssCoup m572 : 16|1@1+ (1,0) [0|0] "" GTW
 SG_ RCM2_573_occPROSConfig m573 : 16|1@1+ (1,0) [0|0] "" GTW
 SG_ RCM2_587_sbrRearNetSht2Gnd m587 : 16|1@1+ (1,0) [0|0] "" GTW
 SG_ RCM2_588_sbrRearNetSht2Bat m588 : 16|1@1+ (1,0) [0|0] "" GTW
 SG_ RCM2_589_sbrRearNetOpen m589 : 16|1@1+ (1,0) [0|0] "" GTW
 SG_ RCM2_590_sbrRearNetUndefined m590 : 16|1@1+ (1,0) [0|0] "" GTW
 SG_ RCM2_591_sbrRearNetCrssCoup m591 : 16|1@1+ (1,0) [0|0] "" GTW
 SG_ RCM2_592_sbrRearNetConfig m592 : 16|1@1+ (1,0) [0|0] "" GTW
 SG_ RCM2_593_driveOrientaSht2Gnd m593 : 16|1@1+ (1,0) [0|0] "" GTW
 SG_ RCM2_594_driveOrientaSht2Bat m594 : 16|1@1+ (1,0) [0|0] "" GTW
 SG_ RCM2_595_driveOrientaOpen m595 : 16|1@1+ (1,0) [0|0] "" GTW
 SG_ RCM2_596_driveOrientaUndefined m596 : 16|1@1+ (1,0) [0|0] "" GTW
 SG_ RCM2_597_driveOrientaCrssCoup m597 : 16|1@1+ (1,0) [0|0] "" GTW
 SG_ RCM2_598_driveOrientaConfig m598 : 16|1@1+ (1,0) [0|0] "" GTW
 SG_ RCM2_600_comCANinternalTimeout m600 : 16|1@1+ (1,0) [0|0] "" GTW
 SG_ RCM2_601_comChassisCANInit m601 : 16|1@1+ (1,0) [0|0] "" GTW
 SG_ RCM2_602_comChassisCANBusOff m602 : 16|1@1+ (1,0) [0|0] "" GTW
 SG_ RCM2_603_comPARTYCANInit m603 : 16|1@1+ (1,0) [0|0] "" GTW
 SG_ RCM2_604_comPARTYCANBusOff m604 : 16|1@1+ (1,0) [0|0] "" GTW
 SG_ RCM2_605_comStwAngStatMIA m605 : 16|1@1+ (1,0) [0|0] "" GTW
 SG_ RCM2_606_comStwAngStatChkSm m606 : 16|1@1+ (1,0) [0|0] "" GTW
 SG_ RCM2_607_comStwAngStatCntr m607 : 16|1@1+ (1,0) [0|0] "" GTW
 SG_ RCM2_608_comDItorque1MIA m608 : 16|1@1+ (1,0) [0|0] "" GTW
 SG_ RCM2_609_comDItorque1ChkSm m609 : 16|1@1+ (1,0) [0|0] "" GTW
 SG_ RCM2_610_comDItorque1Cntr m610 : 16|1@1+ (1,0) [0|0] "" GTW
 SG_ RCM2_611_comDItorque2MIA m611 : 16|1@1+ (1,0) [0|0] "" GTW
 SG_ RCM2_612_comDItorque2ChkSm m612 : 16|1@1+ (1,0) [0|0] "" GTW
 SG_ RCM2_613_comDItorque2Cntr m613 : 16|1@1+ (1,0) [0|0] "" GTW
 SG_ RCM2_614_comESP135MIA m614 : 16|1@1+ (1,0) [0|0] "" GTW
 SG_ RCM2_615_comESP135ChkSm m615 : 16|1@1+ (1,0) [0|0] "" GTW
 SG_ RCM2_616_comESP135Cntr m616 : 16|1@1+ (1,0) [0|0] "" GTW
 SG_ RCM2_617_comESP145MIA m617 : 16|1@1+ (1,0) [0|0] "" GTW
 SG_ RCM2_618_comESP145ChkSm m618 : 16|1@1+ (1,0) [0|0] "" GTW
 SG_ RCM2_619_comESP145Cntr m619 : 16|1@1+ (1,0) [0|0] "" GTW
 SG_ RCM2_620_comInvalidVehicleSpeed m620 : 16|1@1+ (1,0) [0|0] "" GTW
 SG_ RCM2_621_comESPBMIA m621 : 16|1@1+ (1,0) [0|0] "" GTW
 SG_ RCM2_622_comESPBChkSm m622 : 16|1@1+ (1,0) [0|0] "" GTW
 SG_ RCM2_623_comESPBCntr m623 : 16|1@1+ (1,0) [0|0] "" GTW
 SG_ RCM2_624_comESPCMIA m624 : 16|1@1+ (1,0) [0|0] "" GTW
 SG_ RCM2_625_comESPCChkSm m625 : 16|1@1+ (1,0) [0|0] "" GTW
 SG_ RCM2_626_comESPCCntr m626 : 16|1@1+ (1,0) [0|0] "" GTW
 SG_ RCM2_627_comEPBStatusMIA m627 : 16|1@1+ (1,0) [0|0] "" GTW
 SG_ RCM2_628_comEPBStatusChkSm m628 : 16|1@1+ (1,0) [0|0] "" GTW
 SG_ RCM2_629_comEPBStatusCntr m629 : 16|1@1+ (1,0) [0|0] "" GTW
 SG_ RCM2_630_comGTWACSMIA m630 : 16|1@1+ (1,0) [0|0] "" GTW
 SG_ RCM2_631_comGTWACSChkSm m631 : 16|1@1+ (1,0) [0|0] "" GTW
 SG_ RCM2_632_comGTWACSCntr m632 : 16|1@1+ (1,0) [0|0] "" GTW
 SG_ RCM2_633_comOCS1PMIA m633 : 16|1@1+ (1,0) [0|0] "" GTW
 SG_ RCM2_634_comOCS1PChkSm m634 : 16|1@1+ (1,0) [0|0] "" GTW
 SG_ RCM2_635_comOCS1PCntr m635 : 16|1@1+ (1,0) [0|0] "" GTW
 SG_ RCM2_636_ocsFaulted m636 : 16|1@1+ (1,0) [0|0] "" GTW
 SG_ RCM2_637_ocsUnknown m637 : 16|1@1+ (1,0) [0|0] "" GTW
 SG_ RCM2_638_comGTWodoMIA m638 : 16|1@1+ (1,0) [0|0] "" GTW
 SG_ RCM2_639_comGTWCarStateMIA m639 : 16|1@1+ (1,0) [0|0] "" GTW
 SG_ RCM2_640_comTPMSStatusCMIA m640 : 16|1@1+ (1,0) [0|0] "" GTW
 SG_ RCM2_641_comGTWCarConfigMIA m641 : 16|1@1+ (1,0) [0|0] "" GTW
 SG_ RCM2_642_comVINmessageMIA m642 : 16|1@1+ (1,0) [0|0] "" GTW
 SG_ RCM2_643_comDASSafetyFrntMIA m643 : 16|1@1+ (1,0) [0|0] "" GTW
 SG_ RCM2_644_comDASSafetyFrntChkSm m644 : 16|1@1+ (1,0) [0|0] "" GTW
 SG_ RCM2_645_comDASSafetyFrntCntr m645 : 16|1@1+ (1,0) [0|0] "" GTW
 SG_ RCM2_646_comDIstateMIA m646 : 16|1@1+ (1,0) [0|0] "" GTW
 SG_ RCM2_647_comDIstateChkSm m647 : 16|1@1+ (1,0) [0|0] "" GTW
 SG_ RCM2_648_comDIstateCntr m648 : 16|1@1+ (1,0) [0|0] "" GTW
 SG_ RCM2_649_comDIstate2MIA m649 : 16|1@1+ (1,0) [0|0] "" GTW
 SG_ RCM2_650_comDIstate2ChkSm m650 : 16|1@1+ (1,0) [0|0] "" GTW
 SG_ RCM2_651_comDIstate2Cntr m651 : 16|1@1+ (1,0) [0|0] "" GTW
 SG_ RCM2_652_ambientTempFaulted m652 : 16|1@1+ (1,0) [0|0] "" GTW
 SG_ RCM2_653_comGTWESP1MIA m653 : 16|1@1+ (1,0) [0|0] "" GTW
 SG_ RCM2_654_comGTWESP1ChkSm m654 : 16|1@1+ (1,0) [0|0] "" GTW
 SG_ RCM2_655_comGTWESP1Cntr m655 : 16|1@1+ (1,0) [0|0] "" GTW
 SG_ RCM2_750_linInternalTimeout m750 : 16|1@1+ (1,0) [0|0] "" GTW
 SG_ RCM2_800_cfgMissingCalibration m800 : 16|1@1+ (1,0) [0|0] "" GTW
 SG_ RCM2_801_cfgImplausConfig m801 : 16|1@1+ (1,0) [0|0] "" GTW
 SG_ RCM2_802_cfgInvalidConfig m802 : 16|1@1+ (1,0) [0|0] "" GTW
 SG_ RCM2_803_cfgNotConfigured m803 : 16|1@1+ (1,0) [0|0] "" GTW
 SG_ RCM2_804_cfgNotProgrammed m804 : 16|1@1+ (1,0) [0|0] "" GTW
 SG_ RCM2_805_cfgPedProNotProgrammed m805 : 16|1@1+ (1,0) [0|0] "" GTW
 SG_ RCM2_806_cfgCrashCalPNmissing m806 : 16|1@1+ (1,0) [0|0] "" GTW
 SG_ RCM2_807_cfgExternalCRCError m807 : 16|1@1+ (1,0) [0|0] "" GTW
 SG_ RCM2_808_cfgInvalParamLayoutID m808 : 16|1@1+ (1,0) [0|0] "" GTW
 SG_ RCM2_809_cfgInvalParamTransID m809 : 16|1@1+ (1,0) [0|0] "" GTW
 SG_ RCM2_810_cfgAlgoVerifySnsrID m810 : 16|1@1+ (1,0) [0|0] "" GTW
 SG_ RCM2_811_cfgConfigDataInconsist m811 : 16|1@1+ (1,0) [0|0] "" GTW
 SG_ RCM2_812_swVersionWrong m812 : 16|1@1+ (1,0) [0|0] "" GTW
 SG_ RCM2_813_vinNotProgrammed m813 : 16|1@1+ (1,0) [0|0] "" GTW
 SG_ RCM2_814_vinMismatch m814 : 16|1@1+ (1,0) [0|0] "" GTW
 SG_ RCM2_815_driveLeaningNotDone m815 : 16|1@1+ (1,0) [0|0] "" GTW
 SG_ RCM2_816_driveLeaningMismatch m816 : 16|1@1+ (1,0) [0|0] "" GTW
 SG_ RCM2_817_bootActionsFailed m817 : 16|1@1+ (1,0) [0|0] "" GTW
 SG_ RCM2_850_internalFault_001 m850 : 16|1@1+ (1,0) [0|0] "" GTW
 SG_ RCM2_851_internalFault_002 m851 : 16|1@1+ (1,0) [0|0] "" GTW
 SG_ RCM2_852_internalFault_003 m852 : 16|1@1+ (1,0) [0|0] "" GTW
 SG_ RCM2_853_internalFault_004 m853 : 16|1@1+ (1,0) [0|0] "" GTW
 SG_ RCM2_854_internalFault_005 m854 : 16|1@1+ (1,0) [0|0] "" GTW
 SG_ RCM2_855_internalFault_006 m855 : 16|1@1+ (1,0) [0|0] "" GTW
 SG_ RCM2_856_internalFault_007 m856 : 16|1@1+ (1,0) [0|0] "" GTW
 SG_ RCM2_857_internalFault_008 m857 : 16|1@1+ (1,0) [0|0] "" GTW
 SG_ RCM2_858_internalFault_009 m858 : 16|1@1+ (1,0) [0|0] "" GTW
 SG_ RCM2_859_internalFault_010 m859 : 16|1@1+ (1,0) [0|0] "" GTW
 SG_ RCM2_860_internalFault_011 m860 : 16|1@1+ (1,0) [0|0] "" GTW
 SG_ RCM2_861_internalFault_012 m861 : 16|1@1+ (1,0) [0|0] "" GTW
 SG_ RCM2_862_internalFault_013 m862 : 16|1@1+ (1,0) [0|0] "" GTW
 SG_ RCM2_863_internalFault_014 m863 : 16|1@1+ (1,0) [0|0] "" GTW
 SG_ RCM2_864_internalFault_015 m864 : 16|1@1+ (1,0) [0|0] "" GTW
 SG_ RCM2_865_internalFault_016 m865 : 16|1@1+ (1,0) [0|0] "" GTW
 SG_ RCM2_866_internalFault_017 m866 : 16|1@1+ (1,0) [0|0] "" GTW
 SG_ RCM2_867_internalFault_018 m867 : 16|1@1+ (1,0) [0|0] "" GTW
 SG_ RCM2_868_internalFault_019 m868 : 16|1@1+ (1,0) [0|0] "" GTW
 SG_ RCM2_869_internalFault_020 m869 : 16|1@1+ (1,0) [0|0] "" GTW
 SG_ RCM2_870_internalFault_021 m870 : 16|1@1+ (1,0) [0|0] "" GTW
 SG_ RCM2_871_internalFault_022 m871 : 16|1@1+ (1,0) [0|0] "" GTW
 SG_ RCM2_872_internalFault_023 m872 : 16|1@1+ (1,0) [0|0] "" GTW
 SG_ RCM2_873_internalFault_024 m873 : 16|1@1+ (1,0) [0|0] "" GTW
 SG_ RCM2_874_internalFault_025 m874 : 16|1@1+ (1,0) [0|0] "" GTW
 SG_ RCM2_875_internalFault_026 m875 : 16|1@1+ (1,0) [0|0] "" GTW
 SG_ RCM2_876_internalFault_027 m876 : 16|1@1+ (1,0) [0|0] "" GTW
 SG_ RCM2_877_internalFault_028 m877 : 16|1@1+ (1,0) [0|0] "" GTW
 SG_ RCM2_878_internalFault_029 m878 : 16|1@1+ (1,0) [0|0] "" GTW
 SG_ RCM2_879_internalFault_030 m879 : 16|1@1+ (1,0) [0|0] "" GTW
 SG_ RCM2_880_internalFault_031 m880 : 16|1@1+ (1,0) [0|0] "" GTW
 SG_ RCM2_881_internalFault_032 m881 : 16|1@1+ (1,0) [0|0] "" GTW
 SG_ RCM2_882_internalFault_033 m882 : 16|1@1+ (1,0) [0|0] "" GTW
 SG_ RCM2_883_internalFault_034 m883 : 16|1@1+ (1,0) [0|0] "" GTW
 SG_ RCM2_884_internalFault_035 m884 : 16|1@1+ (1,0) [0|0] "" GTW
 SG_ RCM2_885_internalFault_036 m885 : 16|1@1+ (1,0) [0|0] "" GTW
 SG_ RCM2_886_internalFault_037 m886 : 16|1@1+ (1,0) [0|0] "" GTW
 SG_ RCM2_887_internalFault_038 m887 : 16|1@1+ (1,0) [0|0] "" GTW
 SG_ RCM2_888_internalFault_039 m888 : 16|1@1+ (1,0) [0|0] "" GTW
 SG_ RCM2_889_internalFault_040 m889 : 16|1@1+ (1,0) [0|0] "" GTW
 SG_ RCM2_890_internalFault_041 m890 : 16|1@1+ (1,0) [0|0] "" GTW
 SG_ RCM2_891_internalFault_042 m891 : 16|1@1+ (1,0) [0|0] "" GTW
 SG_ RCM2_892_internalFault_043 m892 : 16|1@1+ (1,0) [0|0] "" GTW
 SG_ RCM2_893_internalFault_044 m893 : 16|1@1+ (1,0) [0|0] "" GTW
 SG_ RCM2_894_internalFault_045 m894 : 16|1@1+ (1,0) [0|0] "" GTW
 SG_ RCM2_895_internalFault_046 m895 : 16|1@1+ (1,0) [0|0] "" GTW
 SG_ RCM2_896_internalFault_047 m896 : 16|1@1+ (1,0) [0|0] "" GTW
 SG_ RCM2_897_internalFault_048 m897 : 16|1@1+ (1,0) [0|0] "" GTW
 SG_ RCM2_898_internalFault_049 m898 : 16|1@1+ (1,0) [0|0] "" GTW
 SG_ RCM2_899_internalFault_050 m899 : 16|1@1+ (1,0) [0|0] "" GTW
 SG_ RCM2_900_internalFault_051 m900 : 16|1@1+ (1,0) [0|0] "" GTW
 SG_ RCM2_901_internalFault_052 m901 : 16|1@1+ (1,0) [0|0] "" GTW
 SG_ RCM2_902_internalFault_053 m902 : 16|1@1+ (1,0) [0|0] "" GTW
 SG_ RCM2_903_internalFault_054 m903 : 16|1@1+ (1,0) [0|0] "" GTW
 SG_ RCM2_904_internalFault_055 m904 : 16|1@1+ (1,0) [0|0] "" GTW
 SG_ RCM2_905_internalFault_056 m905 : 16|1@1+ (1,0) [0|0] "" GTW
 SG_ RCM2_906_internalFault_057 m906 : 16|1@1+ (1,0) [0|0] "" GTW
 SG_ RCM2_907_internalFault_058 m907 : 16|1@1+ (1,0) [0|0] "" GTW
 SG_ RCM2_908_internalFault_059 m908 : 16|1@1+ (1,0) [0|0] "" GTW
 SG_ RCM2_909_internalFault_060 m909 : 16|1@1+ (1,0) [0|0] "" GTW
 SG_ RCM2_910_internalFault_061 m910 : 16|1@1+ (1,0) [0|0] "" GTW
 SG_ RCM2_911_internalFault_062 m911 : 16|1@1+ (1,0) [0|0] "" GTW
 SG_ RCM2_912_internalFault_063 m912 : 16|1@1+ (1,0) [0|0] "" GTW
 SG_ RCM2_913_internalFault_064 m913 : 16|1@1+ (1,0) [0|0] "" GTW
 SG_ RCM2_914_internalFault_065 m914 : 16|1@1+ (1,0) [0|0] "" GTW
 SG_ RCM2_915_internalFault_066 m915 : 16|1@1+ (1,0) [0|0] "" GTW
 SG_ RCM2_916_internalFault_067 m916 : 16|1@1+ (1,0) [0|0] "" GTW
 SG_ RCM2_917_internalFault_068 m917 : 16|1@1+ (1,0) [0|0] "" GTW
 SG_ RCM2_918_internalFault_069 m918 : 16|1@1+ (1,0) [0|0] "" GTW
 SG_ RCM2_919_internalFault_070 m919 : 16|1@1+ (1,0) [0|0] "" GTW
 SG_ RCM2_920_internalFault_071 m920 : 16|1@1+ (1,0) [0|0] "" GTW
 SG_ RCM2_921_internalFault_072 m921 : 16|1@1+ (1,0) [0|0] "" GTW
 SG_ RCM2_922_internalFault_073 m922 : 16|1@1+ (1,0) [0|0] "" GTW
 SG_ RCM2_923_internalFault_074 m923 : 16|1@1+ (1,0) [0|0] "" GTW
 SG_ RCM2_924_internalFault_075 m924 : 16|1@1+ (1,0) [0|0] "" GTW
 SG_ RCM2_925_internalFault_076 m925 : 16|1@1+ (1,0) [0|0] "" GTW
 SG_ RCM2_926_internalFault_077 m926 : 16|1@1+ (1,0) [0|0] "" GTW
 SG_ RCM2_927_internalFault_078 m927 : 16|1@1+ (1,0) [0|0] "" GTW
 SG_ RCM2_928_internalFault_079 m928 : 16|1@1+ (1,0) [0|0] "" GTW
 SG_ RCM2_929_internalFault_080 m929 : 16|1@1+ (1,0) [0|0] "" GTW
 SG_ RCM2_930_internalFault_081 m930 : 16|1@1+ (1,0) [0|0] "" GTW
 SG_ RCM2_931_internalFault_082 m931 : 16|1@1+ (1,0) [0|0] "" GTW
 SG_ RCM2_932_internalFault_083 m932 : 16|1@1+ (1,0) [0|0] "" GTW
 SG_ RCM2_933_internalFault_084 m933 : 16|1@1+ (1,0) [0|0] "" GTW
 SG_ RCM2_934_internalFault_085 m934 : 16|1@1+ (1,0) [0|0] "" GTW
 SG_ RCM2_935_internalFault_086 m935 : 16|1@1+ (1,0) [0|0] "" GTW
 SG_ RCM2_936_internalFault_087 m936 : 16|1@1+ (1,0) [0|0] "" GTW
 SG_ RCM2_937_internalFault_088 m937 : 16|1@1+ (1,0) [0|0] "" GTW
 SG_ RCM2_938_internalFault_089 m938 : 16|1@1+ (1,0) [0|0] "" GTW
 SG_ RCM2_939_internalFault_090 m939 : 16|1@1+ (1,0) [0|0] "" GTW
 SG_ RCM2_940_internalFault_091 m940 : 16|1@1+ (1,0) [0|0] "" GTW
 SG_ RCM2_941_internalFault_092 m941 : 16|1@1+ (1,0) [0|0] "" GTW
 SG_ RCM2_942_internalFault_093 m942 : 16|1@1+ (1,0) [0|0] "" GTW
 SG_ RCM2_943_internalFault_094 m943 : 16|1@1+ (1,0) [0|0] "" GTW
 SG_ RCM2_944_internalFault_095 m944 : 16|1@1+ (1,0) [0|0] "" GTW
 SG_ RCM2_945_internalFault_096 m945 : 16|1@1+ (1,0) [0|0] "" GTW
 SG_ RCM2_946_internalFault_097 m946 : 16|1@1+ (1,0) [0|0] "" GTW
 SG_ RCM2_947_internalFault_098 m947 : 16|1@1+ (1,0) [0|0] "" GTW
 SG_ RCM2_948_internalFault_099 m948 : 16|1@1+ (1,0) [0|0] "" GTW
 SG_ RCM2_949_internalFault_100 m949 : 16|1@1+ (1,0) [0|0] "" GTW
 SG_ RCM2_950_internalFault_101 m950 : 16|1@1+ (1,0) [0|0] "" GTW
 SG_ RCM2_951_internalFault_102 m951 : 16|1@1+ (1,0) [0|0] "" GTW
 SG_ RCM2_952_internalFault_103 m952 : 16|1@1+ (1,0) [0|0] "" GTW
 SG_ RCM2_953_internalFault_104 m953 : 16|1@1+ (1,0) [0|0] "" GTW
 SG_ RCM2_954_internalFault_105 m954 : 16|1@1+ (1,0) [0|0] "" GTW
 SG_ RCM2_955_internalFault_106 m955 : 16|1@1+ (1,0) [0|0] "" GTW
 SG_ RCM2_956_internalFault_107 m956 : 16|1@1+ (1,0) [0|0] "" GTW
 SG_ RCM2_957_internalFault_108 m957 : 16|1@1+ (1,0) [0|0] "" GTW
 SG_ RCM2_958_internalFault_109 m958 : 16|1@1+ (1,0) [0|0] "" GTW
 SG_ RCM2_959_internalFault_110 m959 : 16|1@1+ (1,0) [0|0] "" GTW
 SG_ RCM2_960_internalFault_111 m960 : 16|1@1+ (1,0) [0|0] "" GTW
 SG_ RCM2_961_internalFault_112 m961 : 16|1@1+ (1,0) [0|0] "" GTW
 SG_ RCM2_962_internalFault_113 m962 : 16|1@1+ (1,0) [0|0] "" GTW
 SG_ RCM2_963_internalFault_114 m963 : 16|1@1+ (1,0) [0|0] "" GTW
 SG_ RCM2_964_internalFault_115 m964 : 16|1@1+ (1,0) [0|0] "" GTW
 SG_ RCM2_965_internalFault_116 m965 : 16|1@1+ (1,0) [0|0] "" GTW
 SG_ RCM2_966_internalFault_117 m966 : 16|1@1+ (1,0) [0|0] "" GTW
 SG_ RCM2_967_internalFault_118 m967 : 16|1@1+ (1,0) [0|0] "" GTW
 SG_ RCM2_968_internalFault_119 m968 : 16|1@1+ (1,0) [0|0] "" GTW
 SG_ RCM2_969_internalFault_120 m969 : 16|1@1+ (1,0) [0|0] "" GTW
 SG_ RCM2_970_internalFault_121 m970 : 16|1@1+ (1,0) [0|0] "" GTW
 SG_ RCM2_971_internalFault_122 m971 : 16|1@1+ (1,0) [0|0] "" GTW
 SG_ RCM2_972_internalFault_123 m972 : 16|1@1+ (1,0) [0|0] "" GTW
 SG_ RCM2_973_internalFault_124 m973 : 16|1@1+ (1,0) [0|0] "" GTW
 SG_ RCM2_974_internalFault_125 m974 : 16|1@1+ (1,0) [0|0] "" GTW
 SG_ RCM2_975_internalFault_126 m975 : 16|1@1+ (1,0) [0|0] "" GTW
 SG_ RCM2_976_internalFault_127 m976 : 16|1@1+ (1,0) [0|0] "" GTW
 SG_ RCM2_977_internalFault_128 m977 : 16|1@1+ (1,0) [0|0] "" GTW
 SG_ RCM2_978_internalFault_129 m978 : 16|1@1+ (1,0) [0|0] "" GTW
 SG_ RCM2_979_internalFault_130 m979 : 16|1@1+ (1,0) [0|0] "" GTW
 SG_ RCM2_980_internalFault_131 m980 : 16|1@1+ (1,0) [0|0] "" GTW
 SG_ RCM2_981_internalFault_132 m981 : 16|1@1+ (1,0) [0|0] "" GTW
 SG_ RCM2_982_internalFault_133 m982 : 16|1@1+ (1,0) [0|0] "" GTW
 SG_ RCM2_983_internalFault_134 m983 : 16|1@1+ (1,0) [0|0] "" GTW
 SG_ RCM2_984_internalFault_135 m984 : 16|1@1+ (1,0) [0|0] "" GTW
 SG_ RCM2_985_internalFault_136 m985 : 16|1@1+ (1,0) [0|0] "" GTW
 SG_ RCM2_986_internalFault_137 m986 : 16|1@1+ (1,0) [0|0] "" GTW
 SG_ RCM2_987_internalFault_138 m987 : 16|1@1+ (1,0) [0|0] "" GTW
 SG_ RCM2_988_internalFault_139 m988 : 16|1@1+ (1,0) [0|0] "" GTW
 SG_ RCM2_989_internalFault_140 m989 : 16|1@1+ (1,0) [0|0] "" GTW
 SG_ RCM2_990_internalFault_141 m990 : 16|1@1+ (1,0) [0|0] "" GTW
 SG_ RCM2_991_internalFault_142 m991 : 16|1@1+ (1,0) [0|0] "" GTW
 SG_ RCM2_992_internalFault_143 m992 : 16|1@1+ (1,0) [0|0] "" GTW
 SG_ RCM2_993_internalFault_144 m993 : 16|1@1+ (1,0) [0|0] "" GTW
 SG_ RCM2_994_internalFault_145 m994 : 16|1@1+ (1,0) [0|0] "" GTW

BO_ 1009 RCM2_alertMatrix: 8 RCM
 SG_ RCM2_matrixIndex M : 0|4@1+ (1,0) [0|0] "" GTW
 SG_ RCM2_a000_crashDetected m0 : 4|1@1+ (1,0) [0|0] "" GTW
 SG_ RCM2_a001_nearDeploy m0 : 5|1@1+ (1,0) [0|0] "" GTW
 SG_ RCM2_a002_airbagsUnArmed m0 : 6|1@1+ (1,0) [0|0] "" GTW
 SG_ RCM2_a003_warningIndicator m0 : 7|1@1+ (1,0) [0|0] "" GTW
 SG_ RCM2_a004_crashAlgoWakeup m0 : 8|1@1+ (1,0) [0|0] "" GTW
 SG_ RCM2_a005_abuseImmunityThrshold m0 : 9|1@1+ (1,0) [0|0] "" GTW
 SG_ RCM2_a006_supplierDiagEnabled m0 : 10|1@1+ (1,0) [0|0] "" GTW
 SG_ RCM2_a007_pedProCrashDetected m0 : 11|1@1+ (1,0) [0|0] "" GTW
 SG_ RCM2_a008_factoryMode m0 : 12|1@1+ (1,0) [0|0] "" GTW
 SG_ RCM2_a009_edrDataAreaLocked m0 : 13|1@1+ (1,0) [0|0] "" GTW
 SG_ RCM2_a010_pedProEDRDataLocked m0 : 14|1@1+ (1,0) [0|0] "" GTW
 SG_ RCM2_a011_FrntAlgoDisabled m0 : 15|1@1+ (1,0) [0|0] "" GTW
 SG_ RCM2_a012_RollAlgoDisabled m0 : 16|1@1+ (1,0) [0|0] "" GTW
 SG_ RCM2_a013_SideAlgoDisabled m0 : 17|1@1+ (1,0) [0|0] "" GTW
 SG_ RCM2_a014_pedProNearDeploy m0 : 18|1@1+ (1,0) [0|0] "" GTW
 SG_ RCM2_a047_batteryESRhigh m0 : 19|1@1+ (1,0) [0|0] "" GTW
 SG_ RCM2_a048_batteryVoltageTooHigh m0 : 20|1@1+ (1,0) [0|0] "" GTW
 SG_ RCM2_a049_batteryVoltageTooLow m0 : 21|1@1+ (1,0) [0|0] "" GTW
 SG_ RCM2_a050_driverABStg1Sht2Gnd m0 : 22|1@1+ (1,0) [0|0] "" GTW
 SG_ RCM2_a051_driverABStg1Sht2Bat m0 : 23|1@1+ (1,0) [0|0] "" GTW
 SG_ RCM2_a052_driverABStg1Open m0 : 24|1@1+ (1,0) [0|0] "" GTW
 SG_ RCM2_a053_driverABStg1Short m0 : 25|1@1+ (1,0) [0|0] "" GTW
 SG_ RCM2_a054_driverABStg1CrssCoup m0 : 26|1@1+ (1,0) [0|0] "" GTW
 SG_ RCM2_a055_driverABStg1Config m0 : 27|1@1+ (1,0) [0|0] "" GTW
 SG_ RCM2_a056_driverABStg2Sht2Gnd m0 : 28|1@1+ (1,0) [0|0] "" GTW
 SG_ RCM2_a057_driverABStg2Sht2Bat m0 : 29|1@1+ (1,0) [0|0] "" GTW
 SG_ RCM2_a058_driverABStg2Open m0 : 30|1@1+ (1,0) [0|0] "" GTW
 SG_ RCM2_a059_driverABStg2Short m0 : 31|1@1+ (1,0) [0|0] "" GTW
 SG_ RCM2_a060_driverABStg2CrssCoup m0 : 32|1@1+ (1,0) [0|0] "" GTW
 SG_ RCM2_a061_driverABStg2Config m0 : 33|1@1+ (1,0) [0|0] "" GTW
 SG_ RCM2_a062_passABStg1Sht2Gnd m0 : 34|1@1+ (1,0) [0|0] "" GTW
 SG_ RCM2_a063_passABStg1Sht2Bat m0 : 35|1@1+ (1,0) [0|0] "" GTW
 SG_ RCM2_a064_passABStg1Open m0 : 36|1@1+ (1,0) [0|0] "" GTW
 SG_ RCM2_a065_passABStg1Short m0 : 37|1@1+ (1,0) [0|0] "" GTW
 SG_ RCM2_a066_passABStg1CrssCoup m0 : 38|1@1+ (1,0) [0|0] "" GTW
 SG_ RCM2_a067_passABStg1Config m0 : 39|1@1+ (1,0) [0|0] "" GTW
 SG_ RCM2_a068_passABStg2Sht2Gnd m0 : 40|1@1+ (1,0) [0|0] "" GTW
 SG_ RCM2_a069_passABStg2Sht2Bat m0 : 41|1@1+ (1,0) [0|0] "" GTW
 SG_ RCM2_a070_passABStg2Open m0 : 42|1@1+ (1,0) [0|0] "" GTW
 SG_ RCM2_a071_passABStg2Short m0 : 43|1@1+ (1,0) [0|0] "" GTW
 SG_ RCM2_a072_passABStg2CrssCoup m0 : 44|1@1+ (1,0) [0|0] "" GTW
 SG_ RCM2_a073_passABStg2Config m0 : 45|1@1+ (1,0) [0|0] "" GTW
 SG_ RCM2_a074_passActiveVentSht2Gnd m0 : 46|1@1+ (1,0) [0|0] "" GTW
 SG_ RCM2_a075_passActiveVentSht2Bat m0 : 47|1@1+ (1,0) [0|0] "" GTW
 SG_ RCM2_a076_passActiveVentOpen m0 : 48|1@1+ (1,0) [0|0] "" GTW
 SG_ RCM2_a077_passActiveVentShort m0 : 49|1@1+ (1,0) [0|0] "" GTW
 SG_ RCM2_a078_passActiveVentCrssCoup m0 : 50|1@1+ (1,0) [0|0] "" GTW
 SG_ RCM2_a079_passActiveVentConfig m0 : 51|1@1+ (1,0) [0|0] "" GTW
 SG_ RCM2_a080_pretenShldLeftSht2Gnd m0 : 52|1@1+ (1,0) [0|0] "" GTW
 SG_ RCM2_a081_pretenShldLeftSht2Bat m0 : 53|1@1+ (1,0) [0|0] "" GTW
 SG_ RCM2_a082_pretenShldLeftOpen m0 : 54|1@1+ (1,0) [0|0] "" GTW
 SG_ RCM2_a083_pretenShldLeftShort m0 : 55|1@1+ (1,0) [0|0] "" GTW
 SG_ RCM2_a084_pretenShldLeftCrossC m0 : 56|1@1+ (1,0) [0|0] "" GTW
 SG_ RCM2_a085_pretenShldLeftConfig m0 : 57|1@1+ (1,0) [0|0] "" GTW
 SG_ RCM2_a086_pretenShldRightSht2Gnd m0 : 58|1@1+ (1,0) [0|0] "" GTW
 SG_ RCM2_a087_pretenShldRightSht2Bat m0 : 59|1@1+ (1,0) [0|0] "" GTW
 SG_ RCM2_a088_pretenShldRightOpen m0 : 60|1@1+ (1,0) [0|0] "" GTW
 SG_ RCM2_a089_pretenShldRightShort m0 : 61|1@1+ (1,0) [0|0] "" GTW
 SG_ RCM2_a090_pretenShldRightCrssCou m0 : 62|1@1+ (1,0) [0|0] "" GTW
 SG_ RCM2_a091_pretenShldRightConfig m0 : 63|1@1+ (1,0) [0|0] "" GTW
 SG_ RCM2_a092_pretenLapLeftSht2Gnd m1 : 4|1@1+ (1,0) [0|0] "" GTW
 SG_ RCM2_a093_pretenLapLeftSht2Bat m1 : 5|1@1+ (1,0) [0|0] "" GTW
 SG_ RCM2_a094_pretenLapLeftOpen m1 : 6|1@1+ (1,0) [0|0] "" GTW
 SG_ RCM2_a095_pretenLapLeftShort m1 : 7|1@1+ (1,0) [0|0] "" GTW
 SG_ RCM2_a096_pretenLapLeftCrssCoup m1 : 8|1@1+ (1,0) [0|0] "" GTW
 SG_ RCM2_a097_pretenLapLeftConfig m1 : 9|1@1+ (1,0) [0|0] "" GTW
 SG_ RCM2_a098_pretenLapRightSht2Gnd m1 : 10|1@1+ (1,0) [0|0] "" GTW
 SG_ RCM2_a099_pretenLapRightSht2Bat m1 : 11|1@1+ (1,0) [0|0] "" GTW
 SG_ RCM2_a100_pretenLapRightOpen m1 : 12|1@1+ (1,0) [0|0] "" GTW
 SG_ RCM2_a101_pretenLapRightShort m1 : 13|1@1+ (1,0) [0|0] "" GTW
 SG_ RCM2_a102_pretenLapRightCrssCoup m1 : 14|1@1+ (1,0) [0|0] "" GTW
 SG_ RCM2_a103_pretenLapRightConfig m1 : 15|1@1+ (1,0) [0|0] "" GTW
 SG_ RCM2_a104_loadLimLeftSht2Gnd m1 : 16|1@1+ (1,0) [0|0] "" GTW
 SG_ RCM2_a105_loadLimLeftSht2Bat m1 : 17|1@1+ (1,0) [0|0] "" GTW
 SG_ RCM2_a106_loadLimLeftOpen m1 : 18|1@1+ (1,0) [0|0] "" GTW
 SG_ RCM2_a107_loadLimLeftShort m1 : 19|1@1+ (1,0) [0|0] "" GTW
 SG_ RCM2_a108_loadLimLeftCrssCoup m1 : 20|1@1+ (1,0) [0|0] "" GTW
 SG_ RCM2_a109_loadLimLeftConfig m1 : 21|1@1+ (1,0) [0|0] "" GTW
 SG_ RCM2_a110_loadLimRightSht2Gnd m1 : 22|1@1+ (1,0) [0|0] "" GTW
 SG_ RCM2_a111_loadLimRightSht2Bat m1 : 23|1@1+ (1,0) [0|0] "" GTW
 SG_ RCM2_a112_loadLimRightOpen m1 : 24|1@1+ (1,0) [0|0] "" GTW
 SG_ RCM2_a113_loadLimRightShort m1 : 25|1@1+ (1,0) [0|0] "" GTW
 SG_ RCM2_a114_loadLimRightCrssCoup m1 : 26|1@1+ (1,0) [0|0] "" GTW
 SG_ RCM2_a115_loadLimRightConfig m1 : 27|1@1+ (1,0) [0|0] "" GTW
 SG_ RCM2_a116_kneeABDrvrSht2Gnd m1 : 28|1@1+ (1,0) [0|0] "" GTW
 SG_ RCM2_a117_kneeABDrvrSht2Bat m1 : 29|1@1+ (1,0) [0|0] "" GTW
 SG_ RCM2_a118_kneeABDrvrOpen m1 : 30|1@1+ (1,0) [0|0] "" GTW
 SG_ RCM2_a119_kneeABDrvrShort m1 : 31|1@1+ (1,0) [0|0] "" GTW
 SG_ RCM2_a120_kneeABDrvrCrssCoup m1 : 32|1@1+ (1,0) [0|0] "" GTW
 SG_ RCM2_a121_kneeABDrvrConfig m1 : 33|1@1+ (1,0) [0|0] "" GTW
 SG_ RCM2_a122_kneeABPassSht2Gnd m1 : 34|1@1+ (1,0) [0|0] "" GTW
 SG_ RCM2_a123_kneeABPassSht2Bat m1 : 35|1@1+ (1,0) [0|0] "" GTW
 SG_ RCM2_a124_kneeABPassOpen m1 : 36|1@1+ (1,0) [0|0] "" GTW
 SG_ RCM2_a125_kneeABPassShort m1 : 37|1@1+ (1,0) [0|0] "" GTW
 SG_ RCM2_a126_kneeABPassCrssCoup m1 : 38|1@1+ (1,0) [0|0] "" GTW
 SG_ RCM2_a127_kneeABPassConfig m1 : 39|1@1+ (1,0) [0|0] "" GTW
 SG_ RCM2_a128_sideAB1stRowLSht2Gnd m1 : 40|1@1+ (1,0) [0|0] "" GTW
 SG_ RCM2_a129_sideAB1stRowLSht2Bat m1 : 41|1@1+ (1,0) [0|0] "" GTW
 SG_ RCM2_a130_sideAB1stRowLOpen m1 : 42|1@1+ (1,0) [0|0] "" GTW
 SG_ RCM2_a131_sideAB1stRowLShort m1 : 43|1@1+ (1,0) [0|0] "" GTW
 SG_ RCM2_a132_sideAB1stRowLCrssCoup m1 : 44|1@1+ (1,0) [0|0] "" GTW
 SG_ RCM2_a133_sideAB1stRowLConfig m1 : 45|1@1+ (1,0) [0|0] "" GTW
 SG_ RCM2_a134_sideAB1stRowRSht2Gnd m1 : 46|1@1+ (1,0) [0|0] "" GTW
 SG_ RCM2_a135_sideAB1stRowRSht2Bat m1 : 47|1@1+ (1,0) [0|0] "" GTW
 SG_ RCM2_a136_sideAB1stRowROpen m1 : 48|1@1+ (1,0) [0|0] "" GTW
 SG_ RCM2_a137_sideAB1stRowRShort m1 : 49|1@1+ (1,0) [0|0] "" GTW
 SG_ RCM2_a138_sideAB1stRowRCrssCoup m1 : 50|1@1+ (1,0) [0|0] "" GTW
 SG_ RCM2_a139_sideAB1stRowRConfig m1 : 51|1@1+ (1,0) [0|0] "" GTW
 SG_ RCM2_a140_hvdPyroSht2Gnd m1 : 52|1@1+ (1,0) [0|0] "" GTW
 SG_ RCM2_a141_hvdPyroSht2Bat m1 : 53|1@1+ (1,0) [0|0] "" GTW
 SG_ RCM2_a142_hvdPyroOpen m1 : 54|1@1+ (1,0) [0|0] "" GTW
 SG_ RCM2_a143_hvdPyroShort m1 : 55|1@1+ (1,0) [0|0] "" GTW
 SG_ RCM2_a144_hvdPyroCrssCoup m1 : 56|1@1+ (1,0) [0|0] "" GTW
 SG_ RCM2_a145_hvdPyroConfig m1 : 57|1@1+ (1,0) [0|0] "" GTW
 SG_ RCM2_a146_curABLeftSht2Gnd m1 : 58|1@1+ (1,0) [0|0] "" GTW
 SG_ RCM2_a147_curABLeftSht2Bat m1 : 59|1@1+ (1,0) [0|0] "" GTW
 SG_ RCM2_a148_curABLeftOpen m1 : 60|1@1+ (1,0) [0|0] "" GTW
 SG_ RCM2_a149_curABLeftShort m1 : 61|1@1+ (1,0) [0|0] "" GTW
 SG_ RCM2_a150_curABLeftCrssCoup m1 : 62|1@1+ (1,0) [0|0] "" GTW
 SG_ RCM2_a151_curABLeftConfig m1 : 63|1@1+ (1,0) [0|0] "" GTW
 SG_ RCM2_a152_curABRightSht2Gnd m2 : 4|1@1+ (1,0) [0|0] "" GTW
 SG_ RCM2_a153_curABRightSht2Bat m2 : 5|1@1+ (1,0) [0|0] "" GTW
 SG_ RCM2_a154_curABRightOpen m2 : 6|1@1+ (1,0) [0|0] "" GTW
 SG_ RCM2_a155_curABRightShort m2 : 7|1@1+ (1,0) [0|0] "" GTW
 SG_ RCM2_a156_curABRightCrssCoup m2 : 8|1@1+ (1,0) [0|0] "" GTW
 SG_ RCM2_a157_curABRightConfig m2 : 9|1@1+ (1,0) [0|0] "" GTW
 SG_ RCM2_a158_preten2ndRowLSht2Gnd m2 : 10|1@1+ (1,0) [0|0] "" GTW
 SG_ RCM2_a159_preten2ndRowLSht2Bat m2 : 11|1@1+ (1,0) [0|0] "" GTW
 SG_ RCM2_a160_preten2ndRowLOpen m2 : 12|1@1+ (1,0) [0|0] "" GTW
 SG_ RCM2_a161_preten2ndRowLShort m2 : 13|1@1+ (1,0) [0|0] "" GTW
 SG_ RCM2_a162_preten2ndRowLCrssCoup m2 : 14|1@1+ (1,0) [0|0] "" GTW
 SG_ RCM2_a163_preten2ndRowLCgf m2 : 15|1@1+ (1,0) [0|0] "" GTW
 SG_ RCM2_a164_preten2ndRowRSht2Gnd m2 : 16|1@1+ (1,0) [0|0] "" GTW
 SG_ RCM2_a165_preten2ndRowRSht2Bat m2 : 17|1@1+ (1,0) [0|0] "" GTW
 SG_ RCM2_a166_preten2ndRowROpen m2 : 18|1@1+ (1,0) [0|0] "" GTW
 SG_ RCM2_a167_preten2ndRowRShort m2 : 19|1@1+ (1,0) [0|0] "" GTW
 SG_ RCM2_a168_preten2ndRowRCrssCoup m2 : 20|1@1+ (1,0) [0|0] "" GTW
 SG_ RCM2_a169_preten2ndRowRCgf m2 : 21|1@1+ (1,0) [0|0] "" GTW
 SG_ RCM2_a170_curAB2ndRowLSht2Gnd m2 : 22|1@1+ (1,0) [0|0] "" GTW
 SG_ RCM2_a171_curAB2ndRowLSht2Bat m2 : 23|1@1+ (1,0) [0|0] "" GTW
 SG_ RCM2_a172_curAB2ndRowLOpen m2 : 24|1@1+ (1,0) [0|0] "" GTW
 SG_ RCM2_a173_curAB2ndRowLShort m2 : 25|1@1+ (1,0) [0|0] "" GTW
 SG_ RCM2_a174_curAB2ndRowLCrssCoup m2 : 26|1@1+ (1,0) [0|0] "" GTW
 SG_ RCM2_a175_curAB2ndRowLConfig m2 : 27|1@1+ (1,0) [0|0] "" GTW
 SG_ RCM2_a176_curAB2ndRowRSht2Gnd m2 : 28|1@1+ (1,0) [0|0] "" GTW
 SG_ RCM2_a177_curAB2ndRowRSht2Bat m2 : 29|1@1+ (1,0) [0|0] "" GTW
 SG_ RCM2_a178_curAB2ndRowROpen m2 : 30|1@1+ (1,0) [0|0] "" GTW
 SG_ RCM2_a179_curAB2ndRowRShort m2 : 31|1@1+ (1,0) [0|0] "" GTW
 SG_ RCM2_a180_curAB2ndRowRCrssCoup m2 : 32|1@1+ (1,0) [0|0] "" GTW
 SG_ RCM2_a181_curAB2ndRowRConfig m2 : 33|1@1+ (1,0) [0|0] "" GTW
 SG_ RCM2_a182_hoodActuatorRSht2Gnd m2 : 34|1@1+ (1,0) [0|0] "" GTW
 SG_ RCM2_a183_hoodActuatorRSht2Bat m2 : 35|1@1+ (1,0) [0|0] "" GTW
 SG_ RCM2_a184_hoodActuatorROpen m2 : 36|1@1+ (1,0) [0|0] "" GTW
 SG_ RCM2_a185_hoodActuatorRShort m2 : 37|1@1+ (1,0) [0|0] "" GTW
 SG_ RCM2_a186_hoodActuatorRCrssCoup m2 : 38|1@1+ (1,0) [0|0] "" GTW
 SG_ RCM2_a187_hoodActuatorRConfig m2 : 39|1@1+ (1,0) [0|0] "" GTW
 SG_ RCM2_a188_hoodActuatorLSht2Gnd m2 : 40|1@1+ (1,0) [0|0] "" GTW
 SG_ RCM2_a189_hoodActuatorLSht2Bat m2 : 41|1@1+ (1,0) [0|0] "" GTW
 SG_ RCM2_a190_hoodActuatorLOpen m2 : 42|1@1+ (1,0) [0|0] "" GTW
 SG_ RCM2_a191_hoodActuatorLShort m2 : 43|1@1+ (1,0) [0|0] "" GTW
 SG_ RCM2_a192_hoodActuatorLCrssCoup m2 : 44|1@1+ (1,0) [0|0] "" GTW
 SG_ RCM2_a193_hoodActuatorLConfig m2 : 45|1@1+ (1,0) [0|0] "" GTW
 SG_ RCM2_a250_ens1Sht2Bat m2 : 46|1@1+ (1,0) [0|0] "" GTW
 SG_ RCM2_a251_ens1Sht2Gnd m2 : 47|1@1+ (1,0) [0|0] "" GTW
 SG_ RCM2_a252_ens1Config m2 : 48|1@1+ (1,0) [0|0] "" GTW
 SG_ RCM2_a253_ens2Sht2Bat m2 : 49|1@1+ (1,0) [0|0] "" GTW
 SG_ RCM2_a254_ens2Sht2Gnd m2 : 50|1@1+ (1,0) [0|0] "" GTW
 SG_ RCM2_a255_ens2Config m2 : 51|1@1+ (1,0) [0|0] "" GTW
 SG_ RCM2_a300_imuAccXHgMonChlPerm m2 : 52|1@1+ (1,0) [0|0] "" GTW
 SG_ RCM2_a301_imuAccXHgMonChlTemp m2 : 53|1@1+ (1,0) [0|0] "" GTW
 SG_ RCM2_a302_imuAccYHgMonChlPerm m2 : 54|1@1+ (1,0) [0|0] "" GTW
 SG_ RCM2_a303_imuAccYHgMonChlTemp m2 : 55|1@1+ (1,0) [0|0] "" GTW
 SG_ RCM2_a304_imuYawR8SnsrPermBG m2 : 56|1@1+ (1,0) [0|0] "" GTW
 SG_ RCM2_a305_imuYawR8SnsrPermInit m2 : 57|1@1+ (1,0) [0|0] "" GTW
 SG_ RCM2_a306_imuYawR8SnsrPermLF m2 : 58|1@1+ (1,0) [0|0] "" GTW
 SG_ RCM2_a307_imuYawR8ChnlMonTmpLF m2 : 59|1@1+ (1,0) [0|0] "" GTW
 SG_ RCM2_a308_imuPitchR8SnsrPermBG m2 : 60|1@1+ (1,0) [0|0] "" GTW
 SG_ RCM2_a309_imuPitchR8SnsrPermInit m2 : 61|1@1+ (1,0) [0|0] "" GTW
 SG_ RCM2_a310_imuPitchR8SnsrPermLF m2 : 62|1@1+ (1,0) [0|0] "" GTW
 SG_ RCM2_a311_imuPitchR8ChnlMonTmpLF m2 : 63|1@1+ (1,0) [0|0] "" GTW
 SG_ RCM2_a312_imuRollR8SnsrPermBG m3 : 4|1@1+ (1,0) [0|0] "" GTW
 SG_ RCM2_a313_imuRollR8SnsrPermInit m3 : 5|1@1+ (1,0) [0|0] "" GTW
 SG_ RCM2_a314_imuRollR8SnsrPermLF m3 : 6|1@1+ (1,0) [0|0] "" GTW
 SG_ RCM2_a315_imuRollR8ChnlMonTmpLF m3 : 7|1@1+ (1,0) [0|0] "" GTW
 SG_ RCM2_a316_imuAccXLgMonChlPerm m3 : 8|1@1+ (1,0) [0|0] "" GTW
 SG_ RCM2_a317_imuAccXLgMonChlTemp m3 : 9|1@1+ (1,0) [0|0] "" GTW
 SG_ RCM2_a318_imuAccYLgMonChlPerm m3 : 10|1@1+ (1,0) [0|0] "" GTW
 SG_ RCM2_a319_imuAccYLgMonChlTemp m3 : 11|1@1+ (1,0) [0|0] "" GTW
 SG_ RCM2_a320_imuAccZLgMonChlPerm m3 : 12|1@1+ (1,0) [0|0] "" GTW
 SG_ RCM2_a321_imuAccZLgMonChlTemp m3 : 13|1@1+ (1,0) [0|0] "" GTW
 SG_ RCM2_a322_imuCalibrationFailed m3 : 14|1@1+ (1,0) [0|0] "" GTW
 SG_ RCM2_a323_imuCalibrationNotDone m3 : 15|1@1+ (1,0) [0|0] "" GTW
 SG_ RCM2_a350_upFrntSnsrLSht2Gnd m3 : 16|1@1+ (1,0) [0|0] "" GTW
 SG_ RCM2_a351_upFrntSnsrLSht2Bat m3 : 17|1@1+ (1,0) [0|0] "" GTW
 SG_ RCM2_a352_upFrntSnsrLOpen m3 : 18|1@1+ (1,0) [0|0] "" GTW
 SG_ RCM2_a353_upFrntSnsrLCrssCoup m3 : 19|1@1+ (1,0) [0|0] "" GTW
 SG_ RCM2_a354_upFrntSnsrLCommErr m3 : 20|1@1+ (1,0) [0|0] "" GTW
 SG_ RCM2_a355_upFrntSnsrLInitTyp m3 : 21|1@1+ (1,0) [0|0] "" GTW
 SG_ RCM2_a356_upFrntSnsrLConfig m3 : 22|1@1+ (1,0) [0|0] "" GTW
 SG_ RCM2_a357_upFrntSnsrLDefect m3 : 23|1@1+ (1,0) [0|0] "" GTW
 SG_ RCM2_a358_upFrntSnsrLSigMon m3 : 24|1@1+ (1,0) [0|0] "" GTW
 SG_ RCM2_a360_upFrntSnsrRSht2Gnd m3 : 25|1@1+ (1,0) [0|0] "" GTW
 SG_ RCM2_a361_upFrntSnsrRSht2Bat m3 : 26|1@1+ (1,0) [0|0] "" GTW
 SG_ RCM2_a362_upFrntSnsrROpen m3 : 27|1@1+ (1,0) [0|0] "" GTW
 SG_ RCM2_a363_upFrntSnsrRCrssCoup m3 : 28|1@1+ (1,0) [0|0] "" GTW
 SG_ RCM2_a364_upFrntSnsrRCommErr m3 : 29|1@1+ (1,0) [0|0] "" GTW
 SG_ RCM2_a365_upFrntSnsrRInitTyp m3 : 30|1@1+ (1,0) [0|0] "" GTW
 SG_ RCM2_a366_upFrntSnsrRConfig m3 : 31|1@1+ (1,0) [0|0] "" GTW
 SG_ RCM2_a367_upFrntSnsrRDefect m3 : 32|1@1+ (1,0) [0|0] "" GTW
 SG_ RCM2_a368_upFrntSnsrRSigMon m3 : 33|1@1+ (1,0) [0|0] "" GTW
 SG_ RCM2_a370_upFrntSnsrMidLSht2Gnd m3 : 34|1@1+ (1,0) [0|0] "" GTW
 SG_ RCM2_a371_upFrntSnsrMidLSht2Bat m3 : 35|1@1+ (1,0) [0|0] "" GTW
 SG_ RCM2_a372_upFrntSnsrMidLOpen m3 : 36|1@1+ (1,0) [0|0] "" GTW
 SG_ RCM2_a373_upFrntSnsrMidLCrssCoup m3 : 37|1@1+ (1,0) [0|0] "" GTW
 SG_ RCM2_a374_upFrntSnsrMidLCommErr m3 : 38|1@1+ (1,0) [0|0] "" GTW
 SG_ RCM2_a375_upFrntSnsrMidLInitTyp m3 : 39|1@1+ (1,0) [0|0] "" GTW
 SG_ RCM2_a376_upFrntSnsrMidLConfig m3 : 40|1@1+ (1,0) [0|0] "" GTW
 SG_ RCM2_a377_upFrntSnsrMidLDefect m3 : 41|1@1+ (1,0) [0|0] "" GTW
 SG_ RCM2_a378_upFrntSnsrMidLSigMon m3 : 42|1@1+ (1,0) [0|0] "" GTW
 SG_ RCM2_a380_upFrntSnsrMidRSht2Gnd m3 : 43|1@1+ (1,0) [0|0] "" GTW
 SG_ RCM2_a381_upFrntSnsrMidRSht2Bat m3 : 44|1@1+ (1,0) [0|0] "" GTW
 SG_ RCM2_a382_upFrntSnsrMidROpen m3 : 45|1@1+ (1,0) [0|0] "" GTW
 SG_ RCM2_a383_upFrntSnsrMidRCrssCoup m3 : 46|1@1+ (1,0) [0|0] "" GTW
 SG_ RCM2_a384_upFrntSnsrMidRCommErr m3 : 47|1@1+ (1,0) [0|0] "" GTW
 SG_ RCM2_a385_upFrntSnsrMidRInitTyp m3 : 48|1@1+ (1,0) [0|0] "" GTW
 SG_ RCM2_a386_upFrntSnsrMidRConfig m3 : 49|1@1+ (1,0) [0|0] "" GTW
 SG_ RCM2_a387_upFrntSnsrMidRDefect m3 : 50|1@1+ (1,0) [0|0] "" GTW
 SG_ RCM2_a388_upFrntSnsrMidRSigMon m3 : 51|1@1+ (1,0) [0|0] "" GTW
 SG_ RCM2_a390_sideAccelBPilLSht2Gnd m3 : 52|1@1+ (1,0) [0|0] "" GTW
 SG_ RCM2_a391_sideAccelBPilLSht2Bat m3 : 53|1@1+ (1,0) [0|0] "" GTW
 SG_ RCM2_a392_sideAccelBPilLOpen m3 : 54|1@1+ (1,0) [0|0] "" GTW
 SG_ RCM2_a393_sideAccelBPilLCLosCoup m3 : 55|1@1+ (1,0) [0|0] "" GTW
 SG_ RCM2_a394_sideAccelBPilLCommErr m3 : 56|1@1+ (1,0) [0|0] "" GTW
 SG_ RCM2_a395_sideAccelBPilLInitTyp m3 : 57|1@1+ (1,0) [0|0] "" GTW
 SG_ RCM2_a396_sideAccelBPilLConfig m3 : 58|1@1+ (1,0) [0|0] "" GTW
 SG_ RCM2_a397_sideAccelBPilLDefect m3 : 59|1@1+ (1,0) [0|0] "" GTW
 SG_ RCM2_a398_sideAccelBPilLSigMon m3 : 60|1@1+ (1,0) [0|0] "" GTW
 SG_ RCM2_a400_sideAccelBPilRSht2Gnd m3 : 61|1@1+ (1,0) [0|0] "" GTW
 SG_ RCM2_a401_sideAccelBPilRSht2Bat m3 : 62|1@1+ (1,0) [0|0] "" GTW
 SG_ RCM2_a402_sideAccelBPilROpen m3 : 63|1@1+ (1,0) [0|0] "" GTW
 SG_ RCM2_a403_sideAccelBPilRCrssCoup m4 : 4|1@1+ (1,0) [0|0] "" GTW
 SG_ RCM2_a404_sideAccelBPilRCommErr m4 : 5|1@1+ (1,0) [0|0] "" GTW
 SG_ RCM2_a405_sideAccelBPilRInitTyp m4 : 6|1@1+ (1,0) [0|0] "" GTW
 SG_ RCM2_a406_sideAccelBPilRConfig m4 : 7|1@1+ (1,0) [0|0] "" GTW
 SG_ RCM2_a407_sideAccelBPilRDefect m4 : 8|1@1+ (1,0) [0|0] "" GTW
 SG_ RCM2_a408_sideAccelBPilRSigMon m4 : 9|1@1+ (1,0) [0|0] "" GTW
 SG_ RCM2_a410_sideAccelCPilLSht2Gnd m4 : 10|1@1+ (1,0) [0|0] "" GTW
 SG_ RCM2_a411_sideAccelCPilLSht2Bat m4 : 11|1@1+ (1,0) [0|0] "" GTW
 SG_ RCM2_a412_sideAccelCPilLOpen m4 : 12|1@1+ (1,0) [0|0] "" GTW
 SG_ RCM2_a413_sideAccelCPilLCrssCoup m4 : 13|1@1+ (1,0) [0|0] "" GTW
 SG_ RCM2_a414_sideAccelCPilLCommErr m4 : 14|1@1+ (1,0) [0|0] "" GTW
 SG_ RCM2_a415_sideAccelCPilLInitTyp m4 : 15|1@1+ (1,0) [0|0] "" GTW
 SG_ RCM2_a416_sideAccelCPilLConfig m4 : 16|1@1+ (1,0) [0|0] "" GTW
 SG_ RCM2_a417_sideAccelCPilLDefect m4 : 17|1@1+ (1,0) [0|0] "" GTW
 SG_ RCM2_a418_sideAccelCPilLSigMon m4 : 18|1@1+ (1,0) [0|0] "" GTW
 SG_ RCM2_a420_sideAccelCPilRSht2Gnd m4 : 19|1@1+ (1,0) [0|0] "" GTW
 SG_ RCM2_a421_sideAccelCPilRSht2Bat m4 : 20|1@1+ (1,0) [0|0] "" GTW
 SG_ RCM2_a422_sideAccelCPilROpen m4 : 21|1@1+ (1,0) [0|0] "" GTW
 SG_ RCM2_a423_sideAccelCPilRCrssCoup m4 : 22|1@1+ (1,0) [0|0] "" GTW
 SG_ RCM2_a424_sideAccelCPilRCommErr m4 : 23|1@1+ (1,0) [0|0] "" GTW
 SG_ RCM2_a425_sideAccelCPilRInitTyp m4 : 24|1@1+ (1,0) [0|0] "" GTW
 SG_ RCM2_a426_sideAccelCPilRConfig m4 : 25|1@1+ (1,0) [0|0] "" GTW
 SG_ RCM2_a427_sideAccelCPilRDefect m4 : 26|1@1+ (1,0) [0|0] "" GTW
 SG_ RCM2_a428_sideAccelCPilRSigMon m4 : 27|1@1+ (1,0) [0|0] "" GTW
 SG_ RCM2_a430_presFrntLDoorSht2Gnd m4 : 28|1@1+ (1,0) [0|0] "" GTW
 SG_ RCM2_a431_presFrntLDoorSht2Bat m4 : 29|1@1+ (1,0) [0|0] "" GTW
 SG_ RCM2_a432_presFrntLDoorOpen m4 : 30|1@1+ (1,0) [0|0] "" GTW
 SG_ RCM2_a433_presFrntLDoorCrssCoup m4 : 31|1@1+ (1,0) [0|0] "" GTW
 SG_ RCM2_a434_presFrntLDoorCommErr m4 : 32|1@1+ (1,0) [0|0] "" GTW
 SG_ RCM2_a435_presFrntLDoorInitTyp m4 : 33|1@1+ (1,0) [0|0] "" GTW
 SG_ RCM2_a436_presFrntLDoorConfig m4 : 34|1@1+ (1,0) [0|0] "" GTW
 SG_ RCM2_a437_presFrntLDoorDefect m4 : 35|1@1+ (1,0) [0|0] "" GTW
 SG_ RCM2_a438_presFrntLDoorSigMon m4 : 36|1@1+ (1,0) [0|0] "" GTW
 SG_ RCM2_a439_presDoorAbsolute1 m4 : 37|1@1+ (1,0) [0|0] "" GTW
 SG_ RCM2_a440_presFrntRDoorSht2Gnd m4 : 38|1@1+ (1,0) [0|0] "" GTW
 SG_ RCM2_a441_presFrntRDoorSht2Bat m4 : 39|1@1+ (1,0) [0|0] "" GTW
 SG_ RCM2_a442_presFrntRDoorOpen m4 : 40|1@1+ (1,0) [0|0] "" GTW
 SG_ RCM2_a443_presFrntRDoorCrssCoup m4 : 41|1@1+ (1,0) [0|0] "" GTW
 SG_ RCM2_a444_presFrntRDoorCommErr m4 : 42|1@1+ (1,0) [0|0] "" GTW
 SG_ RCM2_a445_presFrntRDoorInitTyp m4 : 43|1@1+ (1,0) [0|0] "" GTW
 SG_ RCM2_a446_presFrntRDoorConfig m4 : 44|1@1+ (1,0) [0|0] "" GTW
 SG_ RCM2_a447_presFrntRDoorDefect m4 : 45|1@1+ (1,0) [0|0] "" GTW
 SG_ RCM2_a448_presFrntRDoorSigMon m4 : 46|1@1+ (1,0) [0|0] "" GTW
 SG_ RCM2_a449_presDoorAbsolute2 m4 : 47|1@1+ (1,0) [0|0] "" GTW
 SG_ RCM2_a450_presPedProLSht2Gnd m4 : 48|1@1+ (1,0) [0|0] "" GTW
 SG_ RCM2_a451_presPedProLSht2Bat m4 : 49|1@1+ (1,0) [0|0] "" GTW
 SG_ RCM2_a452_presPedProLOpen m4 : 50|1@1+ (1,0) [0|0] "" GTW
 SG_ RCM2_a453_presPedProLCrssCoup m4 : 51|1@1+ (1,0) [0|0] "" GTW
 SG_ RCM2_a454_presPedProLCommErr m4 : 52|1@1+ (1,0) [0|0] "" GTW
 SG_ RCM2_a455_presPedProLInitTyp m4 : 53|1@1+ (1,0) [0|0] "" GTW
 SG_ RCM2_a456_presPedProLConfig m4 : 54|1@1+ (1,0) [0|0] "" GTW
 SG_ RCM2_a457_presPedProLDefect m4 : 55|1@1+ (1,0) [0|0] "" GTW
 SG_ RCM2_a458_presPedProLSigMon m4 : 56|1@1+ (1,0) [0|0] "" GTW
 SG_ RCM2_a460_presPedProRSht2Gnd m4 : 57|1@1+ (1,0) [0|0] "" GTW
 SG_ RCM2_a461_presPedProRSht2Bat m4 : 58|1@1+ (1,0) [0|0] "" GTW
 SG_ RCM2_a462_presPedProROpen m4 : 59|1@1+ (1,0) [0|0] "" GTW
 SG_ RCM2_a463_presPedProRCrssCoup m4 : 60|1@1+ (1,0) [0|0] "" GTW
 SG_ RCM2_a464_presPedProRCommErr m4 : 61|1@1+ (1,0) [0|0] "" GTW
 SG_ RCM2_a465_presPedProRInitTyp m4 : 62|1@1+ (1,0) [0|0] "" GTW
 SG_ RCM2_a466_presPedProRConfig m4 : 63|1@1+ (1,0) [0|0] "" GTW
 SG_ RCM2_a467_presPedProRDefect m5 : 4|1@1+ (1,0) [0|0] "" GTW
 SG_ RCM2_a468_presPedProRSigMon m5 : 5|1@1+ (1,0) [0|0] "" GTW
 SG_ RCM2_a469_presPedProAbsolute m5 : 6|1@1+ (1,0) [0|0] "" GTW
 SG_ RCM2_a470_upFrntPedProLSht2Gnd m5 : 7|1@1+ (1,0) [0|0] "" GTW
 SG_ RCM2_a471_upFrntPedProLSht2Bat m5 : 8|1@1+ (1,0) [0|0] "" GTW
 SG_ RCM2_a472_upFrntPedProLOpen m5 : 9|1@1+ (1,0) [0|0] "" GTW
 SG_ RCM2_a473_upFrntPedProLCrssCoup m5 : 10|1@1+ (1,0) [0|0] "" GTW
 SG_ RCM2_a474_upFrntPedProLCommErr m5 : 11|1@1+ (1,0) [0|0] "" GTW
 SG_ RCM2_a475_upFrntPedProLIntTyp m5 : 12|1@1+ (1,0) [0|0] "" GTW
 SG_ RCM2_a476_upFrntPedProLConfig m5 : 13|1@1+ (1,0) [0|0] "" GTW
 SG_ RCM2_a477_upFrntPedProLDefect m5 : 14|1@1+ (1,0) [0|0] "" GTW
 SG_ RCM2_a478_upFrntPedProSht2Gnd m5 : 15|1@1+ (1,0) [0|0] "" GTW
 SG_ RCM2_a480_upFrntPedProRSht2Gnd m5 : 16|1@1+ (1,0) [0|0] "" GTW
 SG_ RCM2_a481_upFrntPedProRSht2Bat m5 : 17|1@1+ (1,0) [0|0] "" GTW
 SG_ RCM2_a482_upFrntPedProROpen m5 : 18|1@1+ (1,0) [0|0] "" GTW
 SG_ RCM2_a483_upFrntPedProRCrssCoup m5 : 19|1@1+ (1,0) [0|0] "" GTW
 SG_ RCM2_a484_upFrntPedProRCommErr m5 : 20|1@1+ (1,0) [0|0] "" GTW
 SG_ RCM2_a485_upFrntPedProRIntTyp m5 : 21|1@1+ (1,0) [0|0] "" GTW
 SG_ RCM2_a486_upFrntPedProRConfig m5 : 22|1@1+ (1,0) [0|0] "" GTW
 SG_ RCM2_a487_upFrntPedProRDefect m5 : 23|1@1+ (1,0) [0|0] "" GTW
 SG_ RCM2_a488_upFrntPedProSht2Gnd m5 : 24|1@1+ (1,0) [0|0] "" GTW
 SG_ RCM2_a550_bucklHallLeftSht2Gnd m5 : 25|1@1+ (1,0) [0|0] "" GTW
 SG_ RCM2_a551_bucklHallLeftSht2Bat m5 : 26|1@1+ (1,0) [0|0] "" GTW
 SG_ RCM2_a552_bucklHallLeftOpen m5 : 27|1@1+ (1,0) [0|0] "" GTW
 SG_ RCM2_a553_bucklHallLeftUndef m5 : 28|1@1+ (1,0) [0|0] "" GTW
 SG_ RCM2_a554_bucklHallLeftCrssCoup m5 : 29|1@1+ (1,0) [0|0] "" GTW
 SG_ RCM2_a555_bucklHallLeftConfig m5 : 30|1@1+ (1,0) [0|0] "" GTW
 SG_ RCM2_a556_bucklHallRightSht2Gnd m5 : 31|1@1+ (1,0) [0|0] "" GTW
 SG_ RCM2_a557_bucklHallRightSht2Bat m5 : 32|1@1+ (1,0) [0|0] "" GTW
 SG_ RCM2_a558_bucklHallRightOpen m5 : 33|1@1+ (1,0) [0|0] "" GTW
 SG_ RCM2_a559_bucklHallRightUndef m5 : 34|1@1+ (1,0) [0|0] "" GTW
 SG_ RCM2_a560_bucklHallRightCrssCoup m5 : 35|1@1+ (1,0) [0|0] "" GTW
 SG_ RCM2_a561_bucklHallRightConfig m5 : 36|1@1+ (1,0) [0|0] "" GTW
 SG_ RCM2_a562_seaTrkPosLeftSht2Gnd m5 : 37|1@1+ (1,0) [0|0] "" GTW
 SG_ RCM2_a563_seaTrkPosLeftShtBat m5 : 38|1@1+ (1,0) [0|0] "" GTW
 SG_ RCM2_a564_seaTrkPosLeftOpen m5 : 39|1@1+ (1,0) [0|0] "" GTW
 SG_ RCM2_a565_seaTrkPosLeftUndefined m5 : 40|1@1+ (1,0) [0|0] "" GTW
 SG_ RCM2_a566_seaTrkPosLeftCrssCoup m5 : 41|1@1+ (1,0) [0|0] "" GTW

CM_ SG_ 1009 RCM2_a000_crashDetected "Deployment Collision Event Detected";
CM_ SG_ 1009 RCM2_a001_nearDeploy "Non-Deployment Collision Event Detected";
CM_ SG_ 1009 RCM2_a002_airbagsUnArmed "Deployment is Disabled";
CM_ SG_ 1009 RCM2_a003_warningIndicator "Airbag System Fault";
CM_ SG_ 1009 RCM2_a004_crashAlgoWakeup "RCM Crash algorithm enabled";
CM_ SG_ 1009 RCM2_a005_abuseImmunityThrshold "RCM's abuse Immunity Threshold Crossed";
CM_ SG_ 1009 RCM2_a006_supplierDiagEnabled "Supplier Diagnostics enabled";
CM_ SG_ 1009 RCM2_a007_pedProCrashDetected "Pedestrian Collision Event Detected";
CM_ SG_ 1009 RCM2_a008_factoryMode "DTC value: 0xE10000";
CM_ SG_ 1009 RCM2_a009_edrDataAreaLocked "DTC value: 0x919368";
CM_ SG_ 1009 RCM2_a010_pedProEDRDataLocked "DTC value: 0x919369";
CM_ SG_ 1009 RCM2_a011_FrntAlgoDisabled "DTC value: 0xF00006";
CM_ SG_ 1009 RCM2_a012_RollAlgoDisabled "DTC value: 0xF00006";
CM_ SG_ 1009 RCM2_a013_SideAlgoDisabled "DTC value: 0xF00006";
CM_ SG_ 1009 RCM2_a014_pedProNearDeploy "Non-Deployment Pedestrian Collision Event Detected";
CM_ SG_ 1009 RCM2_a047_batteryESRhigh "DTC value: 0xF0081B";
CM_ SG_ 1009 RCM2_a048_batteryVoltageTooHigh "DTC value: 0xF00317";
CM_ SG_ 1009 RCM2_a049_batteryVoltageTooLow "DTC value: 0xF00316";
CM_ SG_ 1009 RCM2_a050_driverABStg1Sht2Gnd "DTC value: 0x800111";
CM_ SG_ 1009 RCM2_a051_driverABStg1Sht2Bat "DTC value: 0x800112";
CM_ SG_ 1009 RCM2_a052_driverABStg1Open "DTC value: 0x800113";
CM_ SG_ 1009 RCM2_a053_driverABStg1Short "DTC value: 0x80011A";
CM_ SG_ 1009 RCM2_a054_driverABStg1CrssCoup "DTC value: 0x80012B";
CM_ SG_ 1009 RCM2_a055_driverABStg1Config "DTC value: 0x800156";
CM_ SG_ 1009 RCM2_a056_driverABStg2Sht2Gnd "DTC value: 0x800211";
CM_ SG_ 1009 RCM2_a057_driverABStg2Sht2Bat "DTC value: 0x800212";
CM_ SG_ 1009 RCM2_a058_driverABStg2Open "DTC value: 0x800213";
CM_ SG_ 1009 RCM2_a059_driverABStg2Short "DTC value: 0x80021A";
CM_ SG_ 1009 RCM2_a060_driverABStg2CrssCoup "DTC value: 0x80022B";
CM_ SG_ 1009 RCM2_a061_driverABStg2Config "DTC value: 0x800256";
CM_ SG_ 1009 RCM2_a062_passABStg1Sht2Gnd "DTC value: 0x801011";
CM_ SG_ 1009 RCM2_a063_passABStg1Sht2Bat "DTC value: 0x801012";
CM_ SG_ 1009 RCM2_a064_passABStg1Open "DTC value: 0x801013";
CM_ SG_ 1009 RCM2_a065_passABStg1Short "DTC value: 0x80101A";
CM_ SG_ 1009 RCM2_a066_passABStg1CrssCoup "DTC value: 0x80102B";
CM_ SG_ 1009 RCM2_a067_passABStg1Config "DTC value: 0x801056";
CM_ SG_ 1009 RCM2_a068_passABStg2Sht2Gnd "DTC value: 0x801111";
CM_ SG_ 1009 RCM2_a069_passABStg2Sht2Bat "DTC value: 0x801112";
CM_ SG_ 1009 RCM2_a070_passABStg2Open "DTC value: 0x801113";
CM_ SG_ 1009 RCM2_a071_passABStg2Short "DTC value: 0x80111A";
CM_ SG_ 1009 RCM2_a072_passABStg2CrssCoup "DTC value: 0x80112B";
CM_ SG_ 1009 RCM2_a073_passABStg2Config "DTC value: 0x801156";
CM_ SG_ 1009 RCM2_a074_passActiveVentSht2Gnd "DTC value: 0x91CF11";
CM_ SG_ 1009 RCM2_a075_passActiveVentSht2Bat "DTC value: 0x91CF12";
CM_ SG_ 1009 RCM2_a076_passActiveVentOpen "DTC value: 0x91CF13";
CM_ SG_ 1009 RCM2_a077_passActiveVentShort "DTC value: 0x91CF1A";
CM_ SG_ 1009 RCM2_a078_passActiveVentCrssCoup "DTC value: 0x91CF2B";
CM_ SG_ 1009 RCM2_a079_passActiveVentConfig "DTC value: 0x91CF56";
CM_ SG_ 1009 RCM2_a080_pretenShldLeftSht2Gnd "DTC value: 0x921111";
CM_ SG_ 1009 RCM2_a081_pretenShldLeftSht2Bat "DTC value: 0x921112";
CM_ SG_ 1009 RCM2_a082_pretenShldLeftOpen "DTC value: 0x921113";
CM_ SG_ 1009 RCM2_a083_pretenShldLeftShort "DTC value: 0x92111A";
CM_ SG_ 1009 RCM2_a084_pretenShldLeftCrossC "DTC value: 0x92112B";
CM_ SG_ 1009 RCM2_a085_pretenShldLeftConfig "DTC value: 0x921156";
CM_ SG_ 1009 RCM2_a086_pretenShldRightSht2Gnd "DTC value: 0x921411";
CM_ SG_ 1009 RCM2_a087_pretenShldRightSht2Bat "DTC value: 0x921412";
CM_ SG_ 1009 RCM2_a088_pretenShldRightOpen "DTC value: 0x921413";
CM_ SG_ 1009 RCM2_a089_pretenShldRightShort "DTC value: 0x92141A";
CM_ SG_ 1009 RCM2_a090_pretenShldRightCrssCou "DTC value: 0x92142B";
CM_ SG_ 1009 RCM2_a091_pretenShldRightConfig "DTC value: 0x921456";
CM_ SG_ 1009 RCM2_a092_pretenLapLeftSht2Gnd "DTC value: 0x940811";
CM_ SG_ 1009 RCM2_a093_pretenLapLeftSht2Bat "DTC value: 0x940812";
CM_ SG_ 1009 RCM2_a094_pretenLapLeftOpen "DTC value: 0x940813";
CM_ SG_ 1009 RCM2_a095_pretenLapLeftShort "DTC value: 0x94081A";
CM_ SG_ 1009 RCM2_a096_pretenLapLeftCrssCoup "DTC value: 0x94082B";
CM_ SG_ 1009 RCM2_a097_pretenLapLeftConfig "DTC value: 0x940856";
CM_ SG_ 1009 RCM2_a098_pretenLapRightSht2Gnd "DTC value: 0x940911";
CM_ SG_ 1009 RCM2_a099_pretenLapRightSht2Bat "DTC value: 0x940912";
CM_ SG_ 1009 RCM2_a100_pretenLapRightOpen "DTC value: 0x940913";
CM_ SG_ 1009 RCM2_a101_pretenLapRightShort "DTC value: 0x94091A";
CM_ SG_ 1009 RCM2_a102_pretenLapRightCrssCoup "DTC value: 0x94092B";
CM_ SG_ 1009 RCM2_a103_pretenLapRightConfig "DTC value: 0x940956";
CM_ SG_ 1009 RCM2_a104_loadLimLeftSht2Gnd "DTC value: 0x808011";
CM_ SG_ 1009 RCM2_a105_loadLimLeftSht2Bat "DTC value: 0x808012";
CM_ SG_ 1009 RCM2_a106_loadLimLeftOpen "DTC value: 0x808013";
CM_ SG_ 1009 RCM2_a107_loadLimLeftShort "DTC value: 0x80801A";
CM_ SG_ 1009 RCM2_a108_loadLimLeftCrssCoup "DTC value: 0x80802B";
CM_ SG_ 1009 RCM2_a109_loadLimLeftConfig "DTC value: 0x808056";
CM_ SG_ 1009 RCM2_a110_loadLimRightSht2Gnd "DTC value: 0x808211";
CM_ SG_ 1009 RCM2_a111_loadLimRightSht2Bat "DTC value: 0x808212";
CM_ SG_ 1009 RCM2_a112_loadLimRightOpen "DTC value: 0x808213";
CM_ SG_ 1009 RCM2_a113_loadLimRightShort "DTC value: 0x80821A";
CM_ SG_ 1009 RCM2_a114_loadLimRightCrssCoup "DTC value: 0x80822B";
CM_ SG_ 1009 RCM2_a115_loadLimRightConfig "DTC value: 0x808256";
CM_ SG_ 1009 RCM2_a116_kneeABDrvrSht2Gnd "DTC value: 0x800411";
CM_ SG_ 1009 RCM2_a117_kneeABDrvrSht2Bat "DTC value: 0x800412";
CM_ SG_ 1009 RCM2_a118_kneeABDrvrOpen "DTC value: 0x800413";
CM_ SG_ 1009 RCM2_a119_kneeABDrvrShort "DTC value: 0x80041A";
CM_ SG_ 1009 RCM2_a120_kneeABDrvrCrssCoup "DTC value: 0x80042B";
CM_ SG_ 1009 RCM2_a121_kneeABDrvrConfig "DTC value: 0x800456";
CM_ SG_ 1009 RCM2_a122_kneeABPassSht2Gnd "DTC value: 0x91CD11";
CM_ SG_ 1009 RCM2_a123_kneeABPassSht2Bat "DTC value: 0x91CD12";
CM_ SG_ 1009 RCM2_a124_kneeABPassOpen "DTC value: 0x91CD13";
CM_ SG_ 1009 RCM2_a125_kneeABPassShort "DTC value: 0x91CD1A";
CM_ SG_ 1009 RCM2_a126_kneeABPassCrssCoup "DTC value: 0x91CD2B";
CM_ SG_ 1009 RCM2_a127_kneeABPassConfig "DTC value: 0x91CD56";
CM_ SG_ 1009 RCM2_a128_sideAB1stRowLSht2Gnd "DTC value: 0x802011";
CM_ SG_ 1009 RCM2_a129_sideAB1stRowLSht2Bat "DTC value: 0x802012";
CM_ SG_ 1009 RCM2_a130_sideAB1stRowLOpen "DTC value: 0x802013";
CM_ SG_ 1009 RCM2_a131_sideAB1stRowLShort "DTC value: 0x80201A";
CM_ SG_ 1009 RCM2_a132_sideAB1stRowLCrssCoup "DTC value: 0x80202B";
CM_ SG_ 1009 RCM2_a133_sideAB1stRowLConfig "DTC value: 0x802056";
CM_ SG_ 1009 RCM2_a134_sideAB1stRowRSht2Gnd "DTC value: 0x802811";
CM_ SG_ 1009 RCM2_a135_sideAB1stRowRSht2Bat "DTC value: 0x802812";
CM_ SG_ 1009 RCM2_a136_sideAB1stRowROpen "DTC value: 0x802813";
CM_ SG_ 1009 RCM2_a137_sideAB1stRowRShort "DTC value: 0x80281A";
CM_ SG_ 1009 RCM2_a138_sideAB1stRowRCrssCoup "DTC value: 0x80282B";
CM_ SG_ 1009 RCM2_a139_sideAB1stRowRConfig "DTC value: 0x802856";
CM_ SG_ 1009 RCM2_a140_hvdPyroSht2Gnd "DTC value: 0x800511";
CM_ SG_ 1009 RCM2_a141_hvdPyroSht2Bat "DTC value: 0x800512";
CM_ SG_ 1009 RCM2_a142_hvdPyroOpen "DTC value: 0x800513";
CM_ SG_ 1009 RCM2_a143_hvdPyroShort "DTC value: 0x80051A";
CM_ SG_ 1009 RCM2_a144_hvdPyroCrssCoup "DTC value: 0x80052B";
CM_ SG_ 1009 RCM2_a145_hvdPyroConfig "DTC value: 0x800556";
CM_ SG_ 1009 RCM2_a146_curABLeftSht2Gnd "DTC value: 0x802111";
CM_ SG_ 1009 RCM2_a147_curABLeftSht2Bat "DTC value: 0x802112";
CM_ SG_ 1009 RCM2_a148_curABLeftOpen "DTC value: 0x802113";
CM_ SG_ 1009 RCM2_a149_curABLeftShort "DTC value: 0x80211A";
CM_ SG_ 1009 RCM2_a150_curABLeftCrssCoup "DTC value: 0x80212B";
CM_ SG_ 1009 RCM2_a151_curABLeftConfig "DTC value: 0x802156";
CM_ SG_ 1009 RCM2_a152_curABRightSht2Gnd "DTC value: 0x802911";
CM_ SG_ 1009 RCM2_a153_curABRightSht2Bat "DTC value: 0x802912";
CM_ SG_ 1009 RCM2_a154_curABRightOpen "DTC value: 0x802913";
CM_ SG_ 1009 RCM2_a155_curABRightShort "DTC value: 0x80291A";
CM_ SG_ 1009 RCM2_a156_curABRightCrssCoup "DTC value: 0x80292B";
CM_ SG_ 1009 RCM2_a157_curABRightConfig "DTC value: 0x802956";
CM_ SG_ 1009 RCM2_a158_preten2ndRowLSht2Gnd "DTC value: 0x807311";
CM_ SG_ 1009 RCM2_a159_preten2ndRowLSht2Bat "DTC value: 0x807312";
CM_ SG_ 1009 RCM2_a160_preten2ndRowLOpen "DTC value: 0x807313";
CM_ SG_ 1009 RCM2_a161_preten2ndRowLShort "DTC value: 0x80731A";
CM_ SG_ 1009 RCM2_a162_preten2ndRowLCrssCoup "DTC value: 0x80732B";
CM_ SG_ 1009 RCM2_a163_preten2ndRowLCgf "DTC value: 0x807356";
CM_ SG_ 1009 RCM2_a164_preten2ndRowRSht2Gnd "DTC value: 0x807511";
CM_ SG_ 1009 RCM2_a165_preten2ndRowRSht2Bat "DTC value: 0x807512";
CM_ SG_ 1009 RCM2_a166_preten2ndRowROpen "DTC value: 0x807513";
CM_ SG_ 1009 RCM2_a167_preten2ndRowRShort "DTC value: 0x80751A";
CM_ SG_ 1009 RCM2_a168_preten2ndRowRCrssCoup "DTC value: 0x80752B";
CM_ SG_ 1009 RCM2_a169_preten2ndRowRCgf "DTC value: 0x807556";
CM_ SG_ 1009 RCM2_a170_curAB2ndRowLSht2Gnd "DTC value: 0x807611";
CM_ SG_ 1009 RCM2_a171_curAB2ndRowLSht2Bat "DTC value: 0x807612";
CM_ SG_ 1009 RCM2_a172_curAB2ndRowLOpen "DTC value: 0x807613";
CM_ SG_ 1009 RCM2_a173_curAB2ndRowLShort "DTC value: 0x80761A";
CM_ SG_ 1009 RCM2_a174_curAB2ndRowLCrssCoup "DTC value: 0x80762B";
CM_ SG_ 1009 RCM2_a175_curAB2ndRowLConfig "DTC value: 0x807656";
CM_ SG_ 1009 RCM2_a176_curAB2ndRowRSht2Gnd "DTC value: 0x807811";
CM_ SG_ 1009 RCM2_a177_curAB2ndRowRSht2Bat "DTC value: 0x807812";
CM_ SG_ 1009 RCM2_a178_curAB2ndRowROpen "DTC value: 0x807813";
CM_ SG_ 1009 RCM2_a179_curAB2ndRowRShort "DTC value: 0x80781A";
CM_ SG_ 1009 RCM2_a180_curAB2ndRowRCrssCoup "DTC value: 0x80782B";
CM_ SG_ 1009 RCM2_a181_curAB2ndRowRConfig "DTC value: 0x807856";
CM_ SG_ 1009 RCM2_a182_hoodActuatorRSht2Gnd "DTC value: 0x900311";
CM_ SG_ 1009 RCM2_a183_hoodActuatorRSht2Bat "DTC value: 0x900312";
CM_ SG_ 1009 RCM2_a184_hoodActuatorROpen "DTC value: 0x900313";
CM_ SG_ 1009 RCM2_a185_hoodActuatorRShort "DTC value: 0x90031A";
CM_ SG_ 1009 RCM2_a186_hoodActuatorRCrssCoup "DTC value: 0x90032B";
CM_ SG_ 1009 RCM2_a187_hoodActuatorRConfig "DTC value: 0x900356";
CM_ SG_ 1009 RCM2_a188_hoodActuatorLSht2Gnd "DTC value: 0x900111";
CM_ SG_ 1009 RCM2_a189_hoodActuatorLSht2Bat "DTC value: 0x900112";
CM_ SG_ 1009 RCM2_a190_hoodActuatorLOpen "DTC value: 0x900113";
CM_ SG_ 1009 RCM2_a191_hoodActuatorLShort "DTC value: 0x90011A";
CM_ SG_ 1009 RCM2_a192_hoodActuatorLCrssCoup "DTC value: 0x90012B";
CM_ SG_ 1009 RCM2_a193_hoodActuatorLConfig "DTC value: 0x900156";
CM_ SG_ 1009 RCM2_a250_ens1Sht2Bat "DTC value: 0x91D812";
CM_ SG_ 1009 RCM2_a251_ens1Sht2Gnd "DTC value: 0x91D814";
CM_ SG_ 1009 RCM2_a252_ens1Config "DTC value: 0x91D816";
CM_ SG_ 1009 RCM2_a253_ens2Sht2Bat "DTC value: 0x91D912";
CM_ SG_ 1009 RCM2_a254_ens2Sht2Gnd "DTC value: 0x91D914";
CM_ SG_ 1009 RCM2_a255_ens2Config "DTC value: 0x91D916";
CM_ SG_ 1009 RCM2_a300_imuAccXHgMonChlPerm "DTC value: 0xE00849";
CM_ SG_ 1009 RCM2_a301_imuAccXHgMonChlTemp "DTC value: 0xE00864";
CM_ SG_ 1009 RCM2_a302_imuAccYHgMonChlPerm "DTC value: 0xE00849";
CM_ SG_ 1009 RCM2_a303_imuAccYHgMonChlTemp "DTC value: 0xE00864";
CM_ SG_ 1009 RCM2_a304_imuYawR8SnsrPermBG "DTC value: 0xE00849";
CM_ SG_ 1009 RCM2_a305_imuYawR8SnsrPermInit "DTC value: 0xE00849";
CM_ SG_ 1009 RCM2_a306_imuYawR8SnsrPermLF "DTC value: 0xE00849";
CM_ SG_ 1009 RCM2_a307_imuYawR8ChnlMonTmpLF "DTC value: 0xE00864";
CM_ SG_ 1009 RCM2_a308_imuPitchR8SnsrPermBG "DTC value: 0xE00849";
CM_ SG_ 1009 RCM2_a309_imuPitchR8SnsrPermInit "DTC value: 0xE00849";
CM_ SG_ 1009 RCM2_a310_imuPitchR8SnsrPermLF "DTC value: 0xE00849";
CM_ SG_ 1009 RCM2_a311_imuPitchR8ChnlMonTmpLF "DTC value: 0xE00864";
CM_ SG_ 1009 RCM2_a312_imuRollR8SnsrPermBG "DTC value: 0xE00849";
CM_ SG_ 1009 RCM2_a313_imuRollR8SnsrPermInit "DTC value: 0xE00849";
CM_ SG_ 1009 RCM2_a314_imuRollR8SnsrPermLF "DTC value: 0xE00849";
CM_ SG_ 1009 RCM2_a315_imuRollR8ChnlMonTmpLF "DTC value: 0xE00864";
CM_ SG_ 1009 RCM2_a316_imuAccXLgMonChlPerm "DTC value: 0xE00849";
CM_ SG_ 1009 RCM2_a317_imuAccXLgMonChlTemp "DTC value: 0xE00864";
CM_ SG_ 1009 RCM2_a318_imuAccYLgMonChlPerm "DTC value: 0xE00849";
CM_ SG_ 1009 RCM2_a319_imuAccYLgMonChlTemp "DTC value: 0xE00864";
CM_ SG_ 1009 RCM2_a320_imuAccZLgMonChlPerm "DTC value: 0xE00849";
CM_ SG_ 1009 RCM2_a321_imuAccZLgMonChlTemp "DTC value: 0xE00864";
CM_ SG_ 1009 RCM2_a322_imuCalibrationFailed "DTC value: 0xE00892";
CM_ SG_ 1009 RCM2_a323_imuCalibrationNotDone "DTC value: 0xE00854";
CM_ SG_ 1009 RCM2_a350_upFrntSnsrLSht2Gnd "DTC value: 0x809011";
CM_ SG_ 1009 RCM2_a351_upFrntSnsrLSht2Bat "DTC value: 0x809012";
CM_ SG_ 1009 RCM2_a352_upFrntSnsrLOpen "DTC value: 0x809013";
CM_ SG_ 1009 RCM2_a353_upFrntSnsrLCrssCoup "DTC value: 0x80902B";
CM_ SG_ 1009 RCM2_a354_upFrntSnsrLCommErr "DTC value: 0x809031";
CM_ SG_ 1009 RCM2_a355_upFrntSnsrLInitTyp "DTC value: 0x80904A";
CM_ SG_ 1009 RCM2_a356_upFrntSnsrLConfig "DTC value: 0x809056";
CM_ SG_ 1009 RCM2_a357_upFrntSnsrLDefect "DTC value: 0x809096";
CM_ SG_ 1009 RCM2_a358_upFrntSnsrLSigMon "DTC value: 0x809097";
CM_ SG_ 1009 RCM2_a360_upFrntSnsrRSht2Gnd "DTC value: 0x809511";
CM_ SG_ 1009 RCM2_a361_upFrntSnsrRSht2Bat "DTC value: 0x809512";
CM_ SG_ 1009 RCM2_a362_upFrntSnsrROpen "DTC value: 0x809513";
CM_ SG_ 1009 RCM2_a363_upFrntSnsrRCrssCoup "DTC value: 0x80952B";
CM_ SG_ 1009 RCM2_a364_upFrntSnsrRCommErr "DTC value: 0x809531";
CM_ SG_ 1009 RCM2_a365_upFrntSnsrRInitTyp "DTC value: 0x80954A";
CM_ SG_ 1009 RCM2_a366_upFrntSnsrRConfig "DTC value: 0x809556";
CM_ SG_ 1009 RCM2_a367_upFrntSnsrRDefect "DTC value: 0x809596";
CM_ SG_ 1009 RCM2_a368_upFrntSnsrRSigMon "DTC value: 0x809597";
CM_ SG_ 1009 RCM2_a370_upFrntSnsrMidLSht2Gnd "DTC value: 0x809311";
CM_ SG_ 1009 RCM2_a371_upFrntSnsrMidLSht2Bat "DTC value: 0x809312";
CM_ SG_ 1009 RCM2_a372_upFrntSnsrMidLOpen "DTC value: 0x809313";
CM_ SG_ 1009 RCM2_a373_upFrntSnsrMidLCrssCoup "DTC value: 0x80932B";
CM_ SG_ 1009 RCM2_a374_upFrntSnsrMidLCommErr "DTC value: 0x809331";
CM_ SG_ 1009 RCM2_a375_upFrntSnsrMidLInitTyp "DTC value: 0x80934A";
CM_ SG_ 1009 RCM2_a376_upFrntSnsrMidLConfig "DTC value: 0x809356";
CM_ SG_ 1009 RCM2_a377_upFrntSnsrMidLDefect "DTC value: 0x809396";
CM_ SG_ 1009 RCM2_a378_upFrntSnsrMidLSigMon "DTC value: 0x809397";
CM_ SG_ 1009 RCM2_a380_upFrntSnsrMidRSht2Gnd "DTC value: 0x809411";
CM_ SG_ 1009 RCM2_a381_upFrntSnsrMidRSht2Bat "DTC value: 0x809412";
CM_ SG_ 1009 RCM2_a382_upFrntSnsrMidROpen "DTC value: 0x809413";
CM_ SG_ 1009 RCM2_a383_upFrntSnsrMidRCrssCoup "DTC value: 0x80942B";
CM_ SG_ 1009 RCM2_a384_upFrntSnsrMidRCommErr "DTC value: 0x809431";
CM_ SG_ 1009 RCM2_a385_upFrntSnsrMidRInitTyp "DTC value: 0x80944A";
CM_ SG_ 1009 RCM2_a386_upFrntSnsrMidRConfig "DTC value: 0x809456";
CM_ SG_ 1009 RCM2_a387_upFrntSnsrMidRDefect "DTC value: 0x809496";
CM_ SG_ 1009 RCM2_a388_upFrntSnsrMidRSigMon "DTC value: 0x809497";
CM_ SG_ 1009 RCM2_a390_sideAccelBPilLSht2Gnd "DTC value: 0x809111";
CM_ SG_ 1009 RCM2_a391_sideAccelBPilLSht2Bat "DTC value: 0x809112";
CM_ SG_ 1009 RCM2_a392_sideAccelBPilLOpen "DTC value: 0x809113";
CM_ SG_ 1009 RCM2_a393_sideAccelBPilLCLosCoup "DTC value: 0x80912B";
CM_ SG_ 1009 RCM2_a394_sideAccelBPilLCommErr "DTC value: 0x809131";
CM_ SG_ 1009 RCM2_a395_sideAccelBPilLInitTyp "DTC value: 0x80914A";
CM_ SG_ 1009 RCM2_a396_sideAccelBPilLConfig "DTC value: 0x809156";
CM_ SG_ 1009 RCM2_a397_sideAccelBPilLDefect "DTC value: 0x809196";
CM_ SG_ 1009 RCM2_a398_sideAccelBPilLSigMon "DTC value: 0x809197";
CM_ SG_ 1009 RCM2_a400_sideAccelBPilRSht2Gnd "DTC value: 0x809611";
CM_ SG_ 1009 RCM2_a401_sideAccelBPilRSht2Bat "DTC value: 0x809612";
CM_ SG_ 1009 RCM2_a402_sideAccelBPilROpen "DTC value: 0x809613";
CM_ SG_ 1009 RCM2_a403_sideAccelBPilRCrssCoup "DTC value: 0x80962B";
CM_ SG_ 1009 RCM2_a404_sideAccelBPilRCommErr "DTC value: 0x809631";
CM_ SG_ 1009 RCM2_a405_sideAccelBPilRInitTyp "DTC value: 0x80964A";
CM_ SG_ 1009 RCM2_a406_sideAccelBPilRConfig "DTC value: 0x809656";
CM_ SG_ 1009 RCM2_a407_sideAccelBPilRDefect "DTC value: 0x809696";
CM_ SG_ 1009 RCM2_a408_sideAccelBPilRSigMon "DTC value: 0x809697";
CM_ SG_ 1009 RCM2_a410_sideAccelCPilLSht2Gnd "DTC value: 0x809211";
CM_ SG_ 1009 RCM2_a411_sideAccelCPilLSht2Bat "DTC value: 0x809212";
CM_ SG_ 1009 RCM2_a412_sideAccelCPilLOpen "DTC value: 0x809213";
CM_ SG_ 1009 RCM2_a413_sideAccelCPilLCrssCoup "DTC value: 0x80922B";
CM_ SG_ 1009 RCM2_a414_sideAccelCPilLCommErr "DTC value: 0x809231";
CM_ SG_ 1009 RCM2_a415_sideAccelCPilLInitTyp "DTC value: 0x80924A";
CM_ SG_ 1009 RCM2_a416_sideAccelCPilLConfig "DTC value: 0x809256";
CM_ SG_ 1009 RCM2_a417_sideAccelCPilLDefect "DTC value: 0x809296";
CM_ SG_ 1009 RCM2_a418_sideAccelCPilLSigMon "DTC value: 0x809297";
CM_ SG_ 1009 RCM2_a420_sideAccelCPilRSht2Gnd "DTC value: 0x809711";
CM_ SG_ 1009 RCM2_a421_sideAccelCPilRSht2Bat "DTC value: 0x809712";
CM_ SG_ 1009 RCM2_a422_sideAccelCPilROpen "DTC value: 0x809713";
CM_ SG_ 1009 RCM2_a423_sideAccelCPilRCrssCoup "DTC value: 0x80972B";
CM_ SG_ 1009 RCM2_a424_sideAccelCPilRCommErr "DTC value: 0x809731";
CM_ SG_ 1009 RCM2_a425_sideAccelCPilRInitTyp "DTC value: 0x80974A";
CM_ SG_ 1009 RCM2_a426_sideAccelCPilRConfig "DTC value: 0x809756";
CM_ SG_ 1009 RCM2_a427_sideAccelCPilRDefect "DTC value: 0x809796";
CM_ SG_ 1009 RCM2_a428_sideAccelCPilRSigMon "DTC value: 0x809797";
CM_ SG_ 1009 RCM2_a430_presFrntLDoorSht2Gnd "DTC value: 0x91A011";
CM_ SG_ 1009 RCM2_a431_presFrntLDoorSht2Bat "DTC value: 0x91A012";
CM_ SG_ 1009 RCM2_a432_presFrntLDoorOpen "DTC value: 0x91A013";
CM_ SG_ 1009 RCM2_a433_presFrntLDoorCrssCoup "DTC value: 0x91A02B";
CM_ SG_ 1009 RCM2_a434_presFrntLDoorCommErr "DTC value: 0x91A031";
CM_ SG_ 1009 RCM2_a435_presFrntLDoorInitTyp "DTC value: 0x91A04A";
CM_ SG_ 1009 RCM2_a436_presFrntLDoorConfig "DTC value: 0x91A056";
CM_ SG_ 1009 RCM2_a437_presFrntLDoorDefect "DTC value: 0x91A096";
CM_ SG_ 1009 RCM2_a438_presFrntLDoorSigMon "DTC value: 0x91A097";
CM_ SG_ 1009 RCM2_a439_presDoorAbsolute1 "DTC value: 0x91A098";
CM_ SG_ 1009 RCM2_a440_presFrntRDoorSht2Gnd "DTC value: 0x91A111";
CM_ SG_ 1009 RCM2_a441_presFrntRDoorSht2Bat "DTC value: 0x91A112";
CM_ SG_ 1009 RCM2_a442_presFrntRDoorOpen "DTC value: 0x91A113";
CM_ SG_ 1009 RCM2_a443_presFrntRDoorCrssCoup "DTC value: 0x91A12B";
CM_ SG_ 1009 RCM2_a444_presFrntRDoorCommErr "DTC value: 0x91A131";
CM_ SG_ 1009 RCM2_a445_presFrntRDoorInitTyp "DTC value: 0x91A14A";
CM_ SG_ 1009 RCM2_a446_presFrntRDoorConfig "DTC value: 0x91A156";
CM_ SG_ 1009 RCM2_a447_presFrntRDoorDefect "DTC value: 0x91A196";
CM_ SG_ 1009 RCM2_a448_presFrntRDoorSigMon "DTC value: 0x91A197";
CM_ SG_ 1009 RCM2_a449_presDoorAbsolute2 "DTC value: 0x91A099";
CM_ SG_ 1009 RCM2_a450_presPedProLSht2Gnd "DTC value: 0x900511";
CM_ SG_ 1009 RCM2_a451_presPedProLSht2Bat "DTC value: 0x900512";
CM_ SG_ 1009 RCM2_a452_presPedProLOpen "DTC value: 0x900513";
CM_ SG_ 1009 RCM2_a453_presPedProLCrssCoup "DTC value: 0x90052B";
CM_ SG_ 1009 RCM2_a454_presPedProLCommErr "DTC value: 0x900531";
CM_ SG_ 1009 RCM2_a455_presPedProLInitTyp "DTC value: 0x90054A";
CM_ SG_ 1009 RCM2_a456_presPedProLConfig "DTC value: 0x900556";
CM_ SG_ 1009 RCM2_a457_presPedProLDefect "DTC value: 0x900596";
CM_ SG_ 1009 RCM2_a458_presPedProLSigMon "DTC value: 0x900597";
CM_ SG_ 1009 RCM2_a460_presPedProRSht2Gnd "DTC value: 0x900411";
CM_ SG_ 1009 RCM2_a461_presPedProRSht2Bat "DTC value: 0x900412";
CM_ SG_ 1009 RCM2_a462_presPedProROpen "DTC value: 0x900413";
CM_ SG_ 1009 RCM2_a463_presPedProRCrssCoup "DTC value: 0x90042B";
CM_ SG_ 1009 RCM2_a464_presPedProRCommErr "DTC value: 0x900431";
CM_ SG_ 1009 RCM2_a465_presPedProRInitTyp "DTC value: 0x90044A";
CM_ SG_ 1009 RCM2_a466_presPedProRConfig "DTC value: 0x900456";
CM_ SG_ 1009 RCM2_a467_presPedProRDefect "DTC value: 0x900496";
CM_ SG_ 1009 RCM2_a468_presPedProRSigMon "DTC value: 0x900497";
CM_ SG_ 1009 RCM2_a469_presPedProAbsolute "DTC value: 0x900498";
CM_ SG_ 1009 RCM2_a470_upFrntPedProLSht2Gnd "DTC value: 0x901411";
CM_ SG_ 1009 RCM2_a471_upFrntPedProLSht2Bat "DTC value: 0x901412";
CM_ SG_ 1009 RCM2_a472_upFrntPedProLOpen "DTC value: 0x901413";
CM_ SG_ 1009 RCM2_a473_upFrntPedProLCrssCoup "DTC value: 0x90142B";
CM_ SG_ 1009 RCM2_a474_upFrntPedProLCommErr "DTC value: 0x901431";
CM_ SG_ 1009 RCM2_a475_upFrntPedProLIntTyp "DTC value: 0x90144A";
CM_ SG_ 1009 RCM2_a476_upFrntPedProLConfig "DTC value: 0x901456";
CM_ SG_ 1009 RCM2_a477_upFrntPedProLDefect "DTC value: 0x901496";
CM_ SG_ 1009 RCM2_a478_upFrntPedProSht2Gnd "DTC value: 0x901497";
CM_ SG_ 1009 RCM2_a480_upFrntPedProRSht2Gnd "DTC value: 0x901511";
CM_ SG_ 1009 RCM2_a481_upFrntPedProRSht2Bat "DTC value: 0x901512";
CM_ SG_ 1009 RCM2_a482_upFrntPedProROpen "DTC value: 0x901513";
CM_ SG_ 1009 RCM2_a483_upFrntPedProRCrssCoup "DTC value: 0x90152B";
CM_ SG_ 1009 RCM2_a484_upFrntPedProRCommErr "DTC value: 0x901531";
CM_ SG_ 1009 RCM2_a485_upFrntPedProRIntTyp "DTC value: 0x90154A";
CM_ SG_ 1009 RCM2_a486_upFrntPedProRConfig "DTC value: 0x901556";
CM_ SG_ 1009 RCM2_a487_upFrntPedProRDefect "DTC value: 0x901596";
CM_ SG_ 1009 RCM2_a488_upFrntPedProSht2Gnd "DTC value: 0x901597";
CM_ SG_ 1009 RCM2_a550_bucklHallLeftSht2Gnd "DTC value: 0x805011";
CM_ SG_ 1009 RCM2_a551_bucklHallLeftSht2Bat "DTC value: 0x805012";
CM_ SG_ 1009 RCM2_a552_bucklHallLeftOpen "DTC value: 0x805013";
CM_ SG_ 1009 RCM2_a553_bucklHallLeftUndef "DTC value: 0x80501D";
CM_ SG_ 1009 RCM2_a554_bucklHallLeftCrssCoup "DTC value: 0x80502B";
CM_ SG_ 1009 RCM2_a555_bucklHallLeftConfig "DTC value: 0x805056";
CM_ SG_ 1009 RCM2_a556_bucklHallRightSht2Gnd "DTC value: 0x805211";
CM_ SG_ 1009 RCM2_a557_bucklHallRightSht2Bat "DTC value: 0x805212";
CM_ SG_ 1009 RCM2_a558_bucklHallRightOpen "DTC value: 0x805213";
CM_ SG_ 1009 RCM2_a559_bucklHallRightUndef "DTC value: 0x80521D";
CM_ SG_ 1009 RCM2_a560_bucklHallRightCrssCoup "DTC value: 0x80522B";
CM_ SG_ 1009 RCM2_a561_bucklHallRightConfig "DTC value: 0x805256";
CM_ SG_ 1009 RCM2_a562_seaTrkPosLeftSht2Gnd "DTC value: 0x80B511";
CM_ SG_ 1009 RCM2_a563_seaTrkPosLeftShtBat "DTC value: 0x80B512";
CM_ SG_ 1009 RCM2_a564_seaTrkPosLeftOpen "DTC value: 0x80B513";
CM_ SG_ 1009 RCM2_a565_seaTrkPosLeftUndefined "DTC value: 0x80B51D";
CM_ SG_ 1009 RCM2_a566_seaTrkPosLeftCrssCoup "DTC value: 0x80B52B";
BA_DEF_ BO_ "AlertLogSubSystemId" INT 0 0;
BA_DEF_ BO_ "AlertType" INT 0 4;
BA_DEF_ BO_ "AppBotschaft" ENUM "nein","ja";
BA_DEF_ BO_ "DiagRequest" ENUM "No","Yes";
BA_DEF_ BO_ "DiagResponse" ENUM "No","Yes";
BA_DEF_ BO_ "ETHGatewayMessageSendType" ENUM "UseGenMsgSendType","onWrite","noAutoCode";
BA_DEF_ BO_ "ETHId" STRING ;
BA_DEF_ BO_ "GatewayHandlerEnum" ENUM "noHandler","uds","alertLog","messageLogOnReception","udsClient";
BA_DEF_ BO_ "GatewayMessageAtomic" ENUM "No","Yes";
BA_DEF_ BO_ "GatewayMessageSendType" ENUM "UseGenMsgSendType","onWrite","noAutoCode";
BA_DEF_ BO_ "GenMsgCycleTime" INT 0 0;
BA_DEF_ BO_ "GenMsgCycleTimeFast" INT 0 0;
BA_DEF_ BO_ "GenMsgDelayTime" INT 0 0;
BA_DEF_ BO_ "GenMsgForceMiaCheck" ENUM "No","Yes";
BA_DEF_ BO_ "GenMsgGatewayNotification" STRING ;
BA_DEF_ BO_ "GenMsgILSupport" ENUM "No","Yes";
BA_DEF_ BO_ "GenMsgSaltingFunction" ENUM "No","Yes";
BA_DEF_ BO_ "GenMsgSendType" ENUM "Cyclic","NotUsed","NotUsed","NotUsed","NotUsed","NotUsed","NotUsed","IfActive","NoMsgSendType","Sporadic";
BA_DEF_ BO_ "GenMsgStartValue" STRING ;
BA_DEF_ BO_ "GenMsgTimeOut" INT 0 0;
BA_DEF_ BO_ "MessageIdType" ENUM "normal","udsRequest","udsResponse","udsReserved","udsFunctionalRequest","networkManagement","bootloader","xcp","dtc","diagnostic","vendorExempt";
BA_DEF_ BO_ "NWMBotschaft" ENUM "nein","ja";
BA_DEF_ BO_ "NmMessage" ENUM "No","Yes";
BA_DEF_ BO_ "SubSystemId" INT 0 256;
BA_DEF_ BO_ "UsesChecksum" ENUM "No","Yes";
BA_DEF_ SG_ "FieldType" STRING ;
BA_DEF_ SG_ "FlexKomComment" STRING ;
BA_DEF_ SG_ "FlexKomIsMotorola" ENUM "nein","ja";
BA_DEF_ SG_ "FlexKomSID" INT 0 2147483647;
BA_DEF_ SG_ "FlexKomSigLaenge" INT 0 64;
BA_DEF_ SG_ "FlexKomSigName" STRING ;
BA_DEF_ SG_ "FlexKomSigStartPos" INT 0 63;
BA_DEF_ SG_ "FlexKomSigStartValue" STRING ;
BA_DEF_ SG_ "Gatewaysignal" INT 0 1;
BA_DEF_ SG_ "GenSigCycleTime" INT 0 0;
BA_DEF_ SG_ "GenSigCycleTimeActive" INT 0 0;
BA_DEF_ SG_ "GenSigPersistent" ENUM "No","Yes";
BA_DEF_ SG_ "GenSigSNA" STRING ;
BA_DEF_ SG_ "GenSigSendType" ENUM "Cyclic","OnWrite","OnWriteWithRepetition","OnChange","OnChangeWithRepetition","IfActive","IfActiveWithRepetition","NoSigSendType","NotUsed","NotUsed","NotUsed","NotUsed","NotUsed";
BA_DEF_ SG_ "GenSigStartValue" INT 0 0;
BA_DEF_ SG_ "GenSigTimeout_CGW" INT 0 65535;
BA_DEF_ SG_ "GenSigTimeout_DRVU" INT 0 65535;
BA_DEF_ SG_ "GenSigTimeout_ECM" INT 0 65535;
BA_DEF_ SG_ "GenSigTimeout_EIS" INT 0 65535;
BA_DEF_ SG_ "GenSigTimeout_EPS" INT 0 65535;
BA_DEF_ SG_ "GenSigTimeout_ESP_ABR" INT 0 65535;
BA_DEF_ SG_ "GenSigTimeout_IC" INT 0 65535;
BA_DEF_ SG_ "GenSigTimeout_MPC" INT 0 65535;
BA_DEF_ SG_ "GenSigTimeout_NV" INT 0 65535;
BA_DEF_ SG_ "GenSigTimeout_ORC" INT 0 65535;
BA_DEF_ SG_ "GenSigTimeout_PTS" INT 0 65535;
BA_DEF_ SG_ "GenSigTimeout_RBTM_FL" INT 0 65535;
BA_DEF_ SG_ "GenSigTimeout_RBTM_FR" INT 0 65535;
BA_DEF_ SG_ "GenSigTimeout_RDU" INT 0 65535;
BA_DEF_ SG_ "GenSigTimeout_SCCM" INT 0 65535;
BA_DEF_ SG_ "GenSigTimeout_SPC" INT 0 65535;
BA_DEF_ SG_ "GenSigTimeout_TPM" INT 0 65535;
BA_DEF_ SG_ "LogSignal" STRING ;
BA_DEF_ SG_ "PektronUpdateBitType" ENUM "Not used","Has update bit","Is update bit";
BA_DEF_REL_ BU_SG_REL_ "GenSigTimeoutTime" INT 0 0;

BA_DEF_DEF_ "AlertLogSubSystemId" 0;
BA_DEF_DEF_ "AlertType" 4;
BA_DEF_DEF_ "AppBotschaft" "nein";
BA_DEF_DEF_ "DiagRequest" "No";
BA_DEF_DEF_ "DiagResponse" "No";
BA_DEF_DEF_ "ETHGatewayMessageSendType" "UseGenMsgSendType";
BA_DEF_DEF_ "ETHId" "";
BA_DEF_DEF_ "FieldType" "";
BA_DEF_DEF_ "FlexKomComment" "";
BA_DEF_DEF_ "FlexKomIsMotorola" "";
BA_DEF_DEF_ "FlexKomSID" 0;
BA_DEF_DEF_ "FlexKomSigLaenge" 0;
BA_DEF_DEF_ "FlexKomSigName" "";
BA_DEF_DEF_ "FlexKomSigStartPos" 0;
BA_DEF_DEF_ "FlexKomSigStartValue" "";
BA_DEF_DEF_ "GatewayHandlerEnum" "noHandler";
BA_DEF_DEF_ "GatewayMessageAtomic" "No";
BA_DEF_DEF_ "GatewayMessageSendType" "UseGenMsgSendType";
BA_DEF_DEF_ "Gatewaysignal" 0;
BA_DEF_DEF_ "GenMsgCycleTime" 0;
BA_DEF_DEF_ "GenMsgCycleTimeFast" 0;
BA_DEF_DEF_ "GenMsgDelayTime" 0;
BA_DEF_DEF_ "GenMsgForceMiaCheck" "No";
BA_DEF_DEF_ "GenMsgGatewayNotification" "";
BA_DEF_DEF_ "GenMsgILSupport" "Yes";
BA_DEF_DEF_ "GenMsgSaltingFunction" "No";
BA_DEF_DEF_ "GenMsgSendType" "Cyclic";
BA_DEF_DEF_ "GenMsgStartValue" "";
BA_DEF_DEF_ "GenMsgTimeOut" 0;
BA_DEF_DEF_ "GenSigCycleTime" 0;
BA_DEF_DEF_ "GenSigCycleTimeActive" 0;
BA_DEF_DEF_ "GenSigPersistent" "No";
BA_DEF_DEF_ "GenSigSNA" "";
BA_DEF_DEF_ "GenSigSendType" "Cyclic";
BA_DEF_DEF_ "GenSigStartValue" 0;
BA_DEF_DEF_ "GenSigTimeout_CGW" 0;
BA_DEF_DEF_ "GenSigTimeout_DRVU" 0;
BA_DEF_DEF_ "GenSigTimeout_ECM" 0;
BA_DEF_DEF_ "GenSigTimeout_EIS" 0;
BA_DEF_DEF_ "GenSigTimeout_EPS" 0;
BA_DEF_DEF_ "GenSigTimeout_ESP_ABR" 0;
BA_DEF_DEF_ "GenSigTimeout_IC" 0;
BA_DEF_DEF_ "GenSigTimeout_MPC" 0;
BA_DEF_DEF_ "GenSigTimeout_NV" 0;
BA_DEF_DEF_ "GenSigTimeout_ORC" 0;
BA_DEF_DEF_ "GenSigTimeout_PTS" 0;
BA_DEF_DEF_ "GenSigTimeout_RBTM_FL" 0;
BA_DEF_DEF_ "GenSigTimeout_RBTM_FR" 0;
BA_DEF_DEF_ "GenSigTimeout_RDU" 0;
BA_DEF_DEF_ "GenSigTimeout_SCCM" 0;
BA_DEF_DEF_ "GenSigTimeout_SPC" 0;
BA_DEF_DEF_ "GenSigTimeout_TPM" 0;
BA_DEF_DEF_ "LogSignal" "";
BA_DEF_DEF_ "MessageIdType" "normal";
BA_DEF_DEF_ "NWMBotschaft" "nein";
BA_DEF_DEF_ "NmMessage" "No";
BA_DEF_DEF_ "PektronUpdateBitType" "Not used";
BA_DEF_DEF_ "SubSystemId" 0;
BA_DEF_DEF_ "UsesChecksum" "No";
BA_DEF_DEF_REL_ "GenSigTimeoutTime" 0;
BA_ "AlertLogSubSystemId" BO_ 1249 262;
BA_ "GatewayHandlerEnum" BO_ 1249 2;
BA_ "GenMsgSendType" BO_ 1249 7;
BA_ "GenMsgCycleTime" BO_ 1009 250;
BA_ "GenMsgSendType" BO_ 1009 7;
BA_ "GenSigSendType" SG_ 1009 RCM2_matrixIndex 7;
BA_ "FieldType" SG_ 1009 RCM2_a000_crashDetected "PASSIVE_SAFETY_ALERT";
BA_ "GenSigSendType" SG_ 1009 RCM2_a000_crashDetected 7;
BA_ "FieldType" SG_ 1009 RCM2_a001_nearDeploy "PASSIVE_SAFETY_ALERT";
BA_ "GenSigSendType" SG_ 1009 RCM2_a001_nearDeploy 7;
BA_ "FieldType" SG_ 1009 RCM2_a002_airbagsUnArmed "PASSIVE_SAFETY_ALERT";
BA_ "GenSigSendType" SG_ 1009 RCM2_a002_airbagsUnArmed 7;
BA_ "FieldType" SG_ 1009 RCM2_a003_warningIndicator "PASSIVE_SAFETY_ALERT";
BA_ "GenSigSendType" SG_ 1009 RCM2_a003_warningIndicator 7;
BA_ "FieldType" SG_ 1009 RCM2_a004_crashAlgoWakeup "PASSIVE_SAFETY_ALERT";
BA_ "GenSigSendType" SG_ 1009 RCM2_a004_crashAlgoWakeup 7;
BA_ "FieldType" SG_ 1009 RCM2_a005_abuseImmunityThrshold "PASSIVE_SAFETY_ALERT";
BA_ "GenSigSendType" SG_ 1009 RCM2_a005_abuseImmunityThrshold 7;
BA_ "FieldType" SG_ 1009 RCM2_a006_supplierDiagEnabled "PASSIVE_SAFETY_ALERT";
BA_ "GenSigSendType" SG_ 1009 RCM2_a006_supplierDiagEnabled 7;
BA_ "FieldType" SG_ 1009 RCM2_a007_pedProCrashDetected "PASSIVE_SAFETY_ALERT";
BA_ "GenSigSendType" SG_ 1009 RCM2_a007_pedProCrashDetected 7;
BA_ "FieldType" SG_ 1009 RCM2_a008_factoryMode "PASSIVE_SAFETY_ALERT";
BA_ "GenSigSendType" SG_ 1009 RCM2_a008_factoryMode 7;
BA_ "FieldType" SG_ 1009 RCM2_a009_edrDataAreaLocked "PASSIVE_SAFETY_ALERT";
BA_ "GenSigSendType" SG_ 1009 RCM2_a009_edrDataAreaLocked 7;
BA_ "FieldType" SG_ 1009 RCM2_a010_pedProEDRDataLocked "PASSIVE_SAFETY_ALERT";
BA_ "GenSigSendType" SG_ 1009 RCM2_a010_pedProEDRDataLocked 7;
BA_ "FieldType" SG_ 1009 RCM2_a011_FrntAlgoDisabled "PASSIVE_SAFETY_ALERT";
BA_ "GenSigSendType" SG_ 1009 RCM2_a011_FrntAlgoDisabled 7;
BA_ "FieldType" SG_ 1009 RCM2_a012_RollAlgoDisabled "PASSIVE_SAFETY_ALERT";
BA_ "GenSigSendType" SG_ 1009 RCM2_a012_RollAlgoDisabled 7;
BA_ "FieldType" SG_ 1009 RCM2_a013_SideAlgoDisabled "PASSIVE_SAFETY_ALERT";
BA_ "GenSigSendType" SG_ 1009 RCM2_a013_SideAlgoDisabled 7;
BA_ "FieldType" SG_ 1009 RCM2_a014_pedProNearDeploy "PASSIVE_SAFETY_ALERT";
BA_ "GenSigSendType" SG_ 1009 RCM2_a014_pedProNearDeploy 7;
BA_ "FieldType" SG_ 1009 RCM2_a047_batteryESRhigh "PASSIVE_SAFETY_ALERT";
BA_ "GenSigSendType" SG_ 1009 RCM2_a047_batteryESRhigh 7;
BA_ "FieldType" SG_ 1009 RCM2_a048_batteryVoltageTooHigh "PASSIVE_SAFETY_ALERT";
BA_ "GenSigSendType" SG_ 1009 RCM2_a048_batteryVoltageTooHigh 7;
BA_ "FieldType" SG_ 1009 RCM2_a049_batteryVoltageTooLow "PASSIVE_SAFETY_ALERT";
BA_ "GenSigSendType" SG_ 1009 RCM2_a049_batteryVoltageTooLow 7;
BA_ "FieldType" SG_ 1009 RCM2_a050_driverABStg1Sht2Gnd "PASSIVE_SAFETY_ALERT";
BA_ "GenSigSendType" SG_ 1009 RCM2_a050_driverABStg1Sht2Gnd 7;
BA_ "FieldType" SG_ 1009 RCM2_a051_driverABStg1Sht2Bat "PASSIVE_SAFETY_ALERT";
BA_ "GenSigSendType" SG_ 1009 RCM2_a051_driverABStg1Sht2Bat 7;
BA_ "FieldType" SG_ 1009 RCM2_a052_driverABStg1Open "PASSIVE_SAFETY_ALERT";
BA_ "GenSigSendType" SG_ 1009 RCM2_a052_driverABStg1Open 7;
BA_ "FieldType" SG_ 1009 RCM2_a053_driverABStg1Short "PASSIVE_SAFETY_ALERT";
BA_ "GenSigSendType" SG_ 1009 RCM2_a053_driverABStg1Short 7;
BA_ "FieldType" SG_ 1009 RCM2_a054_driverABStg1CrssCoup "PASSIVE_SAFETY_ALERT";
BA_ "GenSigSendType" SG_ 1009 RCM2_a054_driverABStg1CrssCoup 7;
BA_ "FieldType" SG_ 1009 RCM2_a055_driverABStg1Config "PASSIVE_SAFETY_ALERT";
BA_ "GenSigSendType" SG_ 1009 RCM2_a055_driverABStg1Config 7;
BA_ "FieldType" SG_ 1009 RCM2_a056_driverABStg2Sht2Gnd "PASSIVE_SAFETY_ALERT";
BA_ "GenSigSendType" SG_ 1009 RCM2_a056_driverABStg2Sht2Gnd 7;
BA_ "FieldType" SG_ 1009 RCM2_a057_driverABStg2Sht2Bat "PASSIVE_SAFETY_ALERT";
BA_ "GenSigSendType" SG_ 1009 RCM2_a057_driverABStg2Sht2Bat 7;
BA_ "FieldType" SG_ 1009 RCM2_a058_driverABStg2Open "PASSIVE_SAFETY_ALERT";
BA_ "GenSigSendType" SG_ 1009 RCM2_a058_driverABStg2Open 7;
BA_ "FieldType" SG_ 1009 RCM2_a059_driverABStg2Short "PASSIVE_SAFETY_ALERT";
BA_ "GenSigSendType" SG_ 1009 RCM2_a059_driverABStg2Short 7;
BA_ "FieldType" SG_ 1009 RCM2_a060_driverABStg2CrssCoup "PASSIVE_SAFETY_ALERT";
BA_ "GenSigSendType" SG_ 1009 RCM2_a060_driverABStg2CrssCoup 7;
BA_ "FieldType" SG_ 1009 RCM2_a061_driverABStg2Config "PASSIVE_SAFETY_ALERT";
BA_ "GenSigSendType" SG_ 1009 RCM2_a061_driverABStg2Config 7;
BA_ "FieldType" SG_ 1009 RCM2_a062_passABStg1Sht2Gnd "PASSIVE_SAFETY_ALERT";
BA_ "GenSigSendType" SG_ 1009 RCM2_a062_passABStg1Sht2Gnd 7;
BA_ "FieldType" SG_ 1009 RCM2_a063_passABStg1Sht2Bat "PASSIVE_SAFETY_ALERT";
BA_ "GenSigSendType" SG_ 1009 RCM2_a063_passABStg1Sht2Bat 7;
BA_ "FieldType" SG_ 1009 RCM2_a064_passABStg1Open "PASSIVE_SAFETY_ALERT";
BA_ "GenSigSendType" SG_ 1009 RCM2_a064_passABStg1Open 7;
BA_ "FieldType" SG_ 1009 RCM2_a065_passABStg1Short "PASSIVE_SAFETY_ALERT";
BA_ "GenSigSendType" SG_ 1009 RCM2_a065_passABStg1Short 7;
BA_ "FieldType" SG_ 1009 RCM2_a066_passABStg1CrssCoup "PASSIVE_SAFETY_ALERT";
BA_ "GenSigSendType" SG_ 1009 RCM2_a066_passABStg1CrssCoup 7;
BA_ "FieldType" SG_ 1009 RCM2_a067_passABStg1Config "PASSIVE_SAFETY_ALERT";
BA_ "GenSigSendType" SG_ 1009 RCM2_a067_passABStg1Config 7;
BA_ "FieldType" SG_ 1009 RCM2_a068_passABStg2Sht2Gnd "PASSIVE_SAFETY_ALERT";
BA_ "GenSigSendType" SG_ 1009 RCM2_a068_passABStg2Sht2Gnd 7;
BA_ "FieldType" SG_ 1009 RCM2_a069_passABStg2Sht2Bat "PASSIVE_SAFETY_ALERT";
BA_ "GenSigSendType" SG_ 1009 RCM2_a069_passABStg2Sht2Bat 7;
BA_ "FieldType" SG_ 1009 RCM2_a070_passABStg2Open "PASSIVE_SAFETY_ALERT";
BA_ "GenSigSendType" SG_ 1009 RCM2_a070_passABStg2Open 7;
BA_ "FieldType" SG_ 1009 RCM2_a071_passABStg2Short "PASSIVE_SAFETY_ALERT";
BA_ "GenSigSendType" SG_ 1009 RCM2_a071_passABStg2Short 7;
BA_ "FieldType" SG_ 1009 RCM2_a072_passABStg2CrssCoup "PASSIVE_SAFETY_ALERT";
BA_ "GenSigSendType" SG_ 1009 RCM2_a072_passABStg2CrssCoup 7;
BA_ "FieldType" SG_ 1009 RCM2_a073_passABStg2Config "PASSIVE_SAFETY_ALERT";
BA_ "GenSigSendType" SG_ 1009 RCM2_a073_passABStg2Config 7;
BA_ "FieldType" SG_ 1009 RCM2_a074_passActiveVentSht2Gnd "PASSIVE_SAFETY_ALERT";
BA_ "GenSigSendType" SG_ 1009 RCM2_a074_passActiveVentSht2Gnd 7;
BA_ "FieldType" SG_ 1009 RCM2_a075_passActiveVentSht2Bat "PASSIVE_SAFETY_ALERT";
BA_ "GenSigSendType" SG_ 1009 RCM2_a075_passActiveVentSht2Bat 7;
BA_ "FieldType" SG_ 1009 RCM2_a076_passActiveVentOpen "PASSIVE_SAFETY_ALERT";
BA_ "GenSigSendType" SG_ 1009 RCM2_a076_passActiveVentOpen 7;
BA_ "FieldType" SG_ 1009 RCM2_a077_passActiveVentShort "PASSIVE_SAFETY_ALERT";
BA_ "GenSigSendType" SG_ 1009 RCM2_a077_passActiveVentShort 7;
BA_ "FieldType" SG_ 1009 RCM2_a078_passActiveVentCrssCoup "PASSIVE_SAFETY_ALERT";
BA_ "GenSigSendType" SG_ 1009 RCM2_a078_passActiveVentCrssCoup 7;
BA_ "FieldType" SG_ 1009 RCM2_a079_passActiveVentConfig "PASSIVE_SAFETY_ALERT";
BA_ "GenSigSendType" SG_ 1009 RCM2_a079_passActiveVentConfig 7;
BA_ "FieldType" SG_ 1009 RCM2_a080_pretenShldLeftSht2Gnd "PASSIVE_SAFETY_ALERT";
BA_ "GenSigSendType" SG_ 1009 RCM2_a080_pretenShldLeftSht2Gnd 7;
BA_ "FieldType" SG_ 1009 RCM2_a081_pretenShldLeftSht2Bat "PASSIVE_SAFETY_ALERT";
BA_ "GenSigSendType" SG_ 1009 RCM2_a081_pretenShldLeftSht2Bat 7;
BA_ "FieldType" SG_ 1009 RCM2_a082_pretenShldLeftOpen "PASSIVE_SAFETY_ALERT";
BA_ "GenSigSendType" SG_ 1009 RCM2_a082_pretenShldLeftOpen 7;
BA_ "FieldType" SG_ 1009 RCM2_a083_pretenShldLeftShort "PASSIVE_SAFETY_ALERT";
BA_ "GenSigSendType" SG_ 1009 RCM2_a083_pretenShldLeftShort 7;
BA_ "FieldType" SG_ 1009 RCM2_a084_pretenShldLeftCrossC "PASSIVE_SAFETY_ALERT";
BA_ "GenSigSendType" SG_ 1009 RCM2_a084_pretenShldLeftCrossC 7;
BA_ "FieldType" SG_ 1009 RCM2_a085_pretenShldLeftConfig "PASSIVE_SAFETY_ALERT";
BA_ "GenSigSendType" SG_ 1009 RCM2_a085_pretenShldLeftConfig 7;
BA_ "FieldType" SG_ 1009 RCM2_a086_pretenShldRightSht2Gnd "PASSIVE_SAFETY_ALERT";
BA_ "GenSigSendType" SG_ 1009 RCM2_a086_pretenShldRightSht2Gnd 7;
BA_ "FieldType" SG_ 1009 RCM2_a087_pretenShldRightSht2Bat "PASSIVE_SAFETY_ALERT";
BA_ "GenSigSendType" SG_ 1009 RCM2_a087_pretenShldRightSht2Bat 7;
BA_ "FieldType" SG_ 1009 RCM2_a088_pretenShldRightOpen "PASSIVE_SAFETY_ALERT";
BA_ "GenSigSendType" SG_ 1009 RCM2_a088_pretenShldRightOpen 7;
BA_ "FieldType" SG_ 1009 RCM2_a089_pretenShldRightShort "PASSIVE_SAFETY_ALERT";
BA_ "GenSigSendType" SG_ 1009 RCM2_a089_pretenShldRightShort 7;
BA_ "FieldType" SG_ 1009 RCM2_a090_pretenShldRightCrssCou "PASSIVE_SAFETY_ALERT";
BA_ "GenSigSendType" SG_ 1009 RCM2_a090_pretenShldRightCrssCou 7;
BA_ "FieldType" SG_ 1009 RCM2_a091_pretenShldRightConfig "PASSIVE_SAFETY_ALERT";
BA_ "GenSigSendType" SG_ 1009 RCM2_a091_pretenShldRightConfig 7;
BA_ "FieldType" SG_ 1009 RCM2_a092_pretenLapLeftSht2Gnd "PASSIVE_SAFETY_ALERT";
BA_ "GenSigSendType" SG_ 1009 RCM2_a092_pretenLapLeftSht2Gnd 7;
BA_ "FieldType" SG_ 1009 RCM2_a093_pretenLapLeftSht2Bat "PASSIVE_SAFETY_ALERT";
BA_ "GenSigSendType" SG_ 1009 RCM2_a093_pretenLapLeftSht2Bat 7;
BA_ "FieldType" SG_ 1009 RCM2_a094_pretenLapLeftOpen "PASSIVE_SAFETY_ALERT";
BA_ "GenSigSendType" SG_ 1009 RCM2_a094_pretenLapLeftOpen 7;
BA_ "FieldType" SG_ 1009 RCM2_a095_pretenLapLeftShort "PASSIVE_SAFETY_ALERT";
BA_ "GenSigSendType" SG_ 1009 RCM2_a095_pretenLapLeftShort 7;
BA_ "FieldType" SG_ 1009 RCM2_a096_pretenLapLeftCrssCoup "PASSIVE_SAFETY_ALERT";
BA_ "GenSigSendType" SG_ 1009 RCM2_a096_pretenLapLeftCrssCoup 7;
BA_ "FieldType" SG_ 1009 RCM2_a097_pretenLapLeftConfig "PASSIVE_SAFETY_ALERT";
BA_ "GenSigSendType" SG_ 1009 RCM2_a097_pretenLapLeftConfig 7;
BA_ "FieldType" SG_ 1009 RCM2_a098_pretenLapRightSht2Gnd "PASSIVE_SAFETY_ALERT";
BA_ "GenSigSendType" SG_ 1009 RCM2_a098_pretenLapRightSht2Gnd 7;
BA_ "FieldType" SG_ 1009 RCM2_a099_pretenLapRightSht2Bat "PASSIVE_SAFETY_ALERT";
BA_ "GenSigSendType" SG_ 1009 RCM2_a099_pretenLapRightSht2Bat 7;
BA_ "FieldType" SG_ 1009 RCM2_a100_pretenLapRightOpen "PASSIVE_SAFETY_ALERT";
BA_ "GenSigSendType" SG_ 1009 RCM2_a100_pretenLapRightOpen 7;
BA_ "FieldType" SG_ 1009 RCM2_a101_pretenLapRightShort "PASSIVE_SAFETY_ALERT";
BA_ "GenSigSendType" SG_ 1009 RCM2_a101_pretenLapRightShort 7;
BA_ "FieldType" SG_ 1009 RCM2_a102_pretenLapRightCrssCoup "PASSIVE_SAFETY_ALERT";
BA_ "GenSigSendType" SG_ 1009 RCM2_a102_pretenLapRightCrssCoup 7;
BA_ "FieldType" SG_ 1009 RCM2_a103_pretenLapRightConfig "PASSIVE_SAFETY_ALERT";
BA_ "GenSigSendType" SG_ 1009 RCM2_a103_pretenLapRightConfig 7;
BA_ "FieldType" SG_ 1009 RCM2_a104_loadLimLeftSht2Gnd "PASSIVE_SAFETY_ALERT";
BA_ "GenSigSendType" SG_ 1009 RCM2_a104_loadLimLeftSht2Gnd 7;
BA_ "FieldType" SG_ 1009 RCM2_a105_loadLimLeftSht2Bat "PASSIVE_SAFETY_ALERT";
BA_ "GenSigSendType" SG_ 1009 RCM2_a105_loadLimLeftSht2Bat 7;
BA_ "FieldType" SG_ 1009 RCM2_a106_loadLimLeftOpen "PASSIVE_SAFETY_ALERT";
BA_ "GenSigSendType" SG_ 1009 RCM2_a106_loadLimLeftOpen 7;
BA_ "FieldType" SG_ 1009 RCM2_a107_loadLimLeftShort "PASSIVE_SAFETY_ALERT";
BA_ "GenSigSendType" SG_ 1009 RCM2_a107_loadLimLeftShort 7;
BA_ "FieldType" SG_ 1009 RCM2_a108_loadLimLeftCrssCoup "PASSIVE_SAFETY_ALERT";
BA_ "GenSigSendType" SG_ 1009 RCM2_a108_loadLimLeftCrssCoup 7;
BA_ "FieldType" SG_ 1009 RCM2_a109_loadLimLeftConfig "PASSIVE_SAFETY_ALERT";
BA_ "GenSigSendType" SG_ 1009 RCM2_a109_loadLimLeftConfig 7;
BA_ "FieldType" SG_ 1009 RCM2_a110_loadLimRightSht2Gnd "PASSIVE_SAFETY_ALERT";
BA_ "GenSigSendType" SG_ 1009 RCM2_a110_loadLimRightSht2Gnd 7;
BA_ "FieldType" SG_ 1009 RCM2_a111_loadLimRightSht2Bat "PASSIVE_SAFETY_ALERT";
BA_ "GenSigSendType" SG_ 1009 RCM2_a111_loadLimRightSht2Bat 7;
BA_ "FieldType" SG_ 1009 RCM2_a112_loadLimRightOpen "PASSIVE_SAFETY_ALERT";
BA_ "GenSigSendType" SG_ 1009 RCM2_a112_loadLimRightOpen 7;
BA_ "FieldType" SG_ 1009 RCM2_a113_loadLimRightShort "PASSIVE_SAFETY_ALERT";
BA_ "GenSigSendType" SG_ 1009 RCM2_a113_loadLimRightShort 7;
BA_ "FieldType" SG_ 1009 RCM2_a114_loadLimRightCrssCoup "PASSIVE_SAFETY_ALERT";
BA_ "GenSigSendType" SG_ 1009 RCM2_a114_loadLimRightCrssCoup 7;
BA_ "FieldType" SG_ 1009 RCM2_a115_loadLimRightConfig "PASSIVE_SAFETY_ALERT";
BA_ "GenSigSendType" SG_ 1009 RCM2_a115_loadLimRightConfig 7;
BA_ "FieldType" SG_ 1009 RCM2_a116_kneeABDrvrSht2Gnd "PASSIVE_SAFETY_ALERT";
BA_ "GenSigSendType" SG_ 1009 RCM2_a116_kneeABDrvrSht2Gnd 7;
BA_ "FieldType" SG_ 1009 RCM2_a117_kneeABDrvrSht2Bat "PASSIVE_SAFETY_ALERT";
BA_ "GenSigSendType" SG_ 1009 RCM2_a117_kneeABDrvrSht2Bat 7;
BA_ "FieldType" SG_ 1009 RCM2_a118_kneeABDrvrOpen "PASSIVE_SAFETY_ALERT";
BA_ "GenSigSendType" SG_ 1009 RCM2_a118_kneeABDrvrOpen 7;
BA_ "FieldType" SG_ 1009 RCM2_a119_kneeABDrvrShort "PASSIVE_SAFETY_ALERT";
BA_ "GenSigSendType" SG_ 1009 RCM2_a119_kneeABDrvrShort 7;
BA_ "FieldType" SG_ 1009 RCM2_a120_kneeABDrvrCrssCoup "PASSIVE_SAFETY_ALERT";
BA_ "GenSigSendType" SG_ 1009 RCM2_a120_kneeABDrvrCrssCoup 7;
BA_ "FieldType" SG_ 1009 RCM2_a121_kneeABDrvrConfig "PASSIVE_SAFETY_ALERT";
BA_ "GenSigSendType" SG_ 1009 RCM2_a121_kneeABDrvrConfig 7;
BA_ "FieldType" SG_ 1009 RCM2_a122_kneeABPassSht2Gnd "PASSIVE_SAFETY_ALERT";
BA_ "GenSigSendType" SG_ 1009 RCM2_a122_kneeABPassSht2Gnd 7;
BA_ "FieldType" SG_ 1009 RCM2_a123_kneeABPassSht2Bat "PASSIVE_SAFETY_ALERT";
BA_ "GenSigSendType" SG_ 1009 RCM2_a123_kneeABPassSht2Bat 7;
BA_ "FieldType" SG_ 1009 RCM2_a124_kneeABPassOpen "PASSIVE_SAFETY_ALERT";
BA_ "GenSigSendType" SG_ 1009 RCM2_a124_kneeABPassOpen 7;
BA_ "FieldType" SG_ 1009 RCM2_a125_kneeABPassShort "PASSIVE_SAFETY_ALERT";
BA_ "GenSigSendType" SG_ 1009 RCM2_a125_kneeABPassShort 7;
BA_ "FieldType" SG_ 1009 RCM2_a126_kneeABPassCrssCoup "PASSIVE_SAFETY_ALERT";
BA_ "GenSigSendType" SG_ 1009 RCM2_a126_kneeABPassCrssCoup 7;
BA_ "FieldType" SG_ 1009 RCM2_a127_kneeABPassConfig "PASSIVE_SAFETY_ALERT";
BA_ "GenSigSendType" SG_ 1009 RCM2_a127_kneeABPassConfig 7;
BA_ "FieldType" SG_ 1009 RCM2_a128_sideAB1stRowLSht2Gnd "PASSIVE_SAFETY_ALERT";
BA_ "GenSigSendType" SG_ 1009 RCM2_a128_sideAB1stRowLSht2Gnd 7;
BA_ "FieldType" SG_ 1009 RCM2_a129_sideAB1stRowLSht2Bat "PASSIVE_SAFETY_ALERT";
BA_ "GenSigSendType" SG_ 1009 RCM2_a129_sideAB1stRowLSht2Bat 7;
BA_ "FieldType" SG_ 1009 RCM2_a130_sideAB1stRowLOpen "PASSIVE_SAFETY_ALERT";
BA_ "GenSigSendType" SG_ 1009 RCM2_a130_sideAB1stRowLOpen 7;
BA_ "FieldType" SG_ 1009 RCM2_a131_sideAB1stRowLShort "PASSIVE_SAFETY_ALERT";
BA_ "GenSigSendType" SG_ 1009 RCM2_a131_sideAB1stRowLShort 7;
BA_ "FieldType" SG_ 1009 RCM2_a132_sideAB1stRowLCrssCoup "PASSIVE_SAFETY_ALERT";
BA_ "GenSigSendType" SG_ 1009 RCM2_a132_sideAB1stRowLCrssCoup 7;
BA_ "FieldType" SG_ 1009 RCM2_a133_sideAB1stRowLConfig "PASSIVE_SAFETY_ALERT";
BA_ "GenSigSendType" SG_ 1009 RCM2_a133_sideAB1stRowLConfig 7;
BA_ "FieldType" SG_ 1009 RCM2_a134_sideAB1stRowRSht2Gnd "PASSIVE_SAFETY_ALERT";
BA_ "GenSigSendType" SG_ 1009 RCM2_a134_sideAB1stRowRSht2Gnd 7;
BA_ "FieldType" SG_ 1009 RCM2_a135_sideAB1stRowRSht2Bat "PASSIVE_SAFETY_ALERT";
BA_ "GenSigSendType" SG_ 1009 RCM2_a135_sideAB1stRowRSht2Bat 7;
BA_ "FieldType" SG_ 1009 RCM2_a136_sideAB1stRowROpen "PASSIVE_SAFETY_ALERT";
BA_ "GenSigSendType" SG_ 1009 RCM2_a136_sideAB1stRowROpen 7;
BA_ "FieldType" SG_ 1009 RCM2_a137_sideAB1stRowRShort "PASSIVE_SAFETY_ALERT";
BA_ "GenSigSendType" SG_ 1009 RCM2_a137_sideAB1stRowRShort 7;
BA_ "FieldType" SG_ 1009 RCM2_a138_sideAB1stRowRCrssCoup "PASSIVE_SAFETY_ALERT";
BA_ "GenSigSendType" SG_ 1009 RCM2_a138_sideAB1stRowRCrssCoup 7;
BA_ "FieldType" SG_ 1009 RCM2_a139_sideAB1stRowRConfig "PASSIVE_SAFETY_ALERT";
BA_ "GenSigSendType" SG_ 1009 RCM2_a139_sideAB1stRowRConfig 7;
BA_ "FieldType" SG_ 1009 RCM2_a140_hvdPyroSht2Gnd "PASSIVE_SAFETY_ALERT";
BA_ "GenSigSendType" SG_ 1009 RCM2_a140_hvdPyroSht2Gnd 7;
BA_ "FieldType" SG_ 1009 RCM2_a141_hvdPyroSht2Bat "PASSIVE_SAFETY_ALERT";
BA_ "GenSigSendType" SG_ 1009 RCM2_a141_hvdPyroSht2Bat 7;
BA_ "FieldType" SG_ 1009 RCM2_a142_hvdPyroOpen "PASSIVE_SAFETY_ALERT";
BA_ "GenSigSendType" SG_ 1009 RCM2_a142_hvdPyroOpen 7;
BA_ "FieldType" SG_ 1009 RCM2_a143_hvdPyroShort "PASSIVE_SAFETY_ALERT";
BA_ "GenSigSendType" SG_ 1009 RCM2_a143_hvdPyroShort 7;
BA_ "FieldType" SG_ 1009 RCM2_a144_hvdPyroCrssCoup "PASSIVE_SAFETY_ALERT";
BA_ "GenSigSendType" SG_ 1009 RCM2_a144_hvdPyroCrssCoup 7;
BA_ "FieldType" SG_ 1009 RCM2_a145_hvdPyroConfig "PASSIVE_SAFETY_ALERT";
BA_ "GenSigSendType" SG_ 1009 RCM2_a145_hvdPyroConfig 7;
BA_ "FieldType" SG_ 1009 RCM2_a146_curABLeftSht2Gnd "PASSIVE_SAFETY_ALERT";
BA_ "GenSigSendType" SG_ 1009 RCM2_a146_curABLeftSht2Gnd 7;
BA_ "FieldType" SG_ 1009 RCM2_a147_curABLeftSht2Bat "PASSIVE_SAFETY_ALERT";
BA_ "GenSigSendType" SG_ 1009 RCM2_a147_curABLeftSht2Bat 7;
BA_ "FieldType" SG_ 1009 RCM2_a148_curABLeftOpen "PASSIVE_SAFETY_ALERT";
BA_ "GenSigSendType" SG_ 1009 RCM2_a148_curABLeftOpen 7;
BA_ "FieldType" SG_ 1009 RCM2_a149_curABLeftShort "PASSIVE_SAFETY_ALERT";
BA_ "GenSigSendType" SG_ 1009 RCM2_a149_curABLeftShort 7;
BA_ "FieldType" SG_ 1009 RCM2_a150_curABLeftCrssCoup "PASSIVE_SAFETY_ALERT";
BA_ "GenSigSendType" SG_ 1009 RCM2_a150_curABLeftCrssCoup 7;
BA_ "FieldType" SG_ 1009 RCM2_a151_curABLeftConfig "PASSIVE_SAFETY_ALERT";
BA_ "GenSigSendType" SG_ 1009 RCM2_a151_curABLeftConfig 7;
BA_ "FieldType" SG_ 1009 RCM2_a152_curABRightSht2Gnd "PASSIVE_SAFETY_ALERT";
BA_ "GenSigSendType" SG_ 1009 RCM2_a152_curABRightSht2Gnd 7;
BA_ "FieldType" SG_ 1009 RCM2_a153_curABRightSht2Bat "PASSIVE_SAFETY_ALERT";
BA_ "GenSigSendType" SG_ 1009 RCM2_a153_curABRightSht2Bat 7;
BA_ "FieldType" SG_ 1009 RCM2_a154_curABRightOpen "PASSIVE_SAFETY_ALERT";
BA_ "GenSigSendType" SG_ 1009 RCM2_a154_curABRightOpen 7;
BA_ "FieldType" SG_ 1009 RCM2_a155_curABRightShort "PASSIVE_SAFETY_ALERT";
BA_ "GenSigSendType" SG_ 1009 RCM2_a155_curABRightShort 7;
BA_ "FieldType" SG_ 1009 RCM2_a156_curABRightCrssCoup "PASSIVE_SAFETY_ALERT";
BA_ "GenSigSendType" SG_ 1009 RCM2_a156_curABRightCrssCoup 7;
BA_ "FieldType" SG_ 1009 RCM2_a157_curABRightConfig "PASSIVE_SAFETY_ALERT";
BA_ "GenSigSendType" SG_ 1009 RCM2_a157_curABRightConfig 7;
BA_ "FieldType" SG_ 1009 RCM2_a158_preten2ndRowLSht2Gnd "PASSIVE_SAFETY_ALERT";
BA_ "GenSigSendType" SG_ 1009 RCM2_a158_preten2ndRowLSht2Gnd 7;
BA_ "FieldType" SG_ 1009 RCM2_a159_preten2ndRowLSht2Bat "PASSIVE_SAFETY_ALERT";
BA_ "GenSigSendType" SG_ 1009 RCM2_a159_preten2ndRowLSht2Bat 7;
BA_ "FieldType" SG_ 1009 RCM2_a160_preten2ndRowLOpen "PASSIVE_SAFETY_ALERT";
BA_ "GenSigSendType" SG_ 1009 RCM2_a160_preten2ndRowLOpen 7;
BA_ "FieldType" SG_ 1009 RCM2_a161_preten2ndRowLShort "PASSIVE_SAFETY_ALERT";
BA_ "GenSigSendType" SG_ 1009 RCM2_a161_preten2ndRowLShort 7;
BA_ "FieldType" SG_ 1009 RCM2_a162_preten2ndRowLCrssCoup "PASSIVE_SAFETY_ALERT";
BA_ "GenSigSendType" SG_ 1009 RCM2_a162_preten2ndRowLCrssCoup 7;
BA_ "FieldType" SG_ 1009 RCM2_a163_preten2ndRowLCgf "PASSIVE_SAFETY_ALERT";
BA_ "GenSigSendType" SG_ 1009 RCM2_a163_preten2ndRowLCgf 7;
BA_ "FieldType" SG_ 1009 RCM2_a164_preten2ndRowRSht2Gnd "PASSIVE_SAFETY_ALERT";
BA_ "GenSigSendType" SG_ 1009 RCM2_a164_preten2ndRowRSht2Gnd 7;
BA_ "FieldType" SG_ 1009 RCM2_a165_preten2ndRowRSht2Bat "PASSIVE_SAFETY_ALERT";
BA_ "GenSigSendType" SG_ 1009 RCM2_a165_preten2ndRowRSht2Bat 7;
BA_ "FieldType" SG_ 1009 RCM2_a166_preten2ndRowROpen "PASSIVE_SAFETY_ALERT";
BA_ "GenSigSendType" SG_ 1009 RCM2_a166_preten2ndRowROpen 7;
BA_ "FieldType" SG_ 1009 RCM2_a167_preten2ndRowRShort "PASSIVE_SAFETY_ALERT";
BA_ "GenSigSendType" SG_ 1009 RCM2_a167_preten2ndRowRShort 7;
BA_ "FieldType" SG_ 1009 RCM2_a168_preten2ndRowRCrssCoup "PASSIVE_SAFETY_ALERT";
BA_ "GenSigSendType" SG_ 1009 RCM2_a168_preten2ndRowRCrssCoup 7;
BA_ "FieldType" SG_ 1009 RCM2_a169_preten2ndRowRCgf "PASSIVE_SAFETY_ALERT";
BA_ "GenSigSendType" SG_ 1009 RCM2_a169_preten2ndRowRCgf 7;
BA_ "FieldType" SG_ 1009 RCM2_a170_curAB2ndRowLSht2Gnd "PASSIVE_SAFETY_ALERT";
BA_ "GenSigSendType" SG_ 1009 RCM2_a170_curAB2ndRowLSht2Gnd 7;
BA_ "FieldType" SG_ 1009 RCM2_a171_curAB2ndRowLSht2Bat "PASSIVE_SAFETY_ALERT";
BA_ "GenSigSendType" SG_ 1009 RCM2_a171_curAB2ndRowLSht2Bat 7;
BA_ "FieldType" SG_ 1009 RCM2_a172_curAB2ndRowLOpen "PASSIVE_SAFETY_ALERT";
BA_ "GenSigSendType" SG_ 1009 RCM2_a172_curAB2ndRowLOpen 7;
BA_ "FieldType" SG_ 1009 RCM2_a173_curAB2ndRowLShort "PASSIVE_SAFETY_ALERT";
BA_ "GenSigSendType" SG_ 1009 RCM2_a173_curAB2ndRowLShort 7;
BA_ "FieldType" SG_ 1009 RCM2_a174_curAB2ndRowLCrssCoup "PASSIVE_SAFETY_ALERT";
BA_ "GenSigSendType" SG_ 1009 RCM2_a174_curAB2ndRowLCrssCoup 7;
BA_ "FieldType" SG_ 1009 RCM2_a175_curAB2ndRowLConfig "PASSIVE_SAFETY_ALERT";
BA_ "GenSigSendType" SG_ 1009 RCM2_a175_curAB2ndRowLConfig 7;
BA_ "FieldType" SG_ 1009 RCM2_a176_curAB2ndRowRSht2Gnd "PASSIVE_SAFETY_ALERT";
BA_ "GenSigSendType" SG_ 1009 RCM2_a176_curAB2ndRowRSht2Gnd 7;
BA_ "FieldType" SG_ 1009 RCM2_a177_curAB2ndRowRSht2Bat "PASSIVE_SAFETY_ALERT";
BA_ "GenSigSendType" SG_ 1009 RCM2_a177_curAB2ndRowRSht2Bat 7;
BA_ "FieldType" SG_ 1009 RCM2_a178_curAB2ndRowROpen "PASSIVE_SAFETY_ALERT";
BA_ "GenSigSendType" SG_ 1009 RCM2_a178_curAB2ndRowROpen 7;
BA_ "FieldType" SG_ 1009 RCM2_a179_curAB2ndRowRShort "PASSIVE_SAFETY_ALERT";
BA_ "GenSigSendType" SG_ 1009 RCM2_a179_curAB2ndRowRShort 7;
BA_ "FieldType" SG_ 1009 RCM2_a180_curAB2ndRowRCrssCoup "PASSIVE_SAFETY_ALERT";
BA_ "GenSigSendType" SG_ 1009 RCM2_a180_curAB2ndRowRCrssCoup 7;
BA_ "FieldType" SG_ 1009 RCM2_a181_curAB2ndRowRConfig "PASSIVE_SAFETY_ALERT";
BA_ "GenSigSendType" SG_ 1009 RCM2_a181_curAB2ndRowRConfig 7;
BA_ "FieldType" SG_ 1009 RCM2_a182_hoodActuatorRSht2Gnd "PASSIVE_SAFETY_ALERT";
BA_ "GenSigSendType" SG_ 1009 RCM2_a182_hoodActuatorRSht2Gnd 7;
BA_ "FieldType" SG_ 1009 RCM2_a183_hoodActuatorRSht2Bat "PASSIVE_SAFETY_ALERT";
BA_ "GenSigSendType" SG_ 1009 RCM2_a183_hoodActuatorRSht2Bat 7;
BA_ "FieldType" SG_ 1009 RCM2_a184_hoodActuatorROpen "PASSIVE_SAFETY_ALERT";
BA_ "GenSigSendType" SG_ 1009 RCM2_a184_hoodActuatorROpen 7;
BA_ "FieldType" SG_ 1009 RCM2_a185_hoodActuatorRShort "PASSIVE_SAFETY_ALERT";
BA_ "GenSigSendType" SG_ 1009 RCM2_a185_hoodActuatorRShort 7;
BA_ "FieldType" SG_ 1009 RCM2_a186_hoodActuatorRCrssCoup "PASSIVE_SAFETY_ALERT";
BA_ "GenSigSendType" SG_ 1009 RCM2_a186_hoodActuatorRCrssCoup 7;
BA_ "FieldType" SG_ 1009 RCM2_a187_hoodActuatorRConfig "PASSIVE_SAFETY_ALERT";
BA_ "GenSigSendType" SG_ 1009 RCM2_a187_hoodActuatorRConfig 7;
BA_ "FieldType" SG_ 1009 RCM2_a188_hoodActuatorLSht2Gnd "PASSIVE_SAFETY_ALERT";
BA_ "GenSigSendType" SG_ 1009 RCM2_a188_hoodActuatorLSht2Gnd 7;
BA_ "FieldType" SG_ 1009 RCM2_a189_hoodActuatorLSht2Bat "PASSIVE_SAFETY_ALERT";
BA_ "GenSigSendType" SG_ 1009 RCM2_a189_hoodActuatorLSht2Bat 7;
BA_ "FieldType" SG_ 1009 RCM2_a190_hoodActuatorLOpen "PASSIVE_SAFETY_ALERT";
BA_ "GenSigSendType" SG_ 1009 RCM2_a190_hoodActuatorLOpen 7;
BA_ "FieldType" SG_ 1009 RCM2_a191_hoodActuatorLShort "PASSIVE_SAFETY_ALERT";
BA_ "GenSigSendType" SG_ 1009 RCM2_a191_hoodActuatorLShort 7;
BA_ "FieldType" SG_ 1009 RCM2_a192_hoodActuatorLCrssCoup "PASSIVE_SAFETY_ALERT";
BA_ "GenSigSendType" SG_ 1009 RCM2_a192_hoodActuatorLCrssCoup 7;
BA_ "FieldType" SG_ 1009 RCM2_a193_hoodActuatorLConfig "PASSIVE_SAFETY_ALERT";
BA_ "GenSigSendType" SG_ 1009 RCM2_a193_hoodActuatorLConfig 7;
BA_ "FieldType" SG_ 1009 RCM2_a250_ens1Sht2Bat "PASSIVE_SAFETY_ALERT";
BA_ "GenSigSendType" SG_ 1009 RCM2_a250_ens1Sht2Bat 7;
BA_ "FieldType" SG_ 1009 RCM2_a251_ens1Sht2Gnd "PASSIVE_SAFETY_ALERT";
BA_ "GenSigSendType" SG_ 1009 RCM2_a251_ens1Sht2Gnd 7;
BA_ "FieldType" SG_ 1009 RCM2_a252_ens1Config "PASSIVE_SAFETY_ALERT";
BA_ "GenSigSendType" SG_ 1009 RCM2_a252_ens1Config 7;
BA_ "FieldType" SG_ 1009 RCM2_a253_ens2Sht2Bat "PASSIVE_SAFETY_ALERT";
BA_ "GenSigSendType" SG_ 1009 RCM2_a253_ens2Sht2Bat 7;
BA_ "FieldType" SG_ 1009 RCM2_a254_ens2Sht2Gnd "PASSIVE_SAFETY_ALERT";
BA_ "GenSigSendType" SG_ 1009 RCM2_a254_ens2Sht2Gnd 7;
BA_ "FieldType" SG_ 1009 RCM2_a255_ens2Config "PASSIVE_SAFETY_ALERT";
BA_ "GenSigSendType" SG_ 1009 RCM2_a255_ens2Config 7;
BA_ "FieldType" SG_ 1009 RCM2_a300_imuAccXHgMonChlPerm "PASSIVE_SAFETY_ALERT";
BA_ "GenSigSendType" SG_ 1009 RCM2_a300_imuAccXHgMonChlPerm 7;
BA_ "FieldType" SG_ 1009 RCM2_a301_imuAccXHgMonChlTemp "PASSIVE_SAFETY_ALERT";
BA_ "GenSigSendType" SG_ 1009 RCM2_a301_imuAccXHgMonChlTemp 7;
BA_ "FieldType" SG_ 1009 RCM2_a302_imuAccYHgMonChlPerm "PASSIVE_SAFETY_ALERT";
BA_ "GenSigSendType" SG_ 1009 RCM2_a302_imuAccYHgMonChlPerm 7;
BA_ "FieldType" SG_ 1009 RCM2_a303_imuAccYHgMonChlTemp "PASSIVE_SAFETY_ALERT";
BA_ "GenSigSendType" SG_ 1009 RCM2_a303_imuAccYHgMonChlTemp 7;
BA_ "FieldType" SG_ 1009 RCM2_a304_imuYawR8SnsrPermBG "PASSIVE_SAFETY_ALERT";
BA_ "GenSigSendType" SG_ 1009 RCM2_a304_imuYawR8SnsrPermBG 7;
BA_ "FieldType" SG_ 1009 RCM2_a305_imuYawR8SnsrPermInit "PASSIVE_SAFETY_ALERT";
BA_ "GenSigSendType" SG_ 1009 RCM2_a305_imuYawR8SnsrPermInit 7;
BA_ "FieldType" SG_ 1009 RCM2_a306_imuYawR8SnsrPermLF "PASSIVE_SAFETY_ALERT";
BA_ "GenSigSendType" SG_ 1009 RCM2_a306_imuYawR8SnsrPermLF 7;
BA_ "FieldType" SG_ 1009 RCM2_a307_imuYawR8ChnlMonTmpLF "PASSIVE_SAFETY_ALERT";
BA_ "GenSigSendType" SG_ 1009 RCM2_a307_imuYawR8ChnlMonTmpLF 7;
BA_ "FieldType" SG_ 1009 RCM2_a308_imuPitchR8SnsrPermBG "PASSIVE_SAFETY_ALERT";
BA_ "GenSigSendType" SG_ 1009 RCM2_a308_imuPitchR8SnsrPermBG 7;
BA_ "FieldType" SG_ 1009 RCM2_a309_imuPitchR8SnsrPermInit "PASSIVE_SAFETY_ALERT";
BA_ "GenSigSendType" SG_ 1009 RCM2_a309_imuPitchR8SnsrPermInit 7;
BA_ "FieldType" SG_ 1009 RCM2_a310_imuPitchR8SnsrPermLF "PASSIVE_SAFETY_ALERT";
BA_ "GenSigSendType" SG_ 1009 RCM2_a310_imuPitchR8SnsrPermLF 7;
BA_ "FieldType" SG_ 1009 RCM2_a311_imuPitchR8ChnlMonTmpLF "PASSIVE_SAFETY_ALERT";
BA_ "GenSigSendType" SG_ 1009 RCM2_a311_imuPitchR8ChnlMonTmpLF 7;
BA_ "FieldType" SG_ 1009 RCM2_a312_imuRollR8SnsrPermBG "PASSIVE_SAFETY_ALERT";
BA_ "GenSigSendType" SG_ 1009 RCM2_a312_imuRollR8SnsrPermBG 7;
BA_ "FieldType" SG_ 1009 RCM2_a313_imuRollR8SnsrPermInit "PASSIVE_SAFETY_ALERT";
BA_ "GenSigSendType" SG_ 1009 RCM2_a313_imuRollR8SnsrPermInit 7;
BA_ "FieldType" SG_ 1009 RCM2_a314_imuRollR8SnsrPermLF "PASSIVE_SAFETY_ALERT";
BA_ "GenSigSendType" SG_ 1009 RCM2_a314_imuRollR8SnsrPermLF 7;
BA_ "FieldType" SG_ 1009 RCM2_a315_imuRollR8ChnlMonTmpLF "PASSIVE_SAFETY_ALERT";
BA_ "GenSigSendType" SG_ 1009 RCM2_a315_imuRollR8ChnlMonTmpLF 7;
BA_ "FieldType" SG_ 1009 RCM2_a316_imuAccXLgMonChlPerm "PASSIVE_SAFETY_ALERT";
BA_ "GenSigSendType" SG_ 1009 RCM2_a316_imuAccXLgMonChlPerm 7;
BA_ "FieldType" SG_ 1009 RCM2_a317_imuAccXLgMonChlTemp "PASSIVE_SAFETY_ALERT";
BA_ "GenSigSendType" SG_ 1009 RCM2_a317_imuAccXLgMonChlTemp 7;
BA_ "FieldType" SG_ 1009 RCM2_a318_imuAccYLgMonChlPerm "PASSIVE_SAFETY_ALERT";
BA_ "GenSigSendType" SG_ 1009 RCM2_a318_imuAccYLgMonChlPerm 7;
BA_ "FieldType" SG_ 1009 RCM2_a319_imuAccYLgMonChlTemp "PASSIVE_SAFETY_ALERT";
BA_ "GenSigSendType" SG_ 1009 RCM2_a319_imuAccYLgMonChlTemp 7;
BA_ "FieldType" SG_ 1009 RCM2_a320_imuAccZLgMonChlPerm "PASSIVE_SAFETY_ALERT";
BA_ "GenSigSendType" SG_ 1009 RCM2_a320_imuAccZLgMonChlPerm 7;
BA_ "FieldType" SG_ 1009 RCM2_a321_imuAccZLgMonChlTemp "PASSIVE_SAFETY_ALERT";
BA_ "GenSigSendType" SG_ 1009 RCM2_a321_imuAccZLgMonChlTemp 7;
BA_ "FieldType" SG_ 1009 RCM2_a322_imuCalibrationFailed "PASSIVE_SAFETY_ALERT";
BA_ "GenSigSendType" SG_ 1009 RCM2_a322_imuCalibrationFailed 7;
BA_ "FieldType" SG_ 1009 RCM2_a323_imuCalibrationNotDone "PASSIVE_SAFETY_ALERT";
BA_ "GenSigSendType" SG_ 1009 RCM2_a323_imuCalibrationNotDone 7;
BA_ "FieldType" SG_ 1009 RCM2_a350_upFrntSnsrLSht2Gnd "PASSIVE_SAFETY_ALERT";
BA_ "GenSigSendType" SG_ 1009 RCM2_a350_upFrntSnsrLSht2Gnd 7;
BA_ "FieldType" SG_ 1009 RCM2_a351_upFrntSnsrLSht2Bat "PASSIVE_SAFETY_ALERT";
BA_ "GenSigSendType" SG_ 1009 RCM2_a351_upFrntSnsrLSht2Bat 7;
BA_ "FieldType" SG_ 1009 RCM2_a352_upFrntSnsrLOpen "PASSIVE_SAFETY_ALERT";
BA_ "GenSigSendType" SG_ 1009 RCM2_a352_upFrntSnsrLOpen 7;
BA_ "FieldType" SG_ 1009 RCM2_a353_upFrntSnsrLCrssCoup "PASSIVE_SAFETY_ALERT";
BA_ "GenSigSendType" SG_ 1009 RCM2_a353_upFrntSnsrLCrssCoup 7;
BA_ "FieldType" SG_ 1009 RCM2_a354_upFrntSnsrLCommErr "PASSIVE_SAFETY_ALERT";
BA_ "GenSigSendType" SG_ 1009 RCM2_a354_upFrntSnsrLCommErr 7;
BA_ "FieldType" SG_ 1009 RCM2_a355_upFrntSnsrLInitTyp "PASSIVE_SAFETY_ALERT";
BA_ "GenSigSendType" SG_ 1009 RCM2_a355_upFrntSnsrLInitTyp 7;
BA_ "FieldType" SG_ 1009 RCM2_a356_upFrntSnsrLConfig "PASSIVE_SAFETY_ALERT";
BA_ "GenSigSendType" SG_ 1009 RCM2_a356_upFrntSnsrLConfig 7;
BA_ "FieldType" SG_ 1009 RCM2_a357_upFrntSnsrLDefect "PASSIVE_SAFETY_ALERT";
BA_ "GenSigSendType" SG_ 1009 RCM2_a357_upFrntSnsrLDefect 7;
BA_ "FieldType" SG_ 1009 RCM2_a358_upFrntSnsrLSigMon "PASSIVE_SAFETY_ALERT";
BA_ "GenSigSendType" SG_ 1009 RCM2_a358_upFrntSnsrLSigMon 7;
BA_ "FieldType" SG_ 1009 RCM2_a360_upFrntSnsrRSht2Gnd "PASSIVE_SAFETY_ALERT";
BA_ "GenSigSendType" SG_ 1009 RCM2_a360_upFrntSnsrRSht2Gnd 7;
BA_ "FieldType" SG_ 1009 RCM2_a361_upFrntSnsrRSht2Bat "PASSIVE_SAFETY_ALERT";
BA_ "GenSigSendType" SG_ 1009 RCM2_a361_upFrntSnsrRSht2Bat 7;
BA_ "FieldType" SG_ 1009 RCM2_a362_upFrntSnsrROpen "PASSIVE_SAFETY_ALERT";
BA_ "GenSigSendType" SG_ 1009 RCM2_a362_upFrntSnsrROpen 7;
BA_ "FieldType" SG_ 1009 RCM2_a363_upFrntSnsrRCrssCoup "PASSIVE_SAFETY_ALERT";
BA_ "GenSigSendType" SG_ 1009 RCM2_a363_upFrntSnsrRCrssCoup 7;
BA_ "FieldType" SG_ 1009 RCM2_a364_upFrntSnsrRCommErr "PASSIVE_SAFETY_ALERT";
BA_ "GenSigSendType" SG_ 1009 RCM2_a364_upFrntSnsrRCommErr 7;
BA_ "FieldType" SG_ 1009 RCM2_a365_upFrntSnsrRInitTyp "PASSIVE_SAFETY_ALERT";
BA_ "GenSigSendType" SG_ 1009 RCM2_a365_upFrntSnsrRInitTyp 7;
BA_ "FieldType" SG_ 1009 RCM2_a366_upFrntSnsrRConfig "PASSIVE_SAFETY_ALERT";
BA_ "GenSigSendType" SG_ 1009 RCM2_a366_upFrntSnsrRConfig 7;
BA_ "FieldType" SG_ 1009 RCM2_a367_upFrntSnsrRDefect "PASSIVE_SAFETY_ALERT";
BA_ "GenSigSendType" SG_ 1009 RCM2_a367_upFrntSnsrRDefect 7;
BA_ "FieldType" SG_ 1009 RCM2_a368_upFrntSnsrRSigMon "PASSIVE_SAFETY_ALERT";
BA_ "GenSigSendType" SG_ 1009 RCM2_a368_upFrntSnsrRSigMon 7;
BA_ "FieldType" SG_ 1009 RCM2_a370_upFrntSnsrMidLSht2Gnd "PASSIVE_SAFETY_ALERT";
BA_ "GenSigSendType" SG_ 1009 RCM2_a370_upFrntSnsrMidLSht2Gnd 7;
BA_ "FieldType" SG_ 1009 RCM2_a371_upFrntSnsrMidLSht2Bat "PASSIVE_SAFETY_ALERT";
BA_ "GenSigSendType" SG_ 1009 RCM2_a371_upFrntSnsrMidLSht2Bat 7;
BA_ "FieldType" SG_ 1009 RCM2_a372_upFrntSnsrMidLOpen "PASSIVE_SAFETY_ALERT";
BA_ "GenSigSendType" SG_ 1009 RCM2_a372_upFrntSnsrMidLOpen 7;
BA_ "FieldType" SG_ 1009 RCM2_a373_upFrntSnsrMidLCrssCoup "PASSIVE_SAFETY_ALERT";
BA_ "GenSigSendType" SG_ 1009 RCM2_a373_upFrntSnsrMidLCrssCoup 7;
BA_ "FieldType" SG_ 1009 RCM2_a374_upFrntSnsrMidLCommErr "PASSIVE_SAFETY_ALERT";
BA_ "GenSigSendType" SG_ 1009 RCM2_a374_upFrntSnsrMidLCommErr 7;
BA_ "FieldType" SG_ 1009 RCM2_a375_upFrntSnsrMidLInitTyp "PASSIVE_SAFETY_ALERT";
BA_ "GenSigSendType" SG_ 1009 RCM2_a375_upFrntSnsrMidLInitTyp 7;
BA_ "FieldType" SG_ 1009 RCM2_a376_upFrntSnsrMidLConfig "PASSIVE_SAFETY_ALERT";
BA_ "GenSigSendType" SG_ 1009 RCM2_a376_upFrntSnsrMidLConfig 7;
BA_ "FieldType" SG_ 1009 RCM2_a377_upFrntSnsrMidLDefect "PASSIVE_SAFETY_ALERT";
BA_ "GenSigSendType" SG_ 1009 RCM2_a377_upFrntSnsrMidLDefect 7;
BA_ "FieldType" SG_ 1009 RCM2_a378_upFrntSnsrMidLSigMon "PASSIVE_SAFETY_ALERT";
BA_ "GenSigSendType" SG_ 1009 RCM2_a378_upFrntSnsrMidLSigMon 7;
BA_ "FieldType" SG_ 1009 RCM2_a380_upFrntSnsrMidRSht2Gnd "PASSIVE_SAFETY_ALERT";
BA_ "GenSigSendType" SG_ 1009 RCM2_a380_upFrntSnsrMidRSht2Gnd 7;
BA_ "FieldType" SG_ 1009 RCM2_a381_upFrntSnsrMidRSht2Bat "PASSIVE_SAFETY_ALERT";
BA_ "GenSigSendType" SG_ 1009 RCM2_a381_upFrntSnsrMidRSht2Bat 7;
BA_ "FieldType" SG_ 1009 RCM2_a382_upFrntSnsrMidROpen "PASSIVE_SAFETY_ALERT";
BA_ "GenSigSendType" SG_ 1009 RCM2_a382_upFrntSnsrMidROpen 7;
BA_ "FieldType" SG_ 1009 RCM2_a383_upFrntSnsrMidRCrssCoup "PASSIVE_SAFETY_ALERT";
BA_ "GenSigSendType" SG_ 1009 RCM2_a383_upFrntSnsrMidRCrssCoup 7;
BA_ "FieldType" SG_ 1009 RCM2_a384_upFrntSnsrMidRCommErr "PASSIVE_SAFETY_ALERT";
BA_ "GenSigSendType" SG_ 1009 RCM2_a384_upFrntSnsrMidRCommErr 7;
BA_ "FieldType" SG_ 1009 RCM2_a385_upFrntSnsrMidRInitTyp "PASSIVE_SAFETY_ALERT";
BA_ "GenSigSendType" SG_ 1009 RCM2_a385_upFrntSnsrMidRInitTyp 7;
BA_ "FieldType" SG_ 1009 RCM2_a386_upFrntSnsrMidRConfig "PASSIVE_SAFETY_ALERT";
BA_ "GenSigSendType" SG_ 1009 RCM2_a386_upFrntSnsrMidRConfig 7;
BA_ "FieldType" SG_ 1009 RCM2_a387_upFrntSnsrMidRDefect "PASSIVE_SAFETY_ALERT";
BA_ "GenSigSendType" SG_ 1009 RCM2_a387_upFrntSnsrMidRDefect 7;
BA_ "FieldType" SG_ 1009 RCM2_a388_upFrntSnsrMidRSigMon "PASSIVE_SAFETY_ALERT";
BA_ "GenSigSendType" SG_ 1009 RCM2_a388_upFrntSnsrMidRSigMon 7;
BA_ "FieldType" SG_ 1009 RCM2_a390_sideAccelBPilLSht2Gnd "PASSIVE_SAFETY_ALERT";
BA_ "GenSigSendType" SG_ 1009 RCM2_a390_sideAccelBPilLSht2Gnd 7;
BA_ "FieldType" SG_ 1009 RCM2_a391_sideAccelBPilLSht2Bat "PASSIVE_SAFETY_ALERT";
BA_ "GenSigSendType" SG_ 1009 RCM2_a391_sideAccelBPilLSht2Bat 7;
BA_ "FieldType" SG_ 1009 RCM2_a392_sideAccelBPilLOpen "PASSIVE_SAFETY_ALERT";
BA_ "GenSigSendType" SG_ 1009 RCM2_a392_sideAccelBPilLOpen 7;
BA_ "FieldType" SG_ 1009 RCM2_a393_sideAccelBPilLCLosCoup "PASSIVE_SAFETY_ALERT";
BA_ "GenSigSendType" SG_ 1009 RCM2_a393_sideAccelBPilLCLosCoup 7;
BA_ "FieldType" SG_ 1009 RCM2_a394_sideAccelBPilLCommErr "PASSIVE_SAFETY_ALERT";
BA_ "GenSigSendType" SG_ 1009 RCM2_a394_sideAccelBPilLCommErr 7;
BA_ "FieldType" SG_ 1009 RCM2_a395_sideAccelBPilLInitTyp "PASSIVE_SAFETY_ALERT";
BA_ "GenSigSendType" SG_ 1009 RCM2_a395_sideAccelBPilLInitTyp 7;
BA_ "FieldType" SG_ 1009 RCM2_a396_sideAccelBPilLConfig "PASSIVE_SAFETY_ALERT";
BA_ "GenSigSendType" SG_ 1009 RCM2_a396_sideAccelBPilLConfig 7;
BA_ "FieldType" SG_ 1009 RCM2_a397_sideAccelBPilLDefect "PASSIVE_SAFETY_ALERT";
BA_ "GenSigSendType" SG_ 1009 RCM2_a397_sideAccelBPilLDefect 7;
BA_ "FieldType" SG_ 1009 RCM2_a398_sideAccelBPilLSigMon "PASSIVE_SAFETY_ALERT";
BA_ "GenSigSendType" SG_ 1009 RCM2_a398_sideAccelBPilLSigMon 7;
BA_ "FieldType" SG_ 1009 RCM2_a400_sideAccelBPilRSht2Gnd "PASSIVE_SAFETY_ALERT";
BA_ "GenSigSendType" SG_ 1009 RCM2_a400_sideAccelBPilRSht2Gnd 7;
BA_ "FieldType" SG_ 1009 RCM2_a401_sideAccelBPilRSht2Bat "PASSIVE_SAFETY_ALERT";
BA_ "GenSigSendType" SG_ 1009 RCM2_a401_sideAccelBPilRSht2Bat 7;
BA_ "FieldType" SG_ 1009 RCM2_a402_sideAccelBPilROpen "PASSIVE_SAFETY_ALERT";
BA_ "GenSigSendType" SG_ 1009 RCM2_a402_sideAccelBPilROpen 7;
BA_ "FieldType" SG_ 1009 RCM2_a403_sideAccelBPilRCrssCoup "PASSIVE_SAFETY_ALERT";
BA_ "GenSigSendType" SG_ 1009 RCM2_a403_sideAccelBPilRCrssCoup 7;
BA_ "FieldType" SG_ 1009 RCM2_a404_sideAccelBPilRCommErr "PASSIVE_SAFETY_ALERT";
BA_ "GenSigSendType" SG_ 1009 RCM2_a404_sideAccelBPilRCommErr 7;
BA_ "FieldType" SG_ 1009 RCM2_a405_sideAccelBPilRInitTyp "PASSIVE_SAFETY_ALERT";
BA_ "GenSigSendType" SG_ 1009 RCM2_a405_sideAccelBPilRInitTyp 7;
BA_ "FieldType" SG_ 1009 RCM2_a406_sideAccelBPilRConfig "PASSIVE_SAFETY_ALERT";
BA_ "GenSigSendType" SG_ 1009 RCM2_a406_sideAccelBPilRConfig 7;
BA_ "FieldType" SG_ 1009 RCM2_a407_sideAccelBPilRDefect "PASSIVE_SAFETY_ALERT";
BA_ "GenSigSendType" SG_ 1009 RCM2_a407_sideAccelBPilRDefect 7;
BA_ "FieldType" SG_ 1009 RCM2_a408_sideAccelBPilRSigMon "PASSIVE_SAFETY_ALERT";
BA_ "GenSigSendType" SG_ 1009 RCM2_a408_sideAccelBPilRSigMon 7;
BA_ "FieldType" SG_ 1009 RCM2_a410_sideAccelCPilLSht2Gnd "PASSIVE_SAFETY_ALERT";
BA_ "GenSigSendType" SG_ 1009 RCM2_a410_sideAccelCPilLSht2Gnd 7;
BA_ "FieldType" SG_ 1009 RCM2_a411_sideAccelCPilLSht2Bat "PASSIVE_SAFETY_ALERT";
BA_ "GenSigSendType" SG_ 1009 RCM2_a411_sideAccelCPilLSht2Bat 7;
BA_ "FieldType" SG_ 1009 RCM2_a412_sideAccelCPilLOpen "PASSIVE_SAFETY_ALERT";
BA_ "GenSigSendType" SG_ 1009 RCM2_a412_sideAccelCPilLOpen 7;
BA_ "FieldType" SG_ 1009 RCM2_a413_sideAccelCPilLCrssCoup "PASSIVE_SAFETY_ALERT";
BA_ "GenSigSendType" SG_ 1009 RCM2_a413_sideAccelCPilLCrssCoup 7;
BA_ "FieldType" SG_ 1009 RCM2_a414_sideAccelCPilLCommErr "PASSIVE_SAFETY_ALERT";
BA_ "GenSigSendType" SG_ 1009 RCM2_a414_sideAccelCPilLCommErr 7;
BA_ "FieldType" SG_ 1009 RCM2_a415_sideAccelCPilLInitTyp "PASSIVE_SAFETY_ALERT";
BA_ "GenSigSendType" SG_ 1009 RCM2_a415_sideAccelCPilLInitTyp 7;
BA_ "FieldType" SG_ 1009 RCM2_a416_sideAccelCPilLConfig "PASSIVE_SAFETY_ALERT";
BA_ "GenSigSendType" SG_ 1009 RCM2_a416_sideAccelCPilLConfig 7;
BA_ "FieldType" SG_ 1009 RCM2_a417_sideAccelCPilLDefect "PASSIVE_SAFETY_ALERT";
BA_ "GenSigSendType" SG_ 1009 RCM2_a417_sideAccelCPilLDefect 7;
BA_ "FieldType" SG_ 1009 RCM2_a418_sideAccelCPilLSigMon "PASSIVE_SAFETY_ALERT";
BA_ "GenSigSendType" SG_ 1009 RCM2_a418_sideAccelCPilLSigMon 7;
BA_ "FieldType" SG_ 1009 RCM2_a420_sideAccelCPilRSht2Gnd "PASSIVE_SAFETY_ALERT";
BA_ "GenSigSendType" SG_ 1009 RCM2_a420_sideAccelCPilRSht2Gnd 7;
BA_ "FieldType" SG_ 1009 RCM2_a421_sideAccelCPilRSht2Bat "PASSIVE_SAFETY_ALERT";
BA_ "GenSigSendType" SG_ 1009 RCM2_a421_sideAccelCPilRSht2Bat 7;
BA_ "FieldType" SG_ 1009 RCM2_a422_sideAccelCPilROpen "PASSIVE_SAFETY_ALERT";
BA_ "GenSigSendType" SG_ 1009 RCM2_a422_sideAccelCPilROpen 7;
BA_ "FieldType" SG_ 1009 RCM2_a423_sideAccelCPilRCrssCoup "PASSIVE_SAFETY_ALERT";
BA_ "GenSigSendType" SG_ 1009 RCM2_a423_sideAccelCPilRCrssCoup 7;
BA_ "FieldType" SG_ 1009 RCM2_a424_sideAccelCPilRCommErr "PASSIVE_SAFETY_ALERT";
BA_ "GenSigSendType" SG_ 1009 RCM2_a424_sideAccelCPilRCommErr 7;
BA_ "FieldType" SG_ 1009 RCM2_a425_sideAccelCPilRInitTyp "PASSIVE_SAFETY_ALERT";
BA_ "GenSigSendType" SG_ 1009 RCM2_a425_sideAccelCPilRInitTyp 7;
BA_ "FieldType" SG_ 1009 RCM2_a426_sideAccelCPilRConfig "PASSIVE_SAFETY_ALERT";
BA_ "GenSigSendType" SG_ 1009 RCM2_a426_sideAccelCPilRConfig 7;
BA_ "FieldType" SG_ 1009 RCM2_a427_sideAccelCPilRDefect "PASSIVE_SAFETY_ALERT";
BA_ "GenSigSendType" SG_ 1009 RCM2_a427_sideAccelCPilRDefect 7;
BA_ "FieldType" SG_ 1009 RCM2_a428_sideAccelCPilRSigMon "PASSIVE_SAFETY_ALERT";
BA_ "GenSigSendType" SG_ 1009 RCM2_a428_sideAccelCPilRSigMon 7;
BA_ "FieldType" SG_ 1009 RCM2_a430_presFrntLDoorSht2Gnd "PASSIVE_SAFETY_ALERT";
BA_ "GenSigSendType" SG_ 1009 RCM2_a430_presFrntLDoorSht2Gnd 7;
BA_ "FieldType" SG_ 1009 RCM2_a431_presFrntLDoorSht2Bat "PASSIVE_SAFETY_ALERT";
BA_ "GenSigSendType" SG_ 1009 RCM2_a431_presFrntLDoorSht2Bat 7;
BA_ "FieldType" SG_ 1009 RCM2_a432_presFrntLDoorOpen "PASSIVE_SAFETY_ALERT";
BA_ "GenSigSendType" SG_ 1009 RCM2_a432_presFrntLDoorOpen 7;
BA_ "FieldType" SG_ 1009 RCM2_a433_presFrntLDoorCrssCoup "PASSIVE_SAFETY_ALERT";
BA_ "GenSigSendType" SG_ 1009 RCM2_a433_presFrntLDoorCrssCoup 7;
BA_ "FieldType" SG_ 1009 RCM2_a434_presFrntLDoorCommErr "PASSIVE_SAFETY_ALERT";
BA_ "GenSigSendType" SG_ 1009 RCM2_a434_presFrntLDoorCommErr 7;
BA_ "FieldType" SG_ 1009 RCM2_a435_presFrntLDoorInitTyp "PASSIVE_SAFETY_ALERT";
BA_ "GenSigSendType" SG_ 1009 RCM2_a435_presFrntLDoorInitTyp 7;
BA_ "FieldType" SG_ 1009 RCM2_a436_presFrntLDoorConfig "PASSIVE_SAFETY_ALERT";
BA_ "GenSigSendType" SG_ 1009 RCM2_a436_presFrntLDoorConfig 7;
BA_ "FieldType" SG_ 1009 RCM2_a437_presFrntLDoorDefect "PASSIVE_SAFETY_ALERT";
BA_ "GenSigSendType" SG_ 1009 RCM2_a437_presFrntLDoorDefect 7;
BA_ "FieldType" SG_ 1009 RCM2_a438_presFrntLDoorSigMon "PASSIVE_SAFETY_ALERT";
BA_ "GenSigSendType" SG_ 1009 RCM2_a438_presFrntLDoorSigMon 7;
BA_ "FieldType" SG_ 1009 RCM2_a439_presDoorAbsolute1 "PASSIVE_SAFETY_ALERT";
BA_ "GenSigSendType" SG_ 1009 RCM2_a439_presDoorAbsolute1 7;
BA_ "FieldType" SG_ 1009 RCM2_a440_presFrntRDoorSht2Gnd "PASSIVE_SAFETY_ALERT";
BA_ "GenSigSendType" SG_ 1009 RCM2_a440_presFrntRDoorSht2Gnd 7;
BA_ "FieldType" SG_ 1009 RCM2_a441_presFrntRDoorSht2Bat "PASSIVE_SAFETY_ALERT";
BA_ "GenSigSendType" SG_ 1009 RCM2_a441_presFrntRDoorSht2Bat 7;
BA_ "FieldType" SG_ 1009 RCM2_a442_presFrntRDoorOpen "PASSIVE_SAFETY_ALERT";
BA_ "GenSigSendType" SG_ 1009 RCM2_a442_presFrntRDoorOpen 7;
BA_ "FieldType" SG_ 1009 RCM2_a443_presFrntRDoorCrssCoup "PASSIVE_SAFETY_ALERT";
BA_ "GenSigSendType" SG_ 1009 RCM2_a443_presFrntRDoorCrssCoup 7;
BA_ "FieldType" SG_ 1009 RCM2_a444_presFrntRDoorCommErr "PASSIVE_SAFETY_ALERT";
BA_ "GenSigSendType" SG_ 1009 RCM2_a444_presFrntRDoorCommErr 7;
BA_ "FieldType" SG_ 1009 RCM2_a445_presFrntRDoorInitTyp "PASSIVE_SAFETY_ALERT";
BA_ "GenSigSendType" SG_ 1009 RCM2_a445_presFrntRDoorInitTyp 7;
BA_ "FieldType" SG_ 1009 RCM2_a446_presFrntRDoorConfig "PASSIVE_SAFETY_ALERT";
BA_ "GenSigSendType" SG_ 1009 RCM2_a446_presFrntRDoorConfig 7;
BA_ "FieldType" SG_ 1009 RCM2_a447_presFrntRDoorDefect "PASSIVE_SAFETY_ALERT";
BA_ "GenSigSendType" SG_ 1009 RCM2_a447_presFrntRDoorDefect 7;
BA_ "FieldType" SG_ 1009 RCM2_a448_presFrntRDoorSigMon "PASSIVE_SAFETY_ALERT";
BA_ "GenSigSendType" SG_ 1009 RCM2_a448_presFrntRDoorSigMon 7;
BA_ "FieldType" SG_ 1009 RCM2_a449_presDoorAbsolute2 "PASSIVE_SAFETY_ALERT";
BA_ "GenSigSendType" SG_ 1009 RCM2_a449_presDoorAbsolute2 7;
BA_ "FieldType" SG_ 1009 RCM2_a450_presPedProLSht2Gnd "PASSIVE_SAFETY_ALERT";
BA_ "GenSigSendType" SG_ 1009 RCM2_a450_presPedProLSht2Gnd 7;
BA_ "FieldType" SG_ 1009 RCM2_a451_presPedProLSht2Bat "PASSIVE_SAFETY_ALERT";
BA_ "GenSigSendType" SG_ 1009 RCM2_a451_presPedProLSht2Bat 7;
BA_ "FieldType" SG_ 1009 RCM2_a452_presPedProLOpen "PASSIVE_SAFETY_ALERT";
BA_ "GenSigSendType" SG_ 1009 RCM2_a452_presPedProLOpen 7;
BA_ "FieldType" SG_ 1009 RCM2_a453_presPedProLCrssCoup "PASSIVE_SAFETY_ALERT";
BA_ "GenSigSendType" SG_ 1009 RCM2_a453_presPedProLCrssCoup 7;
BA_ "FieldType" SG_ 1009 RCM2_a454_presPedProLCommErr "PASSIVE_SAFETY_ALERT";
BA_ "GenSigSendType" SG_ 1009 RCM2_a454_presPedProLCommErr 7;
BA_ "FieldType" SG_ 1009 RCM2_a455_presPedProLInitTyp "PASSIVE_SAFETY_ALERT";
BA_ "GenSigSendType" SG_ 1009 RCM2_a455_presPedProLInitTyp 7;
BA_ "FieldType" SG_ 1009 RCM2_a456_presPedProLConfig "PASSIVE_SAFETY_ALERT";
BA_ "GenSigSendType" SG_ 1009 RCM2_a456_presPedProLConfig 7;
BA_ "FieldType" SG_ 1009 RCM2_a457_presPedProLDefect "PASSIVE_SAFETY_ALERT";
BA_ "GenSigSendType" SG_ 1009 RCM2_a457_presPedProLDefect 7;
BA_ "FieldType" SG_ 1009 RCM2_a458_presPedProLSigMon "PASSIVE_SAFETY_ALERT";
BA_ "GenSigSendType" SG_ 1009 RCM2_a458_presPedProLSigMon 7;
BA_ "FieldType" SG_ 1009 RCM2_a460_presPedProRSht2Gnd "PASSIVE_SAFETY_ALERT";
BA_ "GenSigSendType" SG_ 1009 RCM2_a460_presPedProRSht2Gnd 7;
BA_ "FieldType" SG_ 1009 RCM2_a461_presPedProRSht2Bat "PASSIVE_SAFETY_ALERT";
BA_ "GenSigSendType" SG_ 1009 RCM2_a461_presPedProRSht2Bat 7;
BA_ "FieldType" SG_ 1009 RCM2_a462_presPedProROpen "PASSIVE_SAFETY_ALERT";
BA_ "GenSigSendType" SG_ 1009 RCM2_a462_presPedProROpen 7;
BA_ "FieldType" SG_ 1009 RCM2_a463_presPedProRCrssCoup "PASSIVE_SAFETY_ALERT";
BA_ "GenSigSendType" SG_ 1009 RCM2_a463_presPedProRCrssCoup 7;
BA_ "FieldType" SG_ 1009 RCM2_a464_presPedProRCommErr "PASSIVE_SAFETY_ALERT";
BA_ "GenSigSendType" SG_ 1009 RCM2_a464_presPedProRCommErr 7;
BA_ "FieldType" SG_ 1009 RCM2_a465_presPedProRInitTyp "PASSIVE_SAFETY_ALERT";
BA_ "GenSigSendType" SG_ 1009 RCM2_a465_presPedProRInitTyp 7;
BA_ "FieldType" SG_ 1009 RCM2_a466_presPedProRConfig "PASSIVE_SAFETY_ALERT";
BA_ "GenSigSendType" SG_ 1009 RCM2_a466_presPedProRConfig 7;
BA_ "FieldType" SG_ 1009 RCM2_a467_presPedProRDefect "PASSIVE_SAFETY_ALERT";
BA_ "GenSigSendType" SG_ 1009 RCM2_a467_presPedProRDefect 7;
BA_ "FieldType" SG_ 1009 RCM2_a468_presPedProRSigMon "PASSIVE_SAFETY_ALERT";
BA_ "GenSigSendType" SG_ 1009 RCM2_a468_presPedProRSigMon 7;
BA_ "FieldType" SG_ 1009 RCM2_a469_presPedProAbsolute "PASSIVE_SAFETY_ALERT";
BA_ "GenSigSendType" SG_ 1009 RCM2_a469_presPedProAbsolute 7;
BA_ "FieldType" SG_ 1009 RCM2_a470_upFrntPedProLSht2Gnd "PASSIVE_SAFETY_ALERT";
BA_ "GenSigSendType" SG_ 1009 RCM2_a470_upFrntPedProLSht2Gnd 7;
BA_ "FieldType" SG_ 1009 RCM2_a471_upFrntPedProLSht2Bat "PASSIVE_SAFETY_ALERT";
BA_ "GenSigSendType" SG_ 1009 RCM2_a471_upFrntPedProLSht2Bat 7;
BA_ "FieldType" SG_ 1009 RCM2_a472_upFrntPedProLOpen "PASSIVE_SAFETY_ALERT";
BA_ "GenSigSendType" SG_ 1009 RCM2_a472_upFrntPedProLOpen 7;
BA_ "FieldType" SG_ 1009 RCM2_a473_upFrntPedProLCrssCoup "PASSIVE_SAFETY_ALERT";
BA_ "GenSigSendType" SG_ 1009 RCM2_a473_upFrntPedProLCrssCoup 7;
BA_ "FieldType" SG_ 1009 RCM2_a474_upFrntPedProLCommErr "PASSIVE_SAFETY_ALERT";
BA_ "GenSigSendType" SG_ 1009 RCM2_a474_upFrntPedProLCommErr 7;
BA_ "FieldType" SG_ 1009 RCM2_a475_upFrntPedProLIntTyp "PASSIVE_SAFETY_ALERT";
BA_ "GenSigSendType" SG_ 1009 RCM2_a475_upFrntPedProLIntTyp 7;
BA_ "FieldType" SG_ 1009 RCM2_a476_upFrntPedProLConfig "PASSIVE_SAFETY_ALERT";
BA_ "GenSigSendType" SG_ 1009 RCM2_a476_upFrntPedProLConfig 7;
BA_ "FieldType" SG_ 1009 RCM2_a477_upFrntPedProLDefect "PASSIVE_SAFETY_ALERT";
BA_ "GenSigSendType" SG_ 1009 RCM2_a477_upFrntPedProLDefect 7;
BA_ "FieldType" SG_ 1009 RCM2_a478_upFrntPedProSht2Gnd "PASSIVE_SAFETY_ALERT";
BA_ "GenSigSendType" SG_ 1009 RCM2_a478_upFrntPedProSht2Gnd 7;
BA_ "FieldType" SG_ 1009 RCM2_a480_upFrntPedProRSht2Gnd "PASSIVE_SAFETY_ALERT";
BA_ "GenSigSendType" SG_ 1009 RCM2_a480_upFrntPedProRSht2Gnd 7;
BA_ "FieldType" SG_ 1009 RCM2_a481_upFrntPedProRSht2Bat "PASSIVE_SAFETY_ALERT";
BA_ "GenSigSendType" SG_ 1009 RCM2_a481_upFrntPedProRSht2Bat 7;
BA_ "FieldType" SG_ 1009 RCM2_a482_upFrntPedProROpen "PASSIVE_SAFETY_ALERT";
BA_ "GenSigSendType" SG_ 1009 RCM2_a482_upFrntPedProROpen 7;
BA_ "FieldType" SG_ 1009 RCM2_a483_upFrntPedProRCrssCoup "PASSIVE_SAFETY_ALERT";
BA_ "GenSigSendType" SG_ 1009 RCM2_a483_upFrntPedProRCrssCoup 7;
BA_ "FieldType" SG_ 1009 RCM2_a484_upFrntPedProRCommErr "PASSIVE_SAFETY_ALERT";
BA_ "GenSigSendType" SG_ 1009 RCM2_a484_upFrntPedProRCommErr 7;
BA_ "FieldType" SG_ 1009 RCM2_a485_upFrntPedProRIntTyp "PASSIVE_SAFETY_ALERT";
BA_ "GenSigSendType" SG_ 1009 RCM2_a485_upFrntPedProRIntTyp 7;
BA_ "FieldType" SG_ 1009 RCM2_a486_upFrntPedProRConfig "PASSIVE_SAFETY_ALERT";
BA_ "GenSigSendType" SG_ 1009 RCM2_a486_upFrntPedProRConfig 7;
BA_ "FieldType" SG_ 1009 RCM2_a487_upFrntPedProRDefect "PASSIVE_SAFETY_ALERT";
BA_ "GenSigSendType" SG_ 1009 RCM2_a487_upFrntPedProRDefect 7;
BA_ "FieldType" SG_ 1009 RCM2_a488_upFrntPedProSht2Gnd "PASSIVE_SAFETY_ALERT";
BA_ "GenSigSendType" SG_ 1009 RCM2_a488_upFrntPedProSht2Gnd 7;
BA_ "FieldType" SG_ 1009 RCM2_a550_bucklHallLeftSht2Gnd "PASSIVE_SAFETY_ALERT";
BA_ "GenSigSendType" SG_ 1009 RCM2_a550_bucklHallLeftSht2Gnd 7;
BA_ "FieldType" SG_ 1009 RCM2_a551_bucklHallLeftSht2Bat "PASSIVE_SAFETY_ALERT";
BA_ "GenSigSendType" SG_ 1009 RCM2_a551_bucklHallLeftSht2Bat 7;
BA_ "FieldType" SG_ 1009 RCM2_a552_bucklHallLeftOpen "PASSIVE_SAFETY_ALERT";
BA_ "GenSigSendType" SG_ 1009 RCM2_a552_bucklHallLeftOpen 7;
BA_ "FieldType" SG_ 1009 RCM2_a553_bucklHallLeftUndef "PASSIVE_SAFETY_ALERT";
BA_ "GenSigSendType" SG_ 1009 RCM2_a553_bucklHallLeftUndef 7;
BA_ "FieldType" SG_ 1009 RCM2_a554_bucklHallLeftCrssCoup "PASSIVE_SAFETY_ALERT";
BA_ "GenSigSendType" SG_ 1009 RCM2_a554_bucklHallLeftCrssCoup 7;
BA_ "FieldType" SG_ 1009 RCM2_a555_bucklHallLeftConfig "PASSIVE_SAFETY_ALERT";
BA_ "GenSigSendType" SG_ 1009 RCM2_a555_bucklHallLeftConfig 7;
BA_ "FieldType" SG_ 1009 RCM2_a556_bucklHallRightSht2Gnd "PASSIVE_SAFETY_ALERT";
BA_ "GenSigSendType" SG_ 1009 RCM2_a556_bucklHallRightSht2Gnd 7;
BA_ "FieldType" SG_ 1009 RCM2_a557_bucklHallRightSht2Bat "PASSIVE_SAFETY_ALERT";
BA_ "GenSigSendType" SG_ 1009 RCM2_a557_bucklHallRightSht2Bat 7;
BA_ "FieldType" SG_ 1009 RCM2_a558_bucklHallRightOpen "PASSIVE_SAFETY_ALERT";
BA_ "GenSigSendType" SG_ 1009 RCM2_a558_bucklHallRightOpen 7;
BA_ "FieldType" SG_ 1009 RCM2_a559_bucklHallRightUndef "PASSIVE_SAFETY_ALERT";
BA_ "GenSigSendType" SG_ 1009 RCM2_a559_bucklHallRightUndef 7;
BA_ "FieldType" SG_ 1009 RCM2_a560_bucklHallRightCrssCoup "PASSIVE_SAFETY_ALERT";
BA_ "GenSigSendType" SG_ 1009 RCM2_a560_bucklHallRightCrssCoup 7;
BA_ "FieldType" SG_ 1009 RCM2_a561_bucklHallRightConfig "PASSIVE_SAFETY_ALERT";
BA_ "GenSigSendType" SG_ 1009 RCM2_a561_bucklHallRightConfig 7;
BA_ "FieldType" SG_ 1009 RCM2_a562_seaTrkPosLeftSht2Gnd "PASSIVE_SAFETY_ALERT";
BA_ "GenSigSendType" SG_ 1009 RCM2_a562_seaTrkPosLeftSht2Gnd 7;
BA_ "FieldType" SG_ 1009 RCM2_a563_seaTrkPosLeftShtBat "PASSIVE_SAFETY_ALERT";
BA_ "GenSigSendType" SG_ 1009 RCM2_a563_seaTrkPosLeftShtBat 7;
BA_ "FieldType" SG_ 1009 RCM2_a564_seaTrkPosLeftOpen "PASSIVE_SAFETY_ALERT";
BA_ "GenSigSendType" SG_ 1009 RCM2_a564_seaTrkPosLeftOpen 7;
BA_ "FieldType" SG_ 1009 RCM2_a565_seaTrkPosLeftUndefined "PASSIVE_SAFETY_ALERT";
BA_ "GenSigSendType" SG_ 1009 RCM2_a565_seaTrkPosLeftUndefined 7;
BA_ "FieldType" SG_ 1009 RCM2_a566_seaTrkPosLeftCrssCoup "PASSIVE_SAFETY_ALERT";
BA_ "GenSigSendType" SG_ 1009 RCM2_a566_seaTrkPosLeftCrssCoup 7;
VAL_ 1249 RCM2_alertID 994 "RCM2_a994_internalFault_145" 993 "RCM2_a993_internalFault_144" 992 "RCM2_a992_internalFault_143" 991 "RCM2_a991_internalFault_142" 990 "RCM2_a990_internalFault_141" 989 "RCM2_a989_internalFault_140" 988 "RCM2_a988_internalFault_139" 987 "RCM2_a987_internalFault_138" 986 "RCM2_a986_internalFault_137" 985 "RCM2_a985_internalFault_136" 984 "RCM2_a984_internalFault_135" 983 "RCM2_a983_internalFault_134" 982 "RCM2_a982_internalFault_133" 981 "RCM2_a981_internalFault_132" 980 "RCM2_a980_internalFault_131" 979 "RCM2_a979_internalFault_130" 978 "RCM2_a978_internalFault_129" 977 "RCM2_a977_internalFault_128" 976 "RCM2_a976_internalFault_127" 975 "RCM2_a975_internalFault_126" 974 "RCM2_a974_internalFault_125" 973 "RCM2_a973_internalFault_124" 972 "RCM2_a972_internalFault_123" 971 "RCM2_a971_internalFault_122" 970 "RCM2_a970_internalFault_121" 969 "RCM2_a969_internalFault_120" 968 "RCM2_a968_internalFault_119" 967 "RCM2_a967_internalFault_118" 966 "RCM2_a966_internalFault_117" 965 "RCM2_a965_internalFault_116" 964 "RCM2_a964_internalFault_115" 963 "RCM2_a963_internalFault_114" 962 "RCM2_a962_internalFault_113" 961 "RCM2_a961_internalFault_112" 960 "RCM2_a960_internalFault_111" 959 "RCM2_a959_internalFault_110" 958 "RCM2_a958_internalFault_109" 957 "RCM2_a957_internalFault_108" 956 "RCM2_a956_internalFault_107" 955 "RCM2_a955_internalFault_106" 954 "RCM2_a954_internalFault_105" 953 "RCM2_a953_internalFault_104" 952 "RCM2_a952_internalFault_103" 951 "RCM2_a951_internalFault_102" 950 "RCM2_a950_internalFault_101" 949 "RCM2_a949_internalFault_100" 948 "RCM2_a948_internalFault_099" 947 "RCM2_a947_internalFault_098" 946 "RCM2_a946_internalFault_097" 945 "RCM2_a945_internalFault_096" 944 "RCM2_a944_internalFault_095" 943 "RCM2_a943_internalFault_094" 942 "RCM2_a942_internalFault_093" 941 "RCM2_a941_internalFault_092" 940 "RCM2_a940_internalFault_091" 939 "RCM2_a939_internalFault_090" 938 "RCM2_a938_internalFault_089" 937 "RCM2_a937_internalFault_088" 936 "RCM2_a936_internalFault_087" 935 "RCM2_a935_internalFault_086" 934 "RCM2_a934_internalFault_085" 933 "RCM2_a933_internalFault_084" 932 "RCM2_a932_internalFault_083" 931 "RCM2_a931_internalFault_082" 930 "RCM2_a930_internalFault_081" 929 "RCM2_a929_internalFault_080" 928 "RCM2_a928_internalFault_079" 927 "RCM2_a927_internalFault_078" 926 "RCM2_a926_internalFault_077" 925 "RCM2_a925_internalFault_076" 924 "RCM2_a924_internalFault_075" 923 "RCM2_a923_internalFault_074" 922 "RCM2_a922_internalFault_073" 921 "RCM2_a921_internalFault_072" 920 "RCM2_a920_internalFault_071" 919 "RCM2_a919_internalFault_070" 918 "RCM2_a918_internalFault_069" 917 "RCM2_a917_internalFault_068" 916 "RCM2_a916_internalFault_067" 915 "RCM2_a915_internalFault_066" 914 "RCM2_a914_internalFault_065" 913 "RCM2_a913_internalFault_064" 912 "RCM2_a912_internalFault_063" 911 "RCM2_a911_internalFault_062" 910 "RCM2_a910_internalFault_061" 909 "RCM2_a909_internalFault_060" 908 "RCM2_a908_internalFault_059" 907 "RCM2_a907_internalFault_058" 906 "RCM2_a906_internalFault_057" 905 "RCM2_a905_internalFault_056" 904 "RCM2_a904_internalFault_055" 903 "RCM2_a903_internalFault_054" 902 "RCM2_a902_internalFault_053" 901 "RCM2_a901_internalFault_052" 900 "RCM2_a900_internalFault_051" 899 "RCM2_a899_internalFault_050" 898 "RCM2_a898_internalFault_049" 897 "RCM2_a897_internalFault_048" 896 "RCM2_a896_internalFault_047" 895 "RCM2_a895_internalFault_046" 894 "RCM2_a894_internalFault_045" 893 "RCM2_a893_internalFault_044" 892 "RCM2_a892_internalFault_043" 891 "RCM2_a891_internalFault_042" 890 "RCM2_a890_internalFault_041" 889 "RCM2_a889_internalFault_040" 888 "RCM2_a888_internalFault_039" 887 "RCM2_a887_internalFault_038" 886 "RCM2_a886_internalFault_037" 885 "RCM2_a885_internalFault_036" 884 "RCM2_a884_internalFault_035" 883 "RCM2_a883_internalFault_034" 882 "RCM2_a882_internalFault_033" 881 "RCM2_a881_internalFault_032" 880 "RCM2_a880_internalFault_031" 879 "RCM2_a879_internalFault_030" 878 "RCM2_a878_internalFault_029" 877 "RCM2_a877_internalFault_028" 876 "RCM2_a876_internalFault_027" 875 "RCM2_a875_internalFault_026" 874 "RCM2_a874_internalFault_025" 873 "RCM2_a873_internalFault_024" 872 "RCM2_a872_internalFault_023" 871 "RCM2_a871_internalFault_022" 870 "RCM2_a870_internalFault_021" 869 "RCM2_a869_internalFault_020" 868 "RCM2_a868_internalFault_019" 867 "RCM2_a867_internalFault_018" 866 "RCM2_a866_internalFault_017" 865 "RCM2_a865_internalFault_016" 864 "RCM2_a864_internalFault_015" 863 "RCM2_a863_internalFault_014" 862 "RCM2_a862_internalFault_013" 861 "RCM2_a861_internalFault_012" 860 "RCM2_a860_internalFault_011" 859 "RCM2_a859_internalFault_010" 858 "RCM2_a858_internalFault_009" 857 "RCM2_a857_internalFault_008" 856 "RCM2_a856_internalFault_007" 855 "RCM2_a855_internalFault_006" 854 "RCM2_a854_internalFault_005" 853 "RCM2_a853_internalFault_004" 852 "RCM2_a852_internalFault_003" 851 "RCM2_a851_internalFault_002" 850 "RCM2_a850_internalFault_001" 817 "RCM2_a817_bootActionsFailed" 816 "RCM2_a816_driveLeaningMismatch" 815 "RCM2_a815_driveLeaningNotDone" 814 "RCM2_a814_vinMismatch" 813 "RCM2_a813_vinNotProgrammed" 812 "RCM2_a812_swVersionWrong" 811 "RCM2_a811_cfgConfigDataInconsist" 810 "RCM2_a810_cfgAlgoVerifySnsrID" 809 "RCM2_a809_cfgInvalParamTransID" 808 "RCM2_a808_cfgInvalParamLayoutID" 807 "RCM2_a807_cfgExternalCRCError" 806 "RCM2_a806_cfgCrashCalPNmissing" 805 "RCM2_a805_cfgPedProNotProgrammed" 804 "RCM2_a804_cfgNotProgrammed" 803 "RCM2_a803_cfgNotConfigured" 802 "RCM2_a802_cfgInvalidConfig" 801 "RCM2_a801_cfgImplausConfig" 800 "RCM2_a800_cfgMissingCalibration" 750 "RCM2_a750_linInternalTimeout" 655 "RCM2_a655_comGTWESP1Cntr" 654 "RCM2_a654_comGTWESP1ChkSm" 653 "RCM2_a653_comGTWESP1MIA" 652 "RCM2_a652_ambientTempFaulted" 651 "RCM2_a651_comDIstate2Cntr" 650 "RCM2_a650_comDIstate2ChkSm" 649 "RCM2_a649_comDIstate2MIA" 648 "RCM2_a648_comDIstateCntr" 647 "RCM2_a647_comDIstateChkSm" 646 "RCM2_a646_comDIstateMIA" 645 "RCM2_a645_comDASSafetyFrntCntr" 644 "RCM2_a644_comDASSafetyFrntChkSm" 643 "RCM2_a643_comDASSafetyFrntMIA" 642 "RCM2_a642_comVINmessageMIA" 641 "RCM2_a641_comGTWCarConfigMIA" 640 "RCM2_a640_comTPMSStatusCMIA" 639 "RCM2_a639_comGTWCarStateMIA" 638 "RCM2_a638_comGTWodoMIA" 637 "RCM2_a637_ocsUnknown" 636 "RCM2_a636_ocsFaulted" 635 "RCM2_a635_comOCS1PCntr" 634 "RCM2_a634_comOCS1PChkSm" 633 "RCM2_a633_comOCS1PMIA" 632 "RCM2_a632_comGTWACSCntr" 631 "RCM2_a631_comGTWACSChkSm" 630 "RCM2_a630_comGTWACSMIA" 629 "RCM2_a629_comEPBStatusCntr" 628 "RCM2_a628_comEPBStatusChkSm" 627 "RCM2_a627_comEPBStatusMIA" 626 "RCM2_a626_comESPCCntr" 625 "RCM2_a625_comESPCChkSm" 624 "RCM2_a624_comESPCMIA" 623 "RCM2_a623_comESPBCntr" 622 "RCM2_a622_comESPBChkSm" 621 "RCM2_a621_comESPBMIA" 620 "RCM2_a620_comInvalidVehicleSpeed" 619 "RCM2_a619_comESP145Cntr" 618 "RCM2_a618_comESP145ChkSm" 617 "RCM2_a617_comESP145MIA" 616 "RCM2_a616_comESP135Cntr" 615 "RCM2_a615_comESP135ChkSm" 614 "RCM2_a614_comESP135MIA" 613 "RCM2_a613_comDItorque2Cntr" 612 "RCM2_a612_comDItorque2ChkSm" 611 "RCM2_a611_comDItorque2MIA" 610 "RCM2_a610_comDItorque1Cntr" 609 "RCM2_a609_comDItorque1ChkSm" 608 "RCM2_a608_comDItorque1MIA" 607 "RCM2_a607_comStwAngStatCntr" 606 "RCM2_a606_comStwAngStatChkSm" 605 "RCM2_a605_comStwAngStatMIA" 604 "RCM2_a604_comPARTYCANBusOff" 603 "RCM2_a603_comPARTYCANInit" 602 "RCM2_a602_comChassisCANBusOff" 601 "RCM2_a601_comChassisCANInit" 600 "RCM2_a600_comCANinternalTimeout" 598 "RCM2_a598_driveOrientaConfig" 597 "RCM2_a597_driveOrientaCrssCoup" 596 "RCM2_a596_driveOrientaUndefined" 595 "RCM2_a595_driveOrientaOpen" 594 "RCM2_a594_driveOrientaSht2Bat" 593 "RCM2_a593_driveOrientaSht2Gnd" 592 "RCM2_a592_sbrRearNetConfig" 591 "RCM2_a591_sbrRearNetCrssCoup" 590 "RCM2_a590_sbrRearNetUndefined" 589 "RCM2_a589_sbrRearNetOpen" 588 "RCM2_a588_sbrRearNetSht2Bat" 587 "RCM2_a587_sbrRearNetSht2Gnd" 573 "RCM2_a573_occPROSConfig" 572 "RCM2_a572_occPROSCrssCoup" 571 "RCM2_a571_occPROSUndef" 570 "RCM2_a570_occPROSOpen" 569 "RCM2_a569_occPROSSht2Bat" 568 "RCM2_a568_occPROSSht2Gnd" 567 "RCM2_a567_seaTrkPosLeftConfig" 566 "RCM2_a566_seaTrkPosLeftCrssCoup" 565 "RCM2_a565_seaTrkPosLeftUndefined" 564 "RCM2_a564_seaTrkPosLeftOpen" 563 "RCM2_a563_seaTrkPosLeftShtBat" 562 "RCM2_a562_seaTrkPosLeftSht2Gnd" 561 "RCM2_a561_bucklHallRightConfig" 560 "RCM2_a560_bucklHallRightCrssCoup" 559 "RCM2_a559_bucklHallRightUndef" 558 "RCM2_a558_bucklHallRightOpen" 557 "RCM2_a557_bucklHallRightSht2Bat" 556 "RCM2_a556_bucklHallRightSht2Gnd" 555 "RCM2_a555_bucklHallLeftConfig" 554 "RCM2_a554_bucklHallLeftCrssCoup" 553 "RCM2_a553_bucklHallLeftUndef" 552 "RCM2_a552_bucklHallLeftOpen" 551 "RCM2_a551_bucklHallLeftSht2Bat" 550 "RCM2_a550_bucklHallLeftSht2Gnd" 488 "RCM2_a488_upFrntPedProSht2Gnd" 487 "RCM2_a487_upFrntPedProRDefect" 486 "RCM2_a486_upFrntPedProRConfig" 485 "RCM2_a485_upFrntPedProRIntTyp" 484 "RCM2_a484_upFrntPedProRCommErr" 483 "RCM2_a483_upFrntPedProRCrssCoup" 482 "RCM2_a482_upFrntPedProROpen" 481 "RCM2_a481_upFrntPedProRSht2Bat" 480 "RCM2_a480_upFrntPedProRSht2Gnd" 478 "RCM2_a478_upFrntPedProSht2Gnd" 477 "RCM2_a477_upFrntPedProLDefect" 476 "RCM2_a476_upFrntPedProLConfig" 475 "RCM2_a475_upFrntPedProLIntTyp" 474 "RCM2_a474_upFrntPedProLCommErr" 473 "RCM2_a473_upFrntPedProLCrssCoup" 472 "RCM2_a472_upFrntPedProLOpen" 471 "RCM2_a471_upFrntPedProLSht2Bat" 470 "RCM2_a470_upFrntPedProLSht2Gnd" 469 "RCM2_a469_presPedProAbsolute" 468 "RCM2_a468_presPedProRSigMon" 467 "RCM2_a467_presPedProRDefect" 466 "RCM2_a466_presPedProRConfig" 465 "RCM2_a465_presPedProRInitTyp" 464 "RCM2_a464_presPedProRCommErr" 463 "RCM2_a463_presPedProRCrssCoup" 462 "RCM2_a462_presPedProROpen" 461 "RCM2_a461_presPedProRSht2Bat" 460 "RCM2_a460_presPedProRSht2Gnd" 458 "RCM2_a458_presPedProLSigMon" 457 "RCM2_a457_presPedProLDefect" 456 "RCM2_a456_presPedProLConfig" 455 "RCM2_a455_presPedProLInitTyp" 454 "RCM2_a454_presPedProLCommErr" 453 "RCM2_a453_presPedProLCrssCoup" 452 "RCM2_a452_presPedProLOpen" 451 "RCM2_a451_presPedProLSht2Bat" 450 "RCM2_a450_presPedProLSht2Gnd" 449 "RCM2_a449_presDoorAbsolute2" 448 "RCM2_a448_presFrntRDoorSigMon" 447 "RCM2_a447_presFrntRDoorDefect" 446 "RCM2_a446_presFrntRDoorConfig" 445 "RCM2_a445_presFrntRDoorInitTyp" 444 "RCM2_a444_presFrntRDoorCommErr" 443 "RCM2_a443_presFrntRDoorCrssCoup" 442 "RCM2_a442_presFrntRDoorOpen" 441 "RCM2_a441_presFrntRDoorSht2Bat" 440 "RCM2_a440_presFrntRDoorSht2Gnd" 439 "RCM2_a439_presDoorAbsolute1" 438 "RCM2_a438_presFrntLDoorSigMon" 437 "RCM2_a437_presFrntLDoorDefect" 436 "RCM2_a436_presFrntLDoorConfig" 435 "RCM2_a435_presFrntLDoorInitTyp" 434 "RCM2_a434_presFrntLDoorCommErr" 433 "RCM2_a433_presFrntLDoorCrssCoup" 432 "RCM2_a432_presFrntLDoorOpen" 431 "RCM2_a431_presFrntLDoorSht2Bat" 430 "RCM2_a430_presFrntLDoorSht2Gnd" 428 "RCM2_a428_sideAccelCPilRSigMon" 427 "RCM2_a427_sideAccelCPilRDefect" 426 "RCM2_a426_sideAccelCPilRConfig" 425 "RCM2_a425_sideAccelCPilRInitTyp" 424 "RCM2_a424_sideAccelCPilRCommErr" 423 "RCM2_a423_sideAccelCPilRCrssCoup" 422 "RCM2_a422_sideAccelCPilROpen" 421 "RCM2_a421_sideAccelCPilRSht2Bat" 420 "RCM2_a420_sideAccelCPilRSht2Gnd" 418 "RCM2_a418_sideAccelCPilLSigMon" 417 "RCM2_a417_sideAccelCPilLDefect" 416 "RCM2_a416_sideAccelCPilLConfig" 415 "RCM2_a415_sideAccelCPilLInitTyp" 414 "RCM2_a414_sideAccelCPilLCommErr" 413 "RCM2_a413_sideAccelCPilLCrssCoup" 412 "RCM2_a412_sideAccelCPilLOpen" 411 "RCM2_a411_sideAccelCPilLSht2Bat" 410 "RCM2_a410_sideAccelCPilLSht2Gnd" 408 "RCM2_a408_sideAccelBPilRSigMon" 407 "RCM2_a407_sideAccelBPilRDefect" 406 "RCM2_a406_sideAccelBPilRConfig" 405 "RCM2_a405_sideAccelBPilRInitTyp" 404 "RCM2_a404_sideAccelBPilRCommErr" 403 "RCM2_a403_sideAccelBPilRCrssCoup" 402 "RCM2_a402_sideAccelBPilROpen" 401 "RCM2_a401_sideAccelBPilRSht2Bat" 400 "RCM2_a400_sideAccelBPilRSht2Gnd" 398 "RCM2_a398_sideAccelBPilLSigMon" 397 "RCM2_a397_sideAccelBPilLDefect" 396 "RCM2_a396_sideAccelBPilLConfig" 395 "RCM2_a395_sideAccelBPilLInitTyp" 394 "RCM2_a394_sideAccelBPilLCommErr" 393 "RCM2_a393_sideAccelBPilLCLosCoup" 392 "RCM2_a392_sideAccelBPilLOpen" 391 "RCM2_a391_sideAccelBPilLSht2Bat" 390 "RCM2_a390_sideAccelBPilLSht2Gnd" 388 "RCM2_a388_upFrntSnsrMidRSigMon" 387 "RCM2_a387_upFrntSnsrMidRDefect" 386 "RCM2_a386_upFrntSnsrMidRConfig" 385 "RCM2_a385_upFrntSnsrMidRInitTyp" 384 "RCM2_a384_upFrntSnsrMidRCommErr" 383 "RCM2_a383_upFrntSnsrMidRCrssCoup" 382 "RCM2_a382_upFrntSnsrMidROpen" 381 "RCM2_a381_upFrntSnsrMidRSht2Bat" 380 "RCM2_a380_upFrntSnsrMidRSht2Gnd" 378 "RCM2_a378_upFrntSnsrMidLSigMon" 377 "RCM2_a377_upFrntSnsrMidLDefect" 376 "RCM2_a376_upFrntSnsrMidLConfig" 375 "RCM2_a375_upFrntSnsrMidLInitTyp" 374 "RCM2_a374_upFrntSnsrMidLCommErr" 373 "RCM2_a373_upFrntSnsrMidLCrssCoup" 372 "RCM2_a372_upFrntSnsrMidLOpen" 371 "RCM2_a371_upFrntSnsrMidLSht2Bat" 370 "RCM2_a370_upFrntSnsrMidLSht2Gnd" 368 "RCM2_a368_upFrntSnsrRSigMon" 367 "RCM2_a367_upFrntSnsrRDefect" 366 "RCM2_a366_upFrntSnsrRConfig" 365 "RCM2_a365_upFrntSnsrRInitTyp" 364 "RCM2_a364_upFrntSnsrRCommErr" 363 "RCM2_a363_upFrntSnsrRCrssCoup" 362 "RCM2_a362_upFrntSnsrROpen" 361 "RCM2_a361_upFrntSnsrRSht2Bat" 360 "RCM2_a360_upFrntSnsrRSht2Gnd" 358 "RCM2_a358_upFrntSnsrLSigMon" 357 "RCM2_a357_upFrntSnsrLDefect" 356 "RCM2_a356_upFrntSnsrLConfig" 355 "RCM2_a355_upFrntSnsrLInitTyp" 354 "RCM2_a354_upFrntSnsrLCommErr" 353 "RCM2_a353_upFrntSnsrLCrssCoup" 352 "RCM2_a352_upFrntSnsrLOpen" 351 "RCM2_a351_upFrntSnsrLSht2Bat" 350 "RCM2_a350_upFrntSnsrLSht2Gnd" 323 "RCM2_a323_imuCalibrationNotDone" 322 "RCM2_a322_imuCalibrationFailed" 321 "RCM2_a321_imuAccZLgMonChlTemp" 320 "RCM2_a320_imuAccZLgMonChlPerm" 319 "RCM2_a319_imuAccYLgMonChlTemp" 318 "RCM2_a318_imuAccYLgMonChlPerm" 317 "RCM2_a317_imuAccXLgMonChlTemp" 316 "RCM2_a316_imuAccXLgMonChlPerm" 315 "RCM2_a315_imuRollR8ChnlMonTmpLF" 314 "RCM2_a314_imuRollR8SnsrPermLF" 313 "RCM2_a313_imuRollR8SnsrPermInit" 312 "RCM2_a312_imuRollR8SnsrPermBG" 311 "RCM2_a311_imuPitchR8ChnlMonTmpLF" 310 "RCM2_a310_imuPitchR8SnsrPermLF" 309 "RCM2_a309_imuPitchR8SnsrPermInit" 308 "RCM2_a308_imuPitchR8SnsrPermBG" 307 "RCM2_a307_imuYawR8ChnlMonTmpLF" 306 "RCM2_a306_imuYawR8SnsrPermLF" 305 "RCM2_a305_imuYawR8SnsrPermInit" 304 "RCM2_a304_imuYawR8SnsrPermBG" 303 "RCM2_a303_imuAccYHgMonChlTemp" 302 "RCM2_a302_imuAccYHgMonChlPerm" 301 "RCM2_a301_imuAccXHgMonChlTemp" 300 "RCM2_a300_imuAccXHgMonChlPerm" 255 "RCM2_a255_ens2Config" 254 "RCM2_a254_ens2Sht2Gnd" 253 "RCM2_a253_ens2Sht2Bat" 252 "RCM2_a252_ens1Config" 251 "RCM2_a251_ens1Sht2Gnd" 250 "RCM2_a250_ens1Sht2Bat" 193 "RCM2_a193_hoodActuatorLConfig" 192 "RCM2_a192_hoodActuatorLCrssCoup" 191 "RCM2_a191_hoodActuatorLShort" 190 "RCM2_a190_hoodActuatorLOpen" 189 "RCM2_a189_hoodActuatorLSht2Bat" 188 "RCM2_a188_hoodActuatorLSht2Gnd" 187 "RCM2_a187_hoodActuatorRConfig" 186 "RCM2_a186_hoodActuatorRCrssCoup" 185 "RCM2_a185_hoodActuatorRShort" 184 "RCM2_a184_hoodActuatorROpen" 183 "RCM2_a183_hoodActuatorRSht2Bat" 182 "RCM2_a182_hoodActuatorRSht2Gnd" 181 "RCM2_a181_curAB2ndRowRConfig" 180 "RCM2_a180_curAB2ndRowRCrssCoup" 179 "RCM2_a179_curAB2ndRowRShort" 178 "RCM2_a178_curAB2ndRowROpen" 177 "RCM2_a177_curAB2ndRowRSht2Bat" 176 "RCM2_a176_curAB2ndRowRSht2Gnd" 175 "RCM2_a175_curAB2ndRowLConfig" 174 "RCM2_a174_curAB2ndRowLCrssCoup" 173 "RCM2_a173_curAB2ndRowLShort" 172 "RCM2_a172_curAB2ndRowLOpen" 171 "RCM2_a171_curAB2ndRowLSht2Bat" 170 "RCM2_a170_curAB2ndRowLSht2Gnd" 169 "RCM2_a169_preten2ndRowRCgf" 168 "RCM2_a168_preten2ndRowRCrssCoup" 167 "RCM2_a167_preten2ndRowRShort" 166 "RCM2_a166_preten2ndRowROpen" 165 "RCM2_a165_preten2ndRowRSht2Bat" 164 "RCM2_a164_preten2ndRowRSht2Gnd" 163 "RCM2_a163_preten2ndRowLCgf" 162 "RCM2_a162_preten2ndRowLCrssCoup" 161 "RCM2_a161_preten2ndRowLShort" 160 "RCM2_a160_preten2ndRowLOpen" 159 "RCM2_a159_preten2ndRowLSht2Bat" 158 "RCM2_a158_preten2ndRowLSht2Gnd" 157 "RCM2_a157_curABRightConfig" 156 "RCM2_a156_curABRightCrssCoup" 155 "RCM2_a155_curABRightShort" 154 "RCM2_a154_curABRightOpen" 153 "RCM2_a153_curABRightSht2Bat" 152 "RCM2_a152_curABRightSht2Gnd" 151 "RCM2_a151_curABLeftConfig" 150 "RCM2_a150_curABLeftCrssCoup" 149 "RCM2_a149_curABLeftShort" 148 "RCM2_a148_curABLeftOpen" 147 "RCM2_a147_curABLeftSht2Bat" 146 "RCM2_a146_curABLeftSht2Gnd" 145 "RCM2_a145_hvdPyroConfig" 144 "RCM2_a144_hvdPyroCrssCoup" 143 "RCM2_a143_hvdPyroShort" 142 "RCM2_a142_hvdPyroOpen" 141 "RCM2_a141_hvdPyroSht2Bat" 140 "RCM2_a140_hvdPyroSht2Gnd" 139 "RCM2_a139_sideAB1stRowRConfig" 138 "RCM2_a138_sideAB1stRowRCrssCoup" 137 "RCM2_a137_sideAB1stRowRShort" 136 "RCM2_a136_sideAB1stRowROpen" 135 "RCM2_a135_sideAB1stRowRSht2Bat" 134 "RCM2_a134_sideAB1stRowRSht2Gnd" 133 "RCM2_a133_sideAB1stRowLConfig" 132 "RCM2_a132_sideAB1stRowLCrssCoup" 131 "RCM2_a131_sideAB1stRowLShort" 130 "RCM2_a130_sideAB1stRowLOpen" 129 "RCM2_a129_sideAB1stRowLSht2Bat" 128 "RCM2_a128_sideAB1stRowLSht2Gnd" 127 "RCM2_a127_kneeABPassConfig" 126 "RCM2_a126_kneeABPassCrssCoup" 125 "RCM2_a125_kneeABPassShort" 124 "RCM2_a124_kneeABPassOpen" 123 "RCM2_a123_kneeABPassSht2Bat" 122 "RCM2_a122_kneeABPassSht2Gnd" 121 "RCM2_a121_kneeABDrvrConfig" 120 "RCM2_a120_kneeABDrvrCrssCoup" 119 "RCM2_a119_kneeABDrvrShort" 118 "RCM2_a118_kneeABDrvrOpen" 117 "RCM2_a117_kneeABDrvrSht2Bat" 116 "RCM2_a116_kneeABDrvrSht2Gnd" 115 "RCM2_a115_loadLimRightConfig" 114 "RCM2_a114_loadLimRightCrssCoup" 113 "RCM2_a113_loadLimRightShort" 112 "RCM2_a112_loadLimRightOpen" 111 "RCM2_a111_loadLimRightSht2Bat" 110 "RCM2_a110_loadLimRightSht2Gnd" 109 "RCM2_a109_loadLimLeftConfig" 108 "RCM2_a108_loadLimLeftCrssCoup" 107 "RCM2_a107_loadLimLeftShort" 106 "RCM2_a106_loadLimLeftOpen" 105 "RCM2_a105_loadLimLeftSht2Bat" 104 "RCM2_a104_loadLimLeftSht2Gnd" 103 "RCM2_a103_pretenLapRightConfig" 102 "RCM2_a102_pretenLapRightCrssCoup" 101 "RCM2_a101_pretenLapRightShort" 100 "RCM2_a100_pretenLapRightOpen" 99 "RCM2_a099_pretenLapRightSht2Bat" 98 "RCM2_a098_pretenLapRightSht2Gnd" 97 "RCM2_a097_pretenLapLeftConfig" 96 "RCM2_a096_pretenLapLeftCrssCoup" 95 "RCM2_a095_pretenLapLeftShort" 94 "RCM2_a094_pretenLapLeftOpen" 93 "RCM2_a093_pretenLapLeftSht2Bat" 92 "RCM2_a092_pretenLapLeftSht2Gnd" 91 "RCM2_a091_pretenShldRightConfig" 90 "RCM2_a090_pretenShldRightCrssCou" 89 "RCM2_a089_pretenShldRightShort" 88 "RCM2_a088_pretenShldRightOpen" 87 "RCM2_a087_pretenShldRightSht2Bat" 86 "RCM2_a086_pretenShldRightSht2Gnd" 85 "RCM2_a085_pretenShldLeftConfig" 84 "RCM2_a084_pretenShldLeftCrossC" 83 "RCM2_a083_pretenShldLeftShort" 82 "RCM2_a082_pretenShldLeftOpen" 81 "RCM2_a081_pretenShldLeftSht2Bat" 80 "RCM2_a080_pretenShldLeftSht2Gnd" 79 "RCM2_a079_passActiveVentConfig" 78 "RCM2_a078_passActiveVentCrssCoup" 77 "RCM2_a077_passActiveVentShort" 76 "RCM2_a076_passActiveVentOpen" 75 "RCM2_a075_passActiveVentSht2Bat" 74 "RCM2_a074_passActiveVentSht2Gnd" 73 "RCM2_a073_passABStg2Config" 72 "RCM2_a072_passABStg2CrssCoup" 71 "RCM2_a071_passABStg2Short" 70 "RCM2_a070_passABStg2Open" 69 "RCM2_a069_passABStg2Sht2Bat" 68 "RCM2_a068_passABStg2Sht2Gnd" 67 "RCM2_a067_passABStg1Config" 66 "RCM2_a066_passABStg1CrssCoup" 65 "RCM2_a065_passABStg1Short" 64 "RCM2_a064_passABStg1Open" 63 "RCM2_a063_passABStg1Sht2Bat" 62 "RCM2_a062_passABStg1Sht2Gnd" 61 "RCM2_a061_driverABStg2Config" 60 "RCM2_a060_driverABStg2CrssCoup" 59 "RCM2_a059_driverABStg2Short" 58 "RCM2_a058_driverABStg2Open" 57 "RCM2_a057_driverABStg2Sht2Bat" 56 "RCM2_a056_driverABStg2Sht2Gnd" 55 "RCM2_a055_driverABStg1Config" 54 "RCM2_a054_driverABStg1CrssCoup" 53 "RCM2_a053_driverABStg1Short" 52 "RCM2_a052_driverABStg1Open" 51 "RCM2_a051_driverABStg1Sht2Bat" 50 "RCM2_a050_driverABStg1Sht2Gnd" 49 "RCM2_a049_batteryVoltageTooLow" 48 "RCM2_a048_batteryVoltageTooHigh" 47 "RCM2_a047_batteryESRhigh" 14 "RCM2_a014_pedProNearDeploy" 13 "RCM2_a013_SideAlgoDisabled" 12 "RCM2_a012_RollAlgoDisabled" 11 "RCM2_a011_FrntAlgoDisabled" 10 "RCM2_a010_pedProEDRDataLocked" 9 "RCM2_a009_edrDataAreaLocked" 8 "RCM2_a008_factoryMode" 7 "RCM2_a007_pedProCrashDetected" 6 "RCM2_a006_supplierDiagEnabled" 5 "RCM2_a005_abuseImmunityThrshold" 4 "RCM2_a004_crashAlgoWakeup" 3 "RCM2_a003_warningIndicator" 2 "RCM2_a002_airbagsUnArmed" 1 "RCM2_a001_nearDeploy" 0 "RCM2_a000_crashDetected" ;
VAL_ 1249 RCM2_alertState 1 "RCM2_ALERT_SET" 0 "RCM2_ALERT_CLEARED" ;
VAL_ 1009 RCM2_a000_crashDetected 1 "RCM2_ALERT_SET" 0 "RCM2_ALERT_CLEARED" ;
VAL_ 1009 RCM2_a001_nearDeploy 1 "RCM2_ALERT_SET" 0 "RCM2_ALERT_CLEARED" ;
VAL_ 1009 RCM2_a002_airbagsUnArmed 1 "RCM2_ALERT_SET" 0 "RCM2_ALERT_CLEARED" ;
VAL_ 1009 RCM2_a003_warningIndicator 1 "RCM2_ALERT_SET" 0 "RCM2_ALERT_CLEARED" ;
VAL_ 1009 RCM2_a004_crashAlgoWakeup 1 "RCM2_ALERT_SET" 0 "RCM2_ALERT_CLEARED" ;
VAL_ 1009 RCM2_a005_abuseImmunityThrshold 1 "RCM2_ALERT_SET" 0 "RCM2_ALERT_CLEARED" ;
VAL_ 1009 RCM2_a006_supplierDiagEnabled 1 "RCM2_ALERT_SET" 0 "RCM2_ALERT_CLEARED" ;
VAL_ 1009 RCM2_a007_pedProCrashDetected 1 "RCM2_ALERT_SET" 0 "RCM2_ALERT_CLEARED" ;
VAL_ 1009 RCM2_a008_factoryMode 1 "RCM2_ALERT_SET" 0 "RCM2_ALERT_CLEARED" ;
VAL_ 1009 RCM2_a009_edrDataAreaLocked 1 "RCM2_ALERT_SET" 0 "RCM2_ALERT_CLEARED" ;
VAL_ 1009 RCM2_a010_pedProEDRDataLocked 1 "RCM2_ALERT_SET" 0 "RCM2_ALERT_CLEARED" ;
VAL_ 1009 RCM2_a011_FrntAlgoDisabled 1 "RCM2_ALERT_SET" 0 "RCM2_ALERT_CLEARED" ;
VAL_ 1009 RCM2_a012_RollAlgoDisabled 1 "RCM2_ALERT_SET" 0 "RCM2_ALERT_CLEARED" ;
VAL_ 1009 RCM2_a013_SideAlgoDisabled 1 "RCM2_ALERT_SET" 0 "RCM2_ALERT_CLEARED" ;
VAL_ 1009 RCM2_a014_pedProNearDeploy 1 "RCM2_ALERT_SET" 0 "RCM2_ALERT_CLEARED" ;
VAL_ 1009 RCM2_a047_batteryESRhigh 1 "RCM2_ALERT_SET" 0 "RCM2_ALERT_CLEARED" ;
VAL_ 1009 RCM2_a048_batteryVoltageTooHigh 1 "RCM2_ALERT_SET" 0 "RCM2_ALERT_CLEARED" ;
VAL_ 1009 RCM2_a049_batteryVoltageTooLow 1 "RCM2_ALERT_SET" 0 "RCM2_ALERT_CLEARED" ;
VAL_ 1009 RCM2_a050_driverABStg1Sht2Gnd 1 "RCM2_ALERT_SET" 0 "RCM2_ALERT_CLEARED" ;
VAL_ 1009 RCM2_a051_driverABStg1Sht2Bat 1 "RCM2_ALERT_SET" 0 "RCM2_ALERT_CLEARED" ;
VAL_ 1009 RCM2_a052_driverABStg1Open 1 "RCM2_ALERT_SET" 0 "RCM2_ALERT_CLEARED" ;
VAL_ 1009 RCM2_a053_driverABStg1Short 1 "RCM2_ALERT_SET" 0 "RCM2_ALERT_CLEARED" ;
VAL_ 1009 RCM2_a054_driverABStg1CrssCoup 1 "RCM2_ALERT_SET" 0 "RCM2_ALERT_CLEARED" ;
VAL_ 1009 RCM2_a055_driverABStg1Config 1 "RCM2_ALERT_SET" 0 "RCM2_ALERT_CLEARED" ;
VAL_ 1009 RCM2_a056_driverABStg2Sht2Gnd 1 "RCM2_ALERT_SET" 0 "RCM2_ALERT_CLEARED" ;
VAL_ 1009 RCM2_a057_driverABStg2Sht2Bat 1 "RCM2_ALERT_SET" 0 "RCM2_ALERT_CLEARED" ;
VAL_ 1009 RCM2_a058_driverABStg2Open 1 "RCM2_ALERT_SET" 0 "RCM2_ALERT_CLEARED" ;
VAL_ 1009 RCM2_a059_driverABStg2Short 1 "RCM2_ALERT_SET" 0 "RCM2_ALERT_CLEARED" ;
VAL_ 1009 RCM2_a060_driverABStg2CrssCoup 1 "RCM2_ALERT_SET" 0 "RCM2_ALERT_CLEARED" ;
VAL_ 1009 RCM2_a061_driverABStg2Config 1 "RCM2_ALERT_SET" 0 "RCM2_ALERT_CLEARED" ;
VAL_ 1009 RCM2_a062_passABStg1Sht2Gnd 1 "RCM2_ALERT_SET" 0 "RCM2_ALERT_CLEARED" ;
VAL_ 1009 RCM2_a063_passABStg1Sht2Bat 1 "RCM2_ALERT_SET" 0 "RCM2_ALERT_CLEARED" ;
VAL_ 1009 RCM2_a064_passABStg1Open 1 "RCM2_ALERT_SET" 0 "RCM2_ALERT_CLEARED" ;
VAL_ 1009 RCM2_a065_passABStg1Short 1 "RCM2_ALERT_SET" 0 "RCM2_ALERT_CLEARED" ;
VAL_ 1009 RCM2_a066_passABStg1CrssCoup 1 "RCM2_ALERT_SET" 0 "RCM2_ALERT_CLEARED" ;
VAL_ 1009 RCM2_a067_passABStg1Config 1 "RCM2_ALERT_SET" 0 "RCM2_ALERT_CLEARED" ;
VAL_ 1009 RCM2_a068_passABStg2Sht2Gnd 1 "RCM2_ALERT_SET" 0 "RCM2_ALERT_CLEARED" ;
VAL_ 1009 RCM2_a069_passABStg2Sht2Bat 1 "RCM2_ALERT_SET" 0 "RCM2_ALERT_CLEARED" ;
VAL_ 1009 RCM2_a070_passABStg2Open 1 "RCM2_ALERT_SET" 0 "RCM2_ALERT_CLEARED" ;
VAL_ 1009 RCM2_a071_passABStg2Short 1 "RCM2_ALERT_SET" 0 "RCM2_ALERT_CLEARED" ;
VAL_ 1009 RCM2_a072_passABStg2CrssCoup 1 "RCM2_ALERT_SET" 0 "RCM2_ALERT_CLEARED" ;
VAL_ 1009 RCM2_a073_passABStg2Config 1 "RCM2_ALERT_SET" 0 "RCM2_ALERT_CLEARED" ;
VAL_ 1009 RCM2_a074_passActiveVentSht2Gnd 1 "RCM2_ALERT_SET" 0 "RCM2_ALERT_CLEARED" ;
VAL_ 1009 RCM2_a075_passActiveVentSht2Bat 1 "RCM2_ALERT_SET" 0 "RCM2_ALERT_CLEARED" ;
VAL_ 1009 RCM2_a076_passActiveVentOpen 1 "RCM2_ALERT_SET" 0 "RCM2_ALERT_CLEARED" ;
VAL_ 1009 RCM2_a077_passActiveVentShort 1 "RCM2_ALERT_SET" 0 "RCM2_ALERT_CLEARED" ;
VAL_ 1009 RCM2_a078_passActiveVentCrssCoup 1 "RCM2_ALERT_SET" 0 "RCM2_ALERT_CLEARED" ;
VAL_ 1009 RCM2_a079_passActiveVentConfig 1 "RCM2_ALERT_SET" 0 "RCM2_ALERT_CLEARED" ;
VAL_ 1009 RCM2_a080_pretenShldLeftSht2Gnd 1 "RCM2_ALERT_SET" 0 "RCM2_ALERT_CLEARED" ;
VAL_ 1009 RCM2_a081_pretenShldLeftSht2Bat 1 "RCM2_ALERT_SET" 0 "RCM2_ALERT_CLEARED" ;
VAL_ 1009 RCM2_a082_pretenShldLeftOpen 1 "RCM2_ALERT_SET" 0 "RCM2_ALERT_CLEARED" ;
VAL_ 1009 RCM2_a083_pretenShldLeftShort 1 "RCM2_ALERT_SET" 0 "RCM2_ALERT_CLEARED" ;
VAL_ 1009 RCM2_a084_pretenShldLeftCrossC 1 "RCM2_ALERT_SET" 0 "RCM2_ALERT_CLEARED" ;
VAL_ 1009 RCM2_a085_pretenShldLeftConfig 1 "RCM2_ALERT_SET" 0 "RCM2_ALERT_CLEARED" ;
VAL_ 1009 RCM2_a086_pretenShldRightSht2Gnd 1 "RCM2_ALERT_SET" 0 "RCM2_ALERT_CLEARED" ;
VAL_ 1009 RCM2_a087_pretenShldRightSht2Bat 1 "RCM2_ALERT_SET" 0 "RCM2_ALERT_CLEARED" ;
VAL_ 1009 RCM2_a088_pretenShldRightOpen 1 "RCM2_ALERT_SET" 0 "RCM2_ALERT_CLEARED" ;
VAL_ 1009 RCM2_a089_pretenShldRightShort 1 "RCM2_ALERT_SET" 0 "RCM2_ALERT_CLEARED" ;
VAL_ 1009 RCM2_a090_pretenShldRightCrssCou 1 "RCM2_ALERT_SET" 0 "RCM2_ALERT_CLEARED" ;
VAL_ 1009 RCM2_a091_pretenShldRightConfig 1 "RCM2_ALERT_SET" 0 "RCM2_ALERT_CLEARED" ;
VAL_ 1009 RCM2_a092_pretenLapLeftSht2Gnd 1 "RCM2_ALERT_SET" 0 "RCM2_ALERT_CLEARED" ;
VAL_ 1009 RCM2_a093_pretenLapLeftSht2Bat 1 "RCM2_ALERT_SET" 0 "RCM2_ALERT_CLEARED" ;
VAL_ 1009 RCM2_a094_pretenLapLeftOpen 1 "RCM2_ALERT_SET" 0 "RCM2_ALERT_CLEARED" ;
VAL_ 1009 RCM2_a095_pretenLapLeftShort 1 "RCM2_ALERT_SET" 0 "RCM2_ALERT_CLEARED" ;
VAL_ 1009 RCM2_a096_pretenLapLeftCrssCoup 1 "RCM2_ALERT_SET" 0 "RCM2_ALERT_CLEARED" ;
VAL_ 1009 RCM2_a097_pretenLapLeftConfig 1 "RCM2_ALERT_SET" 0 "RCM2_ALERT_CLEARED" ;
VAL_ 1009 RCM2_a098_pretenLapRightSht2Gnd 1 "RCM2_ALERT_SET" 0 "RCM2_ALERT_CLEARED" ;
VAL_ 1009 RCM2_a099_pretenLapRightSht2Bat 1 "RCM2_ALERT_SET" 0 "RCM2_ALERT_CLEARED" ;
VAL_ 1009 RCM2_a100_pretenLapRightOpen 1 "RCM2_ALERT_SET" 0 "RCM2_ALERT_CLEARED" ;
VAL_ 1009 RCM2_a101_pretenLapRightShort 1 "RCM2_ALERT_SET" 0 "RCM2_ALERT_CLEARED" ;
VAL_ 1009 RCM2_a102_pretenLapRightCrssCoup 1 "RCM2_ALERT_SET" 0 "RCM2_ALERT_CLEARED" ;
VAL_ 1009 RCM2_a103_pretenLapRightConfig 1 "RCM2_ALERT_SET" 0 "RCM2_ALERT_CLEARED" ;
VAL_ 1009 RCM2_a104_loadLimLeftSht2Gnd 1 "RCM2_ALERT_SET" 0 "RCM2_ALERT_CLEARED" ;
VAL_ 1009 RCM2_a105_loadLimLeftSht2Bat 1 "RCM2_ALERT_SET" 0 "RCM2_ALERT_CLEARED" ;
VAL_ 1009 RCM2_a106_loadLimLeftOpen 1 "RCM2_ALERT_SET" 0 "RCM2_ALERT_CLEARED" ;
VAL_ 1009 RCM2_a107_loadLimLeftShort 1 "RCM2_ALERT_SET" 0 "RCM2_ALERT_CLEARED" ;
VAL_ 1009 RCM2_a108_loadLimLeftCrssCoup 1 "RCM2_ALERT_SET" 0 "RCM2_ALERT_CLEARED" ;
VAL_ 1009 RCM2_a109_loadLimLeftConfig 1 "RCM2_ALERT_SET" 0 "RCM2_ALERT_CLEARED" ;
VAL_ 1009 RCM2_a110_loadLimRightSht2Gnd 1 "RCM2_ALERT_SET" 0 "RCM2_ALERT_CLEARED" ;
VAL_ 1009 RCM2_a111_loadLimRightSht2Bat 1 "RCM2_ALERT_SET" 0 "RCM2_ALERT_CLEARED" ;
VAL_ 1009 RCM2_a112_loadLimRightOpen 1 "RCM2_ALERT_SET" 0 "RCM2_ALERT_CLEARED" ;
VAL_ 1009 RCM2_a113_loadLimRightShort 1 "RCM2_ALERT_SET" 0 "RCM2_ALERT_CLEARED" ;
VAL_ 1009 RCM2_a114_loadLimRightCrssCoup 1 "RCM2_ALERT_SET" 0 "RCM2_ALERT_CLEARED" ;
VAL_ 1009 RCM2_a115_loadLimRightConfig 1 "RCM2_ALERT_SET" 0 "RCM2_ALERT_CLEARED" ;
VAL_ 1009 RCM2_a116_kneeABDrvrSht2Gnd 1 "RCM2_ALERT_SET" 0 "RCM2_ALERT_CLEARED" ;
VAL_ 1009 RCM2_a117_kneeABDrvrSht2Bat 1 "RCM2_ALERT_SET" 0 "RCM2_ALERT_CLEARED" ;
VAL_ 1009 RCM2_a118_kneeABDrvrOpen 1 "RCM2_ALERT_SET" 0 "RCM2_ALERT_CLEARED" ;
VAL_ 1009 RCM2_a119_kneeABDrvrShort 1 "RCM2_ALERT_SET" 0 "RCM2_ALERT_CLEARED" ;
VAL_ 1009 RCM2_a120_kneeABDrvrCrssCoup 1 "RCM2_ALERT_SET" 0 "RCM2_ALERT_CLEARED" ;
VAL_ 1009 RCM2_a121_kneeABDrvrConfig 1 "RCM2_ALERT_SET" 0 "RCM2_ALERT_CLEARED" ;
VAL_ 1009 RCM2_a122_kneeABPassSht2Gnd 1 "RCM2_ALERT_SET" 0 "RCM2_ALERT_CLEARED" ;
VAL_ 1009 RCM2_a123_kneeABPassSht2Bat 1 "RCM2_ALERT_SET" 0 "RCM2_ALERT_CLEARED" ;
VAL_ 1009 RCM2_a124_kneeABPassOpen 1 "RCM2_ALERT_SET" 0 "RCM2_ALERT_CLEARED" ;
VAL_ 1009 RCM2_a125_kneeABPassShort 1 "RCM2_ALERT_SET" 0 "RCM2_ALERT_CLEARED" ;
VAL_ 1009 RCM2_a126_kneeABPassCrssCoup 1 "RCM2_ALERT_SET" 0 "RCM2_ALERT_CLEARED" ;
VAL_ 1009 RCM2_a127_kneeABPassConfig 1 "RCM2_ALERT_SET" 0 "RCM2_ALERT_CLEARED" ;
VAL_ 1009 RCM2_a128_sideAB1stRowLSht2Gnd 1 "RCM2_ALERT_SET" 0 "RCM2_ALERT_CLEARED" ;
VAL_ 1009 RCM2_a129_sideAB1stRowLSht2Bat 1 "RCM2_ALERT_SET" 0 "RCM2_ALERT_CLEARED" ;
VAL_ 1009 RCM2_a130_sideAB1stRowLOpen 1 "RCM2_ALERT_SET" 0 "RCM2_ALERT_CLEARED" ;
VAL_ 1009 RCM2_a131_sideAB1stRowLShort 1 "RCM2_ALERT_SET" 0 "RCM2_ALERT_CLEARED" ;
VAL_ 1009 RCM2_a132_sideAB1stRowLCrssCoup 1 "RCM2_ALERT_SET" 0 "RCM2_ALERT_CLEARED" ;
VAL_ 1009 RCM2_a133_sideAB1stRowLConfig 1 "RCM2_ALERT_SET" 0 "RCM2_ALERT_CLEARED" ;
VAL_ 1009 RCM2_a134_sideAB1stRowRSht2Gnd 1 "RCM2_ALERT_SET" 0 "RCM2_ALERT_CLEARED" ;
VAL_ 1009 RCM2_a135_sideAB1stRowRSht2Bat 1 "RCM2_ALERT_SET" 0 "RCM2_ALERT_CLEARED" ;
VAL_ 1009 RCM2_a136_sideAB1stRowROpen 1 "RCM2_ALERT_SET" 0 "RCM2_ALERT_CLEARED" ;
VAL_ 1009 RCM2_a137_sideAB1stRowRShort 1 "RCM2_ALERT_SET" 0 "RCM2_ALERT_CLEARED" ;
VAL_ 1009 RCM2_a138_sideAB1stRowRCrssCoup 1 "RCM2_ALERT_SET" 0 "RCM2_ALERT_CLEARED" ;
VAL_ 1009 RCM2_a139_sideAB1stRowRConfig 1 "RCM2_ALERT_SET" 0 "RCM2_ALERT_CLEARED" ;
VAL_ 1009 RCM2_a140_hvdPyroSht2Gnd 1 "RCM2_ALERT_SET" 0 "RCM2_ALERT_CLEARED" ;
VAL_ 1009 RCM2_a141_hvdPyroSht2Bat 1 "RCM2_ALERT_SET" 0 "RCM2_ALERT_CLEARED" ;
VAL_ 1009 RCM2_a142_hvdPyroOpen 1 "RCM2_ALERT_SET" 0 "RCM2_ALERT_CLEARED" ;
VAL_ 1009 RCM2_a143_hvdPyroShort 1 "RCM2_ALERT_SET" 0 "RCM2_ALERT_CLEARED" ;
VAL_ 1009 RCM2_a144_hvdPyroCrssCoup 1 "RCM2_ALERT_SET" 0 "RCM2_ALERT_CLEARED" ;
VAL_ 1009 RCM2_a145_hvdPyroConfig 1 "RCM2_ALERT_SET" 0 "RCM2_ALERT_CLEARED" ;
VAL_ 1009 RCM2_a146_curABLeftSht2Gnd 1 "RCM2_ALERT_SET" 0 "RCM2_ALERT_CLEARED" ;
VAL_ 1009 RCM2_a147_curABLeftSht2Bat 1 "RCM2_ALERT_SET" 0 "RCM2_ALERT_CLEARED" ;
VAL_ 1009 RCM2_a148_curABLeftOpen 1 "RCM2_ALERT_SET" 0 "RCM2_ALERT_CLEARED" ;
VAL_ 1009 RCM2_a149_curABLeftShort 1 "RCM2_ALERT_SET" 0 "RCM2_ALERT_CLEARED" ;
VAL_ 1009 RCM2_a150_curABLeftCrssCoup 1 "RCM2_ALERT_SET" 0 "RCM2_ALERT_CLEARED" ;
VAL_ 1009 RCM2_a151_curABLeftConfig 1 "RCM2_ALERT_SET" 0 "RCM2_ALERT_CLEARED" ;
VAL_ 1009 RCM2_a152_curABRightSht2Gnd 1 "RCM2_ALERT_SET" 0 "RCM2_ALERT_CLEARED" ;
VAL_ 1009 RCM2_a153_curABRightSht2Bat 1 "RCM2_ALERT_SET" 0 "RCM2_ALERT_CLEARED" ;
VAL_ 1009 RCM2_a154_curABRightOpen 1 "RCM2_ALERT_SET" 0 "RCM2_ALERT_CLEARED" ;
VAL_ 1009 RCM2_a155_curABRightShort 1 "RCM2_ALERT_SET" 0 "RCM2_ALERT_CLEARED" ;
VAL_ 1009 RCM2_a156_curABRightCrssCoup 1 "RCM2_ALERT_SET" 0 "RCM2_ALERT_CLEARED" ;
VAL_ 1009 RCM2_a157_curABRightConfig 1 "RCM2_ALERT_SET" 0 "RCM2_ALERT_CLEARED" ;
VAL_ 1009 RCM2_a158_preten2ndRowLSht2Gnd 1 "RCM2_ALERT_SET" 0 "RCM2_ALERT_CLEARED" ;
VAL_ 1009 RCM2_a159_preten2ndRowLSht2Bat 1 "RCM2_ALERT_SET" 0 "RCM2_ALERT_CLEARED" ;
VAL_ 1009 RCM2_a160_preten2ndRowLOpen 1 "RCM2_ALERT_SET" 0 "RCM2_ALERT_CLEARED" ;
VAL_ 1009 RCM2_a161_preten2ndRowLShort 1 "RCM2_ALERT_SET" 0 "RCM2_ALERT_CLEARED" ;
VAL_ 1009 RCM2_a162_preten2ndRowLCrssCoup 1 "RCM2_ALERT_SET" 0 "RCM2_ALERT_CLEARED" ;
VAL_ 1009 RCM2_a163_preten2ndRowLCgf 1 "RCM2_ALERT_SET" 0 "RCM2_ALERT_CLEARED" ;
VAL_ 1009 RCM2_a164_preten2ndRowRSht2Gnd 1 "RCM2_ALERT_SET" 0 "RCM2_ALERT_CLEARED" ;
VAL_ 1009 RCM2_a165_preten2ndRowRSht2Bat 1 "RCM2_ALERT_SET" 0 "RCM2_ALERT_CLEARED" ;
VAL_ 1009 RCM2_a166_preten2ndRowROpen 1 "RCM2_ALERT_SET" 0 "RCM2_ALERT_CLEARED" ;
VAL_ 1009 RCM2_a167_preten2ndRowRShort 1 "RCM2_ALERT_SET" 0 "RCM2_ALERT_CLEARED" ;
VAL_ 1009 RCM2_a168_preten2ndRowRCrssCoup 1 "RCM2_ALERT_SET" 0 "RCM2_ALERT_CLEARED" ;
VAL_ 1009 RCM2_a169_preten2ndRowRCgf 1 "RCM2_ALERT_SET" 0 "RCM2_ALERT_CLEARED" ;
VAL_ 1009 RCM2_a170_curAB2ndRowLSht2Gnd 1 "RCM2_ALERT_SET" 0 "RCM2_ALERT_CLEARED" ;
VAL_ 1009 RCM2_a171_curAB2ndRowLSht2Bat 1 "RCM2_ALERT_SET" 0 "RCM2_ALERT_CLEARED" ;
VAL_ 1009 RCM2_a172_curAB2ndRowLOpen 1 "RCM2_ALERT_SET" 0 "RCM2_ALERT_CLEARED" ;
VAL_ 1009 RCM2_a173_curAB2ndRowLShort 1 "RCM2_ALERT_SET" 0 "RCM2_ALERT_CLEARED" ;
VAL_ 1009 RCM2_a174_curAB2ndRowLCrssCoup 1 "RCM2_ALERT_SET" 0 "RCM2_ALERT_CLEARED" ;
VAL_ 1009 RCM2_a175_curAB2ndRowLConfig 1 "RCM2_ALERT_SET" 0 "RCM2_ALERT_CLEARED" ;
VAL_ 1009 RCM2_a176_curAB2ndRowRSht2Gnd 1 "RCM2_ALERT_SET" 0 "RCM2_ALERT_CLEARED" ;
VAL_ 1009 RCM2_a177_curAB2ndRowRSht2Bat 1 "RCM2_ALERT_SET" 0 "RCM2_ALERT_CLEARED" ;
VAL_ 1009 RCM2_a178_curAB2ndRowROpen 1 "RCM2_ALERT_SET" 0 "RCM2_ALERT_CLEARED" ;
VAL_ 1009 RCM2_a179_curAB2ndRowRShort 1 "RCM2_ALERT_SET" 0 "RCM2_ALERT_CLEARED" ;
VAL_ 1009 RCM2_a180_curAB2ndRowRCrssCoup 1 "RCM2_ALERT_SET" 0 "RCM2_ALERT_CLEARED" ;
VAL_ 1009 RCM2_a181_curAB2ndRowRConfig 1 "RCM2_ALERT_SET" 0 "RCM2_ALERT_CLEARED" ;
VAL_ 1009 RCM2_a182_hoodActuatorRSht2Gnd 1 "RCM2_ALERT_SET" 0 "RCM2_ALERT_CLEARED" ;
VAL_ 1009 RCM2_a183_hoodActuatorRSht2Bat 1 "RCM2_ALERT_SET" 0 "RCM2_ALERT_CLEARED" ;
VAL_ 1009 RCM2_a184_hoodActuatorROpen 1 "RCM2_ALERT_SET" 0 "RCM2_ALERT_CLEARED" ;
VAL_ 1009 RCM2_a185_hoodActuatorRShort 1 "RCM2_ALERT_SET" 0 "RCM2_ALERT_CLEARED" ;
VAL_ 1009 RCM2_a186_hoodActuatorRCrssCoup 1 "RCM2_ALERT_SET" 0 "RCM2_ALERT_CLEARED" ;
VAL_ 1009 RCM2_a187_hoodActuatorRConfig 1 "RCM2_ALERT_SET" 0 "RCM2_ALERT_CLEARED" ;
VAL_ 1009 RCM2_a188_hoodActuatorLSht2Gnd 1 "RCM2_ALERT_SET" 0 "RCM2_ALERT_CLEARED" ;
VAL_ 1009 RCM2_a189_hoodActuatorLSht2Bat 1 "RCM2_ALERT_SET" 0 "RCM2_ALERT_CLEARED" ;
VAL_ 1009 RCM2_a190_hoodActuatorLOpen 1 "RCM2_ALERT_SET" 0 "RCM2_ALERT_CLEARED" ;
VAL_ 1009 RCM2_a191_hoodActuatorLShort 1 "RCM2_ALERT_SET" 0 "RCM2_ALERT_CLEARED" ;
VAL_ 1009 RCM2_a192_hoodActuatorLCrssCoup 1 "RCM2_ALERT_SET" 0 "RCM2_ALERT_CLEARED" ;
VAL_ 1009 RCM2_a193_hoodActuatorLConfig 1 "RCM2_ALERT_SET" 0 "RCM2_ALERT_CLEARED" ;
VAL_ 1009 RCM2_a250_ens1Sht2Bat 1 "RCM2_ALERT_SET" 0 "RCM2_ALERT_CLEARED" ;
VAL_ 1009 RCM2_a251_ens1Sht2Gnd 1 "RCM2_ALERT_SET" 0 "RCM2_ALERT_CLEARED" ;
VAL_ 1009 RCM2_a252_ens1Config 1 "RCM2_ALERT_SET" 0 "RCM2_ALERT_CLEARED" ;
VAL_ 1009 RCM2_a253_ens2Sht2Bat 1 "RCM2_ALERT_SET" 0 "RCM2_ALERT_CLEARED" ;
VAL_ 1009 RCM2_a254_ens2Sht2Gnd 1 "RCM2_ALERT_SET" 0 "RCM2_ALERT_CLEARED" ;
VAL_ 1009 RCM2_a255_ens2Config 1 "RCM2_ALERT_SET" 0 "RCM2_ALERT_CLEARED" ;
VAL_ 1009 RCM2_a300_imuAccXHgMonChlPerm 1 "RCM2_ALERT_SET" 0 "RCM2_ALERT_CLEARED" ;
VAL_ 1009 RCM2_a301_imuAccXHgMonChlTemp 1 "RCM2_ALERT_SET" 0 "RCM2_ALERT_CLEARED" ;
VAL_ 1009 RCM2_a302_imuAccYHgMonChlPerm 1 "RCM2_ALERT_SET" 0 "RCM2_ALERT_CLEARED" ;
VAL_ 1009 RCM2_a303_imuAccYHgMonChlTemp 1 "RCM2_ALERT_SET" 0 "RCM2_ALERT_CLEARED" ;
VAL_ 1009 RCM2_a304_imuYawR8SnsrPermBG 1 "RCM2_ALERT_SET" 0 "RCM2_ALERT_CLEARED" ;
VAL_ 1009 RCM2_a305_imuYawR8SnsrPermInit 1 "RCM2_ALERT_SET" 0 "RCM2_ALERT_CLEARED" ;
VAL_ 1009 RCM2_a306_imuYawR8SnsrPermLF 1 "RCM2_ALERT_SET" 0 "RCM2_ALERT_CLEARED" ;
VAL_ 1009 RCM2_a307_imuYawR8ChnlMonTmpLF 1 "RCM2_ALERT_SET" 0 "RCM2_ALERT_CLEARED" ;
VAL_ 1009 RCM2_a308_imuPitchR8SnsrPermBG 1 "RCM2_ALERT_SET" 0 "RCM2_ALERT_CLEARED" ;
VAL_ 1009 RCM2_a309_imuPitchR8SnsrPermInit 1 "RCM2_ALERT_SET" 0 "RCM2_ALERT_CLEARED" ;
VAL_ 1009 RCM2_a310_imuPitchR8SnsrPermLF 1 "RCM2_ALERT_SET" 0 "RCM2_ALERT_CLEARED" ;
VAL_ 1009 RCM2_a311_imuPitchR8ChnlMonTmpLF 1 "RCM2_ALERT_SET" 0 "RCM2_ALERT_CLEARED" ;
VAL_ 1009 RCM2_a312_imuRollR8SnsrPermBG 1 "RCM2_ALERT_SET" 0 "RCM2_ALERT_CLEARED" ;
VAL_ 1009 RCM2_a313_imuRollR8SnsrPermInit 1 "RCM2_ALERT_SET" 0 "RCM2_ALERT_CLEARED" ;
VAL_ 1009 RCM2_a314_imuRollR8SnsrPermLF 1 "RCM2_ALERT_SET" 0 "RCM2_ALERT_CLEARED" ;
VAL_ 1009 RCM2_a315_imuRollR8ChnlMonTmpLF 1 "RCM2_ALERT_SET" 0 "RCM2_ALERT_CLEARED" ;
VAL_ 1009 RCM2_a316_imuAccXLgMonChlPerm 1 "RCM2_ALERT_SET" 0 "RCM2_ALERT_CLEARED" ;
VAL_ 1009 RCM2_a317_imuAccXLgMonChlTemp 1 "RCM2_ALERT_SET" 0 "RCM2_ALERT_CLEARED" ;
VAL_ 1009 RCM2_a318_imuAccYLgMonChlPerm 1 "RCM2_ALERT_SET" 0 "RCM2_ALERT_CLEARED" ;
VAL_ 1009 RCM2_a319_imuAccYLgMonChlTemp 1 "RCM2_ALERT_SET" 0 "RCM2_ALERT_CLEARED" ;
VAL_ 1009 RCM2_a320_imuAccZLgMonChlPerm 1 "RCM2_ALERT_SET" 0 "RCM2_ALERT_CLEARED" ;
VAL_ 1009 RCM2_a321_imuAccZLgMonChlTemp 1 "RCM2_ALERT_SET" 0 "RCM2_ALERT_CLEARED" ;
VAL_ 1009 RCM2_a322_imuCalibrationFailed 1 "RCM2_ALERT_SET" 0 "RCM2_ALERT_CLEARED" ;
VAL_ 1009 RCM2_a323_imuCalibrationNotDone 1 "RCM2_ALERT_SET" 0 "RCM2_ALERT_CLEARED" ;
VAL_ 1009 RCM2_a350_upFrntSnsrLSht2Gnd 1 "RCM2_ALERT_SET" 0 "RCM2_ALERT_CLEARED" ;
VAL_ 1009 RCM2_a351_upFrntSnsrLSht2Bat 1 "RCM2_ALERT_SET" 0 "RCM2_ALERT_CLEARED" ;
VAL_ 1009 RCM2_a352_upFrntSnsrLOpen 1 "RCM2_ALERT_SET" 0 "RCM2_ALERT_CLEARED" ;
VAL_ 1009 RCM2_a353_upFrntSnsrLCrssCoup 1 "RCM2_ALERT_SET" 0 "RCM2_ALERT_CLEARED" ;
VAL_ 1009 RCM2_a354_upFrntSnsrLCommErr 1 "RCM2_ALERT_SET" 0 "RCM2_ALERT_CLEARED" ;
VAL_ 1009 RCM2_a355_upFrntSnsrLInitTyp 1 "RCM2_ALERT_SET" 0 "RCM2_ALERT_CLEARED" ;
VAL_ 1009 RCM2_a356_upFrntSnsrLConfig 1 "RCM2_ALERT_SET" 0 "RCM2_ALERT_CLEARED" ;
VAL_ 1009 RCM2_a357_upFrntSnsrLDefect 1 "RCM2_ALERT_SET" 0 "RCM2_ALERT_CLEARED" ;
VAL_ 1009 RCM2_a358_upFrntSnsrLSigMon 1 "RCM2_ALERT_SET" 0 "RCM2_ALERT_CLEARED" ;
VAL_ 1009 RCM2_a360_upFrntSnsrRSht2Gnd 1 "RCM2_ALERT_SET" 0 "RCM2_ALERT_CLEARED" ;
VAL_ 1009 RCM2_a361_upFrntSnsrRSht2Bat 1 "RCM2_ALERT_SET" 0 "RCM2_ALERT_CLEARED" ;
VAL_ 1009 RCM2_a362_upFrntSnsrROpen 1 "RCM2_ALERT_SET" 0 "RCM2_ALERT_CLEARED" ;
VAL_ 1009 RCM2_a363_upFrntSnsrRCrssCoup 1 "RCM2_ALERT_SET" 0 "RCM2_ALERT_CLEARED" ;
VAL_ 1009 RCM2_a364_upFrntSnsrRCommErr 1 "RCM2_ALERT_SET" 0 "RCM2_ALERT_CLEARED" ;
VAL_ 1009 RCM2_a365_upFrntSnsrRInitTyp 1 "RCM2_ALERT_SET" 0 "RCM2_ALERT_CLEARED" ;
VAL_ 1009 RCM2_a366_upFrntSnsrRConfig 1 "RCM2_ALERT_SET" 0 "RCM2_ALERT_CLEARED" ;
VAL_ 1009 RCM2_a367_upFrntSnsrRDefect 1 "RCM2_ALERT_SET" 0 "RCM2_ALERT_CLEARED" ;
VAL_ 1009 RCM2_a368_upFrntSnsrRSigMon 1 "RCM2_ALERT_SET" 0 "RCM2_ALERT_CLEARED" ;
VAL_ 1009 RCM2_a370_upFrntSnsrMidLSht2Gnd 1 "RCM2_ALERT_SET" 0 "RCM2_ALERT_CLEARED" ;
VAL_ 1009 RCM2_a371_upFrntSnsrMidLSht2Bat 1 "RCM2_ALERT_SET" 0 "RCM2_ALERT_CLEARED" ;
VAL_ 1009 RCM2_a372_upFrntSnsrMidLOpen 1 "RCM2_ALERT_SET" 0 "RCM2_ALERT_CLEARED" ;
VAL_ 1009 RCM2_a373_upFrntSnsrMidLCrssCoup 1 "RCM2_ALERT_SET" 0 "RCM2_ALERT_CLEARED" ;
VAL_ 1009 RCM2_a374_upFrntSnsrMidLCommErr 1 "RCM2_ALERT_SET" 0 "RCM2_ALERT_CLEARED" ;
VAL_ 1009 RCM2_a375_upFrntSnsrMidLInitTyp 1 "RCM2_ALERT_SET" 0 "RCM2_ALERT_CLEARED" ;
VAL_ 1009 RCM2_a376_upFrntSnsrMidLConfig 1 "RCM2_ALERT_SET" 0 "RCM2_ALERT_CLEARED" ;
VAL_ 1009 RCM2_a377_upFrntSnsrMidLDefect 1 "RCM2_ALERT_SET" 0 "RCM2_ALERT_CLEARED" ;
VAL_ 1009 RCM2_a378_upFrntSnsrMidLSigMon 1 "RCM2_ALERT_SET" 0 "RCM2_ALERT_CLEARED" ;
VAL_ 1009 RCM2_a380_upFrntSnsrMidRSht2Gnd 1 "RCM2_ALERT_SET" 0 "RCM2_ALERT_CLEARED" ;
VAL_ 1009 RCM2_a381_upFrntSnsrMidRSht2Bat 1 "RCM2_ALERT_SET" 0 "RCM2_ALERT_CLEARED" ;
VAL_ 1009 RCM2_a382_upFrntSnsrMidROpen 1 "RCM2_ALERT_SET" 0 "RCM2_ALERT_CLEARED" ;
VAL_ 1009 RCM2_a383_upFrntSnsrMidRCrssCoup 1 "RCM2_ALERT_SET" 0 "RCM2_ALERT_CLEARED" ;
VAL_ 1009 RCM2_a384_upFrntSnsrMidRCommErr 1 "RCM2_ALERT_SET" 0 "RCM2_ALERT_CLEARED" ;
VAL_ 1009 RCM2_a385_upFrntSnsrMidRInitTyp 1 "RCM2_ALERT_SET" 0 "RCM2_ALERT_CLEARED" ;
VAL_ 1009 RCM2_a386_upFrntSnsrMidRConfig 1 "RCM2_ALERT_SET" 0 "RCM2_ALERT_CLEARED" ;
VAL_ 1009 RCM2_a387_upFrntSnsrMidRDefect 1 "RCM2_ALERT_SET" 0 "RCM2_ALERT_CLEARED" ;
VAL_ 1009 RCM2_a388_upFrntSnsrMidRSigMon 1 "RCM2_ALERT_SET" 0 "RCM2_ALERT_CLEARED" ;
VAL_ 1009 RCM2_a390_sideAccelBPilLSht2Gnd 1 "RCM2_ALERT_SET" 0 "RCM2_ALERT_CLEARED" ;
VAL_ 1009 RCM2_a391_sideAccelBPilLSht2Bat 1 "RCM2_ALERT_SET" 0 "RCM2_ALERT_CLEARED" ;
VAL_ 1009 RCM2_a392_sideAccelBPilLOpen 1 "RCM2_ALERT_SET" 0 "RCM2_ALERT_CLEARED" ;
VAL_ 1009 RCM2_a393_sideAccelBPilLCLosCoup 1 "RCM2_ALERT_SET" 0 "RCM2_ALERT_CLEARED" ;
VAL_ 1009 RCM2_a394_sideAccelBPilLCommErr 1 "RCM2_ALERT_SET" 0 "RCM2_ALERT_CLEARED" ;
VAL_ 1009 RCM2_a395_sideAccelBPilLInitTyp 1 "RCM2_ALERT_SET" 0 "RCM2_ALERT_CLEARED" ;
VAL_ 1009 RCM2_a396_sideAccelBPilLConfig 1 "RCM2_ALERT_SET" 0 "RCM2_ALERT_CLEARED" ;
VAL_ 1009 RCM2_a397_sideAccelBPilLDefect 1 "RCM2_ALERT_SET" 0 "RCM2_ALERT_CLEARED" ;
VAL_ 1009 RCM2_a398_sideAccelBPilLSigMon 1 "RCM2_ALERT_SET" 0 "RCM2_ALERT_CLEARED" ;
VAL_ 1009 RCM2_a400_sideAccelBPilRSht2Gnd 1 "RCM2_ALERT_SET" 0 "RCM2_ALERT_CLEARED" ;
VAL_ 1009 RCM2_a401_sideAccelBPilRSht2Bat 1 "RCM2_ALERT_SET" 0 "RCM2_ALERT_CLEARED" ;
VAL_ 1009 RCM2_a402_sideAccelBPilROpen 1 "RCM2_ALERT_SET" 0 "RCM2_ALERT_CLEARED" ;
VAL_ 1009 RCM2_a403_sideAccelBPilRCrssCoup 1 "RCM2_ALERT_SET" 0 "RCM2_ALERT_CLEARED" ;
VAL_ 1009 RCM2_a404_sideAccelBPilRCommErr 1 "RCM2_ALERT_SET" 0 "RCM2_ALERT_CLEARED" ;
VAL_ 1009 RCM2_a405_sideAccelBPilRInitTyp 1 "RCM2_ALERT_SET" 0 "RCM2_ALERT_CLEARED" ;
VAL_ 1009 RCM2_a406_sideAccelBPilRConfig 1 "RCM2_ALERT_SET" 0 "RCM2_ALERT_CLEARED" ;
VAL_ 1009 RCM2_a407_sideAccelBPilRDefect 1 "RCM2_ALERT_SET" 0 "RCM2_ALERT_CLEARED" ;
VAL_ 1009 RCM2_a408_sideAccelBPilRSigMon 1 "RCM2_ALERT_SET" 0 "RCM2_ALERT_CLEARED" ;
VAL_ 1009 RCM2_a410_sideAccelCPilLSht2Gnd 1 "RCM2_ALERT_SET" 0 "RCM2_ALERT_CLEARED" ;
VAL_ 1009 RCM2_a411_sideAccelCPilLSht2Bat 1 "RCM2_ALERT_SET" 0 "RCM2_ALERT_CLEARED" ;
VAL_ 1009 RCM2_a412_sideAccelCPilLOpen 1 "RCM2_ALERT_SET" 0 "RCM2_ALERT_CLEARED" ;
VAL_ 1009 RCM2_a413_sideAccelCPilLCrssCoup 1 "RCM2_ALERT_SET" 0 "RCM2_ALERT_CLEARED" ;
VAL_ 1009 RCM2_a414_sideAccelCPilLCommErr 1 "RCM2_ALERT_SET" 0 "RCM2_ALERT_CLEARED" ;
VAL_ 1009 RCM2_a415_sideAccelCPilLInitTyp 1 "RCM2_ALERT_SET" 0 "RCM2_ALERT_CLEARED" ;
VAL_ 1009 RCM2_a416_sideAccelCPilLConfig 1 "RCM2_ALERT_SET" 0 "RCM2_ALERT_CLEARED" ;
VAL_ 1009 RCM2_a417_sideAccelCPilLDefect 1 "RCM2_ALERT_SET" 0 "RCM2_ALERT_CLEARED" ;
VAL_ 1009 RCM2_a418_sideAccelCPilLSigMon 1 "RCM2_ALERT_SET" 0 "RCM2_ALERT_CLEARED" ;
VAL_ 1009 RCM2_a420_sideAccelCPilRSht2Gnd 1 "RCM2_ALERT_SET" 0 "RCM2_ALERT_CLEARED" ;
VAL_ 1009 RCM2_a421_sideAccelCPilRSht2Bat 1 "RCM2_ALERT_SET" 0 "RCM2_ALERT_CLEARED" ;
VAL_ 1009 RCM2_a422_sideAccelCPilROpen 1 "RCM2_ALERT_SET" 0 "RCM2_ALERT_CLEARED" ;
VAL_ 1009 RCM2_a423_sideAccelCPilRCrssCoup 1 "RCM2_ALERT_SET" 0 "RCM2_ALERT_CLEARED" ;
VAL_ 1009 RCM2_a424_sideAccelCPilRCommErr 1 "RCM2_ALERT_SET" 0 "RCM2_ALERT_CLEARED" ;
VAL_ 1009 RCM2_a425_sideAccelCPilRInitTyp 1 "RCM2_ALERT_SET" 0 "RCM2_ALERT_CLEARED" ;
VAL_ 1009 RCM2_a426_sideAccelCPilRConfig 1 "RCM2_ALERT_SET" 0 "RCM2_ALERT_CLEARED" ;
VAL_ 1009 RCM2_a427_sideAccelCPilRDefect 1 "RCM2_ALERT_SET" 0 "RCM2_ALERT_CLEARED" ;
VAL_ 1009 RCM2_a428_sideAccelCPilRSigMon 1 "RCM2_ALERT_SET" 0 "RCM2_ALERT_CLEARED" ;
VAL_ 1009 RCM2_a430_presFrntLDoorSht2Gnd 1 "RCM2_ALERT_SET" 0 "RCM2_ALERT_CLEARED" ;
VAL_ 1009 RCM2_a431_presFrntLDoorSht2Bat 1 "RCM2_ALERT_SET" 0 "RCM2_ALERT_CLEARED" ;
VAL_ 1009 RCM2_a432_presFrntLDoorOpen 1 "RCM2_ALERT_SET" 0 "RCM2_ALERT_CLEARED" ;
VAL_ 1009 RCM2_a433_presFrntLDoorCrssCoup 1 "RCM2_ALERT_SET" 0 "RCM2_ALERT_CLEARED" ;
VAL_ 1009 RCM2_a434_presFrntLDoorCommErr 1 "RCM2_ALERT_SET" 0 "RCM2_ALERT_CLEARED" ;
VAL_ 1009 RCM2_a435_presFrntLDoorInitTyp 1 "RCM2_ALERT_SET" 0 "RCM2_ALERT_CLEARED" ;
VAL_ 1009 RCM2_a436_presFrntLDoorConfig 1 "RCM2_ALERT_SET" 0 "RCM2_ALERT_CLEARED" ;
VAL_ 1009 RCM2_a437_presFrntLDoorDefect 1 "RCM2_ALERT_SET" 0 "RCM2_ALERT_CLEARED" ;
VAL_ 1009 RCM2_a438_presFrntLDoorSigMon 1 "RCM2_ALERT_SET" 0 "RCM2_ALERT_CLEARED" ;
VAL_ 1009 RCM2_a439_presDoorAbsolute1 1 "RCM2_ALERT_SET" 0 "RCM2_ALERT_CLEARED" ;
VAL_ 1009 RCM2_a440_presFrntRDoorSht2Gnd 1 "RCM2_ALERT_SET" 0 "RCM2_ALERT_CLEARED" ;
VAL_ 1009 RCM2_a441_presFrntRDoorSht2Bat 1 "RCM2_ALERT_SET" 0 "RCM2_ALERT_CLEARED" ;
VAL_ 1009 RCM2_a442_presFrntRDoorOpen 1 "RCM2_ALERT_SET" 0 "RCM2_ALERT_CLEARED" ;
VAL_ 1009 RCM2_a443_presFrntRDoorCrssCoup 1 "RCM2_ALERT_SET" 0 "RCM2_ALERT_CLEARED" ;
VAL_ 1009 RCM2_a444_presFrntRDoorCommErr 1 "RCM2_ALERT_SET" 0 "RCM2_ALERT_CLEARED" ;
VAL_ 1009 RCM2_a445_presFrntRDoorInitTyp 1 "RCM2_ALERT_SET" 0 "RCM2_ALERT_CLEARED" ;
VAL_ 1009 RCM2_a446_presFrntRDoorConfig 1 "RCM2_ALERT_SET" 0 "RCM2_ALERT_CLEARED" ;
VAL_ 1009 RCM2_a447_presFrntRDoorDefect 1 "RCM2_ALERT_SET" 0 "RCM2_ALERT_CLEARED" ;
VAL_ 1009 RCM2_a448_presFrntRDoorSigMon 1 "RCM2_ALERT_SET" 0 "RCM2_ALERT_CLEARED" ;
VAL_ 1009 RCM2_a449_presDoorAbsolute2 1 "RCM2_ALERT_SET" 0 "RCM2_ALERT_CLEARED" ;
VAL_ 1009 RCM2_a450_presPedProLSht2Gnd 1 "RCM2_ALERT_SET" 0 "RCM2_ALERT_CLEARED" ;
VAL_ 1009 RCM2_a451_presPedProLSht2Bat 1 "RCM2_ALERT_SET" 0 "RCM2_ALERT_CLEARED" ;
VAL_ 1009 RCM2_a452_presPedProLOpen 1 "RCM2_ALERT_SET" 0 "RCM2_ALERT_CLEARED" ;
VAL_ 1009 RCM2_a453_presPedProLCrssCoup 1 "RCM2_ALERT_SET" 0 "RCM2_ALERT_CLEARED" ;
VAL_ 1009 RCM2_a454_presPedProLCommErr 1 "RCM2_ALERT_SET" 0 "RCM2_ALERT_CLEARED" ;
VAL_ 1009 RCM2_a455_presPedProLInitTyp 1 "RCM2_ALERT_SET" 0 "RCM2_ALERT_CLEARED" ;
VAL_ 1009 RCM2_a456_presPedProLConfig 1 "RCM2_ALERT_SET" 0 "RCM2_ALERT_CLEARED" ;
VAL_ 1009 RCM2_a457_presPedProLDefect 1 "RCM2_ALERT_SET" 0 "RCM2_ALERT_CLEARED" ;
VAL_ 1009 RCM2_a458_presPedProLSigMon 1 "RCM2_ALERT_SET" 0 "RCM2_ALERT_CLEARED" ;
VAL_ 1009 RCM2_a460_presPedProRSht2Gnd 1 "RCM2_ALERT_SET" 0 "RCM2_ALERT_CLEARED" ;
VAL_ 1009 RCM2_a461_presPedProRSht2Bat 1 "RCM2_ALERT_SET" 0 "RCM2_ALERT_CLEARED" ;
VAL_ 1009 RCM2_a462_presPedProROpen 1 "RCM2_ALERT_SET" 0 "RCM2_ALERT_CLEARED" ;
VAL_ 1009 RCM2_a463_presPedProRCrssCoup 1 "RCM2_ALERT_SET" 0 "RCM2_ALERT_CLEARED" ;
VAL_ 1009 RCM2_a464_presPedProRCommErr 1 "RCM2_ALERT_SET" 0 "RCM2_ALERT_CLEARED" ;
VAL_ 1009 RCM2_a465_presPedProRInitTyp 1 "RCM2_ALERT_SET" 0 "RCM2_ALERT_CLEARED" ;
VAL_ 1009 RCM2_a466_presPedProRConfig 1 "RCM2_ALERT_SET" 0 "RCM2_ALERT_CLEARED" ;
VAL_ 1009 RCM2_a467_presPedProRDefect 1 "RCM2_ALERT_SET" 0 "RCM2_ALERT_CLEARED" ;
VAL_ 1009 RCM2_a468_presPedProRSigMon 1 "RCM2_ALERT_SET" 0 "RCM2_ALERT_CLEARED" ;
VAL_ 1009 RCM2_a469_presPedProAbsolute 1 "RCM2_ALERT_SET" 0 "RCM2_ALERT_CLEARED" ;
VAL_ 1009 RCM2_a470_upFrntPedProLSht2Gnd 1 "RCM2_ALERT_SET" 0 "RCM2_ALERT_CLEARED" ;
VAL_ 1009 RCM2_a471_upFrntPedProLSht2Bat 1 "RCM2_ALERT_SET" 0 "RCM2_ALERT_CLEARED" ;
VAL_ 1009 RCM2_a472_upFrntPedProLOpen 1 "RCM2_ALERT_SET" 0 "RCM2_ALERT_CLEARED" ;
VAL_ 1009 RCM2_a473_upFrntPedProLCrssCoup 1 "RCM2_ALERT_SET" 0 "RCM2_ALERT_CLEARED" ;
VAL_ 1009 RCM2_a474_upFrntPedProLCommErr 1 "RCM2_ALERT_SET" 0 "RCM2_ALERT_CLEARED" ;
VAL_ 1009 RCM2_a475_upFrntPedProLIntTyp 1 "RCM2_ALERT_SET" 0 "RCM2_ALERT_CLEARED" ;
VAL_ 1009 RCM2_a476_upFrntPedProLConfig 1 "RCM2_ALERT_SET" 0 "RCM2_ALERT_CLEARED" ;
VAL_ 1009 RCM2_a477_upFrntPedProLDefect 1 "RCM2_ALERT_SET" 0 "RCM2_ALERT_CLEARED" ;
VAL_ 1009 RCM2_a478_upFrntPedProSht2Gnd 1 "RCM2_ALERT_SET" 0 "RCM2_ALERT_CLEARED" ;
VAL_ 1009 RCM2_a480_upFrntPedProRSht2Gnd 1 "RCM2_ALERT_SET" 0 "RCM2_ALERT_CLEARED" ;
VAL_ 1009 RCM2_a481_upFrntPedProRSht2Bat 1 "RCM2_ALERT_SET" 0 "RCM2_ALERT_CLEARED" ;
VAL_ 1009 RCM2_a482_upFrntPedProROpen 1 "RCM2_ALERT_SET" 0 "RCM2_ALERT_CLEARED" ;
VAL_ 1009 RCM2_a483_upFrntPedProRCrssCoup 1 "RCM2_ALERT_SET" 0 "RCM2_ALERT_CLEARED" ;
VAL_ 1009 RCM2_a484_upFrntPedProRCommErr 1 "RCM2_ALERT_SET" 0 "RCM2_ALERT_CLEARED" ;
VAL_ 1009 RCM2_a485_upFrntPedProRIntTyp 1 "RCM2_ALERT_SET" 0 "RCM2_ALERT_CLEARED" ;
VAL_ 1009 RCM2_a486_upFrntPedProRConfig 1 "RCM2_ALERT_SET" 0 "RCM2_ALERT_CLEARED" ;
VAL_ 1009 RCM2_a487_upFrntPedProRDefect 1 "RCM2_ALERT_SET" 0 "RCM2_ALERT_CLEARED" ;
VAL_ 1009 RCM2_a488_upFrntPedProSht2Gnd 1 "RCM2_ALERT_SET" 0 "RCM2_ALERT_CLEARED" ;
VAL_ 1009 RCM2_a550_bucklHallLeftSht2Gnd 1 "RCM2_ALERT_SET" 0 "RCM2_ALERT_CLEARED" ;
VAL_ 1009 RCM2_a551_bucklHallLeftSht2Bat 1 "RCM2_ALERT_SET" 0 "RCM2_ALERT_CLEARED" ;
VAL_ 1009 RCM2_a552_bucklHallLeftOpen 1 "RCM2_ALERT_SET" 0 "RCM2_ALERT_CLEARED" ;
VAL_ 1009 RCM2_a553_bucklHallLeftUndef 1 "RCM2_ALERT_SET" 0 "RCM2_ALERT_CLEARED" ;
VAL_ 1009 RCM2_a554_bucklHallLeftCrssCoup 1 "RCM2_ALERT_SET" 0 "RCM2_ALERT_CLEARED" ;
VAL_ 1009 RCM2_a555_bucklHallLeftConfig 1 "RCM2_ALERT_SET" 0 "RCM2_ALERT_CLEARED" ;
VAL_ 1009 RCM2_a556_bucklHallRightSht2Gnd 1 "RCM2_ALERT_SET" 0 "RCM2_ALERT_CLEARED" ;
VAL_ 1009 RCM2_a557_bucklHallRightSht2Bat 1 "RCM2_ALERT_SET" 0 "RCM2_ALERT_CLEARED" ;
VAL_ 1009 RCM2_a558_bucklHallRightOpen 1 "RCM2_ALERT_SET" 0 "RCM2_ALERT_CLEARED" ;
VAL_ 1009 RCM2_a559_bucklHallRightUndef 1 "RCM2_ALERT_SET" 0 "RCM2_ALERT_CLEARED" ;
VAL_ 1009 RCM2_a560_bucklHallRightCrssCoup 1 "RCM2_ALERT_SET" 0 "RCM2_ALERT_CLEARED" ;
VAL_ 1009 RCM2_a561_bucklHallRightConfig 1 "RCM2_ALERT_SET" 0 "RCM2_ALERT_CLEARED" ;
VAL_ 1009 RCM2_a562_seaTrkPosLeftSht2Gnd 1 "RCM2_ALERT_SET" 0 "RCM2_ALERT_CLEARED" ;
VAL_ 1009 RCM2_a563_seaTrkPosLeftShtBat 1 "RCM2_ALERT_SET" 0 "RCM2_ALERT_CLEARED" ;
VAL_ 1009 RCM2_a564_seaTrkPosLeftOpen 1 "RCM2_ALERT_SET" 0 "RCM2_ALERT_CLEARED" ;
VAL_ 1009 RCM2_a565_seaTrkPosLeftUndefined 1 "RCM2_ALERT_SET" 0 "RCM2_ALERT_CLEARED" ;
VAL_ 1009 RCM2_a566_seaTrkPosLeftCrssCoup 1 "RCM2_ALERT_SET" 0 "RCM2_ALERT_CLEARED" ;
