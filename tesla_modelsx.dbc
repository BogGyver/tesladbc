VERSION "$Format:%h$"

NS_ :

BS_:

BU_: APB APP APS BCCEN BDY DAS DBG EAS EPAS EPAS2 EPAS3S EPB EPBM ESP GTW GTWU IBST IC MCU OCS PARK PARK3 RADAR RCM RT3000 SCCM SDM SEC TAS TAS2 TAS2DBG TOOL TPMS VCSEATD VCSEATP

BO_ 1486 PARK_alertLog: 8 PARK
 SG_ PARK_alertID M : 0|15@1+ (1,0) [0|0] "" GTW
 SG_ PARK_sw041_subCode m41 : 55|9@1+ (1,0) [0|0] "" GTW
 SG_ PARK_sw042_expData m42 : 16|8@1+ (1,0) [0|255] "" GTW
 SG_ PARK_sw042_actData m42 : 24|8@1+ (1,0) [0|255] "" GTW
 SG_ PARK_sw042_timeHours m42 : 32|5@1+ (1,0) [0|30] "hours" GTW
 SG_ PARK_sw042_timeMinutes m42 : 40|6@1+ (1,0) [0|60] "minutes" GTW
 SG_ PARK_sw042_timeSeconds m42 : 48|7@1+ (0.5,0) [0|60] "seconds" GTW
 SG_ PARK_sw042_subCode m42 : 55|9@1+ (1,0) [0|0] "" GTW
 SG_ PARK_sw043_expData m43 : 16|8@1+ (1,0) [0|255] "" GTW
 SG_ PARK_sw043_actData m43 : 24|8@1+ (1,0) [0|255] "" GTW
 SG_ PARK_sw043_timeHours m43 : 32|5@1+ (1,0) [0|30] "hours" GTW
 SG_ PARK_sw043_timeMinutes m43 : 40|6@1+ (1,0) [0|60] "minutes" GTW
 SG_ PARK_sw043_timeSeconds m43 : 48|7@1+ (0.5,0) [0|60] "seconds" GTW
 SG_ PARK_sw043_subCode m43 : 55|9@1+ (1,0) [0|0] "" GTW
 SG_ PARK_sw044_expData m44 : 16|8@1+ (1,0) [0|255] "" GTW
 SG_ PARK_sw044_actData m44 : 24|8@1+ (1,0) [0|255] "" GTW
 SG_ PARK_sw044_timeHours m44 : 32|5@1+ (1,0) [0|30] "hours" GTW
 SG_ PARK_sw044_timeMinutes m44 : 40|6@1+ (1,0) [0|60] "minutes" GTW
 SG_ PARK_sw044_timeSeconds m44 : 48|7@1+ (0.5,0) [0|60] "seconds" GTW
 SG_ PARK_sw044_subCode m44 : 55|9@1+ (1,0) [0|0] "" GTW
 SG_ PARK_sw045_expData m45 : 16|8@1+ (1,0) [0|255] "" GTW
 SG_ PARK_sw045_actData m45 : 24|8@1+ (1,0) [0|255] "" GTW
 SG_ PARK_sw045_timeHours m45 : 32|5@1+ (1,0) [0|30] "hours" GTW
 SG_ PARK_sw045_timeMinutes m45 : 40|6@1+ (1,0) [0|60] "minutes" GTW
 SG_ PARK_sw045_timeSeconds m45 : 48|7@1+ (0.5,0) [0|60] "seconds" GTW
 SG_ PARK_sw045_subCode m45 : 55|9@1+ (1,0) [0|0] "" GTW
 SG_ PARK_sw046_expData m46 : 16|8@1+ (1,0) [0|255] "" GTW
 SG_ PARK_sw046_actData m46 : 24|8@1+ (1,0) [0|255] "" GTW
 SG_ PARK_sw046_timeHours m46 : 32|5@1+ (1,0) [0|30] "hours" GTW
 SG_ PARK_sw046_timeMinutes m46 : 40|6@1+ (1,0) [0|60] "minutes" GTW
 SG_ PARK_sw046_timeSeconds m46 : 48|7@1+ (0.5,0) [0|60] "seconds" GTW
 SG_ PARK_sw046_subCode m46 : 55|9@1+ (1,0) [0|0] "" GTW
 SG_ PARK_sw047_expData m47 : 16|8@1+ (1,0) [0|255] "" GTW
 SG_ PARK_sw047_actData m47 : 24|8@1+ (1,0) [0|255] "" GTW
 SG_ PARK_sw047_timeHours m47 : 32|5@1+ (1,0) [0|30] "hours" GTW
 SG_ PARK_sw047_timeMinutes m47 : 40|6@1+ (1,0) [0|60] "minutes" GTW
 SG_ PARK_sw047_timeSeconds m47 : 48|7@1+ (0.5,0) [0|60] "seconds" GTW
 SG_ PARK_sw047_subCode m47 : 55|9@1+ (1,0) [0|0] "" GTW
 SG_ PARK_sw048_expData m48 : 16|8@1+ (1,0) [0|255] "" GTW
 SG_ PARK_sw048_actData m48 : 24|8@1+ (1,0) [0|255] "" GTW
 SG_ PARK_sw048_timeHours m48 : 32|5@1+ (1,0) [0|30] "hours" GTW
 SG_ PARK_sw048_timeMinutes m48 : 40|6@1+ (1,0) [0|60] "minutes" GTW
 SG_ PARK_sw048_timeSeconds m48 : 48|7@1+ (0.5,0) [0|60] "seconds" GTW
 SG_ PARK_sw048_subCode m48 : 55|9@1+ (1,0) [0|0] "" GTW
 SG_ PARK_sw049_expData m49 : 16|8@1+ (1,0) [0|255] "" GTW
 SG_ PARK_sw049_actData m49 : 24|8@1+ (1,0) [0|255] "" GTW
 SG_ PARK_sw049_timeHours m49 : 32|5@1+ (1,0) [0|30] "hours" GTW
 SG_ PARK_sw049_timeMinutes m49 : 40|6@1+ (1,0) [0|60] "minutes" GTW
 SG_ PARK_sw049_timeSeconds m49 : 48|7@1+ (0.5,0) [0|60] "seconds" GTW
 SG_ PARK_sw049_subCode m49 : 55|9@1+ (1,0) [0|0] "" GTW
 SG_ PARK_sw050_expData m50 : 16|8@1+ (1,0) [0|255] "" GTW
 SG_ PARK_sw050_actData m50 : 24|8@1+ (1,0) [0|255] "" GTW
 SG_ PARK_sw050_timeHours m50 : 32|5@1+ (1,0) [0|30] "hours" GTW
 SG_ PARK_sw050_timeMinutes m50 : 40|6@1+ (1,0) [0|60] "minutes" GTW
 SG_ PARK_sw050_timeSeconds m50 : 48|7@1+ (0.5,0) [0|60] "seconds" GTW
 SG_ PARK_sw050_subCode m50 : 55|9@1+ (1,0) [0|0] "" GTW
 SG_ PARK_sw051_expData m51 : 16|8@1+ (1,0) [0|255] "" GTW
 SG_ PARK_sw051_actData m51 : 24|8@1+ (1,0) [0|255] "" GTW
 SG_ PARK_sw051_timeHours m51 : 32|5@1+ (1,0) [0|30] "hours" GTW
 SG_ PARK_sw051_timeMinutes m51 : 40|6@1+ (1,0) [0|60] "minutes" GTW
 SG_ PARK_sw051_timeSeconds m51 : 48|7@1+ (0.5,0) [0|60] "seconds" GTW
 SG_ PARK_sw051_subCode m51 : 55|9@1+ (1,0) [0|0] "" GTW
 SG_ PARK_sw052_ambTemp m52 : 16|8@1+ (0.5,-40) [-40|87.5] "C" GTW
 SG_ PARK_sw052_voltage m52 : 24|8@1+ (0.1,0) [0|25.4] "V" GTW
 SG_ PARK_sw052_timeHours m52 : 32|5@1+ (1,0) [0|30] "hours" GTW
 SG_ PARK_sw052_timeMinutes m52 : 40|6@1+ (1,0) [0|60] "minutes" GTW
 SG_ PARK_sw052_timeSeconds m52 : 48|7@1+ (0.5,0) [0|60] "seconds" GTW
 SG_ PARK_sw052_subCode m52 : 55|9@1+ (1,0) [0|0] "" GTW
 SG_ PARK_sw053_ambTemp m53 : 16|8@1+ (0.5,-40) [-40|87.5] "C" GTW
 SG_ PARK_sw053_voltage m53 : 24|8@1+ (0.1,0) [0|25.4] "V" GTW
 SG_ PARK_sw053_timeHours m53 : 32|5@1+ (1,0) [0|30] "hours" GTW
 SG_ PARK_sw053_timeMinutes m53 : 40|6@1+ (1,0) [0|60] "minutes" GTW
 SG_ PARK_sw053_timeSeconds m53 : 48|7@1+ (0.5,0) [0|60] "seconds" GTW
 SG_ PARK_sw053_subCode m53 : 55|9@1+ (1,0) [0|0] "" GTW
 SG_ PARK_sw054_ambTemp m54 : 16|8@1+ (0.5,-40) [-40|87.5] "C" GTW
 SG_ PARK_sw054_voltage m54 : 24|8@1+ (0.1,0) [0|25.4] "V" GTW
 SG_ PARK_sw054_timeHours m54 : 32|5@1+ (1,0) [0|30] "hours" GTW
 SG_ PARK_sw054_timeMinutes m54 : 40|6@1+ (1,0) [0|60] "minutes" GTW
 SG_ PARK_sw054_timeSeconds m54 : 48|7@1+ (0.5,0) [0|60] "seconds" GTW
 SG_ PARK_sw054_subCode m54 : 55|9@1+ (1,0) [0|0] "" GTW
 SG_ PARK_sw055_ambTemp m55 : 16|8@1+ (0.5,-40) [-40|87.5] "C" GTW
 SG_ PARK_sw055_voltage m55 : 24|8@1+ (0.1,0) [0|25.4] "V" GTW
 SG_ PARK_sw055_timeHours m55 : 32|5@1+ (1,0) [0|30] "hours" GTW
 SG_ PARK_sw055_timeMinutes m55 : 40|6@1+ (1,0) [0|60] "minutes" GTW
 SG_ PARK_sw055_timeSeconds m55 : 48|7@1+ (0.5,0) [0|60] "seconds" GTW
 SG_ PARK_sw055_subCode m55 : 55|9@1+ (1,0) [0|0] "" GTW
 SG_ PARK_sw056_ambTemp m56 : 16|8@1+ (0.5,-40) [-40|87.5] "C" GTW
 SG_ PARK_sw056_voltage m56 : 24|8@1+ (0.1,0) [0|25.4] "V" GTW
 SG_ PARK_sw056_timeHours m56 : 32|5@1+ (1,0) [0|30] "hours" GTW
 SG_ PARK_sw056_timeMinutes m56 : 40|6@1+ (1,0) [0|60] "minutes" GTW
 SG_ PARK_sw056_timeSeconds m56 : 48|7@1+ (0.5,0) [0|60] "seconds" GTW
 SG_ PARK_sw056_subCode m56 : 55|9@1+ (1,0) [0|0] "" GTW
 SG_ PARK_sw057_ambTemp m57 : 16|8@1+ (0.5,-40) [-40|87.5] "C" GTW
 SG_ PARK_sw057_voltage m57 : 24|8@1+ (0.1,0) [0|25.4] "V" GTW
 SG_ PARK_sw057_timeHours m57 : 32|5@1+ (1,0) [0|30] "hours" GTW
 SG_ PARK_sw057_timeMinutes m57 : 40|6@1+ (1,0) [0|60] "minutes" GTW
 SG_ PARK_sw057_timeSeconds m57 : 48|7@1+ (0.5,0) [0|60] "seconds" GTW
 SG_ PARK_sw057_subCode m57 : 55|9@1+ (1,0) [0|0] "" GTW
 SG_ PARK_sw058_ambTemp m58 : 16|8@1+ (0.5,-40) [-40|87.5] "C" GTW
 SG_ PARK_sw058_voltage m58 : 24|8@1+ (0.1,0) [0|25.4] "V" GTW
 SG_ PARK_sw058_timeHours m58 : 32|5@1+ (1,0) [0|30] "hours" GTW
 SG_ PARK_sw058_timeMinutes m58 : 40|6@1+ (1,0) [0|60] "minutes" GTW
 SG_ PARK_sw058_timeSeconds m58 : 48|7@1+ (0.5,0) [0|60] "seconds" GTW
 SG_ PARK_sw058_subCode m58 : 55|9@1+ (1,0) [0|0] "" GTW
 SG_ PARK_sw059_ambTemp m59 : 16|8@1+ (0.5,-40) [-40|87.5] "C" GTW
 SG_ PARK_sw059_voltage m59 : 24|8@1+ (0.1,0) [0|25.4] "V" GTW
 SG_ PARK_sw059_timeHours m59 : 32|5@1+ (1,0) [0|30] "hours" GTW
 SG_ PARK_sw059_timeMinutes m59 : 40|6@1+ (1,0) [0|60] "minutes" GTW
 SG_ PARK_sw059_timeSeconds m59 : 48|7@1+ (0.5,0) [0|60] "seconds" GTW
 SG_ PARK_sw059_subCode m59 : 55|9@1+ (1,0) [0|0] "" GTW
 SG_ PARK_sw060_ambTemp m60 : 16|8@1+ (0.5,-40) [-40|87.5] "C" GTW
 SG_ PARK_sw060_voltage m60 : 24|8@1+ (0.1,0) [0|25.4] "V" GTW
 SG_ PARK_sw060_timeHours m60 : 32|5@1+ (1,0) [0|30] "hours" GTW
 SG_ PARK_sw060_timeMinutes m60 : 40|6@1+ (1,0) [0|60] "minutes" GTW
 SG_ PARK_sw060_timeSeconds m60 : 48|7@1+ (0.5,0) [0|60] "seconds" GTW

BA_DEF_ BO_ "AlertLogSubSystemId" INT 0 0;
BA_DEF_ BO_ "AlertType" INT 0 4;
BA_DEF_ BO_ "AppBotschaft" ENUM "nein","ja";
BA_DEF_ BO_ "DiagRequest" ENUM "No","Yes";
BA_DEF_ BO_ "DiagResponse" ENUM "No","Yes";
BA_DEF_ BO_ "ETHGatewayMessageSendType" ENUM "UseGenMsgSendType","onWrite","noAutoCode";
BA_DEF_ BO_ "ETHId" STRING ;
BA_DEF_ BO_ "GatewayHandlerEnum" ENUM "noHandler","uds","alertLog","messageLogOnReception","udsClient";
BA_DEF_ BO_ "GatewayMessageAtomic" ENUM "No","Yes";
BA_DEF_ BO_ "GatewayMessageSendType" ENUM "UseGenMsgSendType","onWrite","noAutoCode";
BA_DEF_ BO_ "GenMsgCycleTime" INT 0 0;
BA_DEF_ BO_ "GenMsgCycleTimeFast" INT 0 0;
BA_DEF_ BO_ "GenMsgDelayTime" INT 0 0;
BA_DEF_ BO_ "GenMsgForceMiaCheck" ENUM "No","Yes";
BA_DEF_ BO_ "GenMsgGatewayNotification" STRING ;
BA_DEF_ BO_ "GenMsgILSupport" ENUM "No","Yes";
BA_DEF_ BO_ "GenMsgSaltingFunction" ENUM "No","Yes";
BA_DEF_ BO_ "GenMsgSendType" ENUM "Cyclic","NotUsed","NotUsed","NotUsed","NotUsed","NotUsed","NotUsed","IfActive","NoMsgSendType","Sporadic";
BA_DEF_ BO_ "GenMsgStartValue" STRING ;
BA_DEF_ BO_ "GenMsgTimeOut" INT 0 0;
BA_DEF_ BO_ "MessageIdType" ENUM "normal","udsRequest","udsResponse","udsReserved","udsFunctionalRequest","networkManagement","bootloader","xcp","dtc","diagnostic","vendorExempt";
BA_DEF_ BO_ "NWMBotschaft" ENUM "nein","ja";
BA_DEF_ BO_ "NmMessage" ENUM "No","Yes";
BA_DEF_ BO_ "SubSystemId" INT 0 256;
BA_DEF_ BO_ "UsesChecksum" ENUM "No","Yes";
BA_DEF_ SG_ "FieldType" STRING ;
BA_DEF_ SG_ "FlexKomComment" STRING ;
BA_DEF_ SG_ "FlexKomIsMotorola" ENUM "nein","ja";
BA_DEF_ SG_ "FlexKomSID" INT 0 2147483647;
BA_DEF_ SG_ "FlexKomSigLaenge" INT 0 64;
BA_DEF_ SG_ "FlexKomSigName" STRING ;
BA_DEF_ SG_ "FlexKomSigStartPos" INT 0 63;
BA_DEF_ SG_ "FlexKomSigStartValue" STRING ;
BA_DEF_ SG_ "Gatewaysignal" INT 0 1;
BA_DEF_ SG_ "GenSigCycleTime" INT 0 0;
BA_DEF_ SG_ "GenSigCycleTimeActive" INT 0 0;
BA_DEF_ SG_ "GenSigPersistent" ENUM "No","Yes";
BA_DEF_ SG_ "GenSigSNA" STRING ;
BA_DEF_ SG_ "GenSigSendType" ENUM "Cyclic","OnWrite","OnWriteWithRepetition","OnChange","OnChangeWithRepetition","IfActive","IfActiveWithRepetition","NoSigSendType","NotUsed","NotUsed","NotUsed","NotUsed","NotUsed";
BA_DEF_ SG_ "GenSigStartValue" INT 0 0;
BA_DEF_ SG_ "GenSigTimeout_CGW" INT 0 65535;
BA_DEF_ SG_ "GenSigTimeout_DRVU" INT 0 65535;
BA_DEF_ SG_ "GenSigTimeout_ECM" INT 0 65535;
BA_DEF_ SG_ "GenSigTimeout_EIS" INT 0 65535;
BA_DEF_ SG_ "GenSigTimeout_EPS" INT 0 65535;
BA_DEF_ SG_ "GenSigTimeout_ESP_ABR" INT 0 65535;
BA_DEF_ SG_ "GenSigTimeout_IC" INT 0 65535;
BA_DEF_ SG_ "GenSigTimeout_MPC" INT 0 65535;
BA_DEF_ SG_ "GenSigTimeout_NV" INT 0 65535;
BA_DEF_ SG_ "GenSigTimeout_ORC" INT 0 65535;
BA_DEF_ SG_ "GenSigTimeout_PTS" INT 0 65535;
BA_DEF_ SG_ "GenSigTimeout_RBTM_FL" INT 0 65535;
BA_DEF_ SG_ "GenSigTimeout_RBTM_FR" INT 0 65535;
BA_DEF_ SG_ "GenSigTimeout_RDU" INT 0 65535;
BA_DEF_ SG_ "GenSigTimeout_SCCM" INT 0 65535;
BA_DEF_ SG_ "GenSigTimeout_SPC" INT 0 65535;
BA_DEF_ SG_ "GenSigTimeout_TPM" INT 0 65535;
BA_DEF_ SG_ "LogSignal" STRING ;
BA_DEF_ SG_ "PektronUpdateBitType" ENUM "Not used","Has update bit","Is update bit";
BA_DEF_REL_ BU_SG_REL_ "GenSigTimeoutTime" INT 0 0;

BA_DEF_DEF_ "AlertLogSubSystemId" 0;
BA_DEF_DEF_ "AlertType" 4;
BA_DEF_DEF_ "AppBotschaft" "nein";
BA_DEF_DEF_ "DiagRequest" "No";
BA_DEF_DEF_ "DiagResponse" "No";
BA_DEF_DEF_ "ETHGatewayMessageSendType" "UseGenMsgSendType";
BA_DEF_DEF_ "ETHId" "";
BA_DEF_DEF_ "FieldType" "";
BA_DEF_DEF_ "FlexKomComment" "";
BA_DEF_DEF_ "FlexKomIsMotorola" "";
BA_DEF_DEF_ "FlexKomSID" 0;
BA_DEF_DEF_ "FlexKomSigLaenge" 0;
BA_DEF_DEF_ "FlexKomSigName" "";
BA_DEF_DEF_ "FlexKomSigStartPos" 0;
BA_DEF_DEF_ "FlexKomSigStartValue" "";
BA_DEF_DEF_ "GatewayHandlerEnum" "noHandler";
BA_DEF_DEF_ "GatewayMessageAtomic" "No";
BA_DEF_DEF_ "GatewayMessageSendType" "UseGenMsgSendType";
BA_DEF_DEF_ "Gatewaysignal" 0;
BA_DEF_DEF_ "GenMsgCycleTime" 0;
BA_DEF_DEF_ "GenMsgCycleTimeFast" 0;
BA_DEF_DEF_ "GenMsgDelayTime" 0;
BA_DEF_DEF_ "GenMsgForceMiaCheck" "No";
BA_DEF_DEF_ "GenMsgGatewayNotification" "";
BA_DEF_DEF_ "GenMsgILSupport" "Yes";
BA_DEF_DEF_ "GenMsgSaltingFunction" "No";
BA_DEF_DEF_ "GenMsgSendType" "Cyclic";
BA_DEF_DEF_ "GenMsgStartValue" "";
BA_DEF_DEF_ "GenMsgTimeOut" 0;
BA_DEF_DEF_ "GenSigCycleTime" 0;
BA_DEF_DEF_ "GenSigCycleTimeActive" 0;
BA_DEF_DEF_ "GenSigPersistent" "No";
BA_DEF_DEF_ "GenSigSNA" "";
BA_DEF_DEF_ "GenSigSendType" "Cyclic";
BA_DEF_DEF_ "GenSigStartValue" 0;
BA_DEF_DEF_ "GenSigTimeout_CGW" 0;
BA_DEF_DEF_ "GenSigTimeout_DRVU" 0;
BA_DEF_DEF_ "GenSigTimeout_ECM" 0;
BA_DEF_DEF_ "GenSigTimeout_EIS" 0;
BA_DEF_DEF_ "GenSigTimeout_EPS" 0;
BA_DEF_DEF_ "GenSigTimeout_ESP_ABR" 0;
BA_DEF_DEF_ "GenSigTimeout_IC" 0;
BA_DEF_DEF_ "GenSigTimeout_MPC" 0;
BA_DEF_DEF_ "GenSigTimeout_NV" 0;
BA_DEF_DEF_ "GenSigTimeout_ORC" 0;
BA_DEF_DEF_ "GenSigTimeout_PTS" 0;
BA_DEF_DEF_ "GenSigTimeout_RBTM_FL" 0;
BA_DEF_DEF_ "GenSigTimeout_RBTM_FR" 0;
BA_DEF_DEF_ "GenSigTimeout_RDU" 0;
BA_DEF_DEF_ "GenSigTimeout_SCCM" 0;
BA_DEF_DEF_ "GenSigTimeout_SPC" 0;
BA_DEF_DEF_ "GenSigTimeout_TPM" 0;
BA_DEF_DEF_ "LogSignal" "";
BA_DEF_DEF_ "MessageIdType" "normal";
BA_DEF_DEF_ "NWMBotschaft" "nein";
BA_DEF_DEF_ "NmMessage" "No";
BA_DEF_DEF_ "PektronUpdateBitType" "Not used";
BA_DEF_DEF_ "SubSystemId" 0;
BA_DEF_DEF_ "UsesChecksum" "No";
BA_DEF_DEF_REL_ "GenSigTimeoutTime" 0;
VAL_ 1486 PARK_sw041_subCode 254 "MID_ADC_E_TOUT_N" 253 "MID_ADC_E_INIT_FAILURE_N" 252 "MID_CAN_E_TIMEOUT_N" 251 "MID_CANIF_E_FULL_TX_BUFFER_N" 250 "MID_CANIF_E_INVALID_DLC_N" 249 "MID_CANIF_E_INVALID_TXPDUID_N" 248 "MID_CANIF_E_STOPPED_N" 247 "MID_CANNM_E_CANIF_TRANSMIT_ERROR_N" 246 "MID_CANNM_E_INIT_FAILED_N" 245 "MID_CANNM_E_NETWORK_TIMEOUT_N" 244 "MID_CANSM_E_BUSOFF_NETWORK_N" 243 "MID_CANTP_E_COM_DIAMANT_N" 242 "MID_ECU_E_EEP_DATAFLASH_LAYOUT_N" 241 "MID_ECU_E_RAM_N" 240 "MID_ECU_E_ROM_N" 239 "MID_FEE_E_LAYOUT_FAILED_N" 238 "MID_NVM_E_CONFIG_FAILED_N" 237 "MID_CAN_DASInvalidData_N" 236 "MID_CAN_C_BUSOFF_N" 235 "MID_NVM_E_INTEGRITY_FAILED_N" 234 "MID_NVM_E_REQ_FAILED_N" 233 "MID_PA_E_ASIC_COM_FAILURE_N" 232 "MID_PA_E_ASIC_HW_FAILURE_N" 231 "MID_PA_E_ENGINE_START_INVALID_N" 230 "MID_PA_E_EPS_STATUS_INVALID_N" 229 "MID_PA_E_GEAR_INVALID_N" 228 "MID_PA_E_LONG_ACC_INVALID_N" 227 "MID_PA_E_OUTSIDE_TEMP_INVALID_N" 226 "MID_CAN_EPASInvalidData_N" 225 "MID_PA_E_SPEED_INVALID_N" 224 "MID_PA_E_SVA_BLOCKED_USS_FL_N" 223 "MID_PA_E_SVA_BLOCKED_USS_FR_N" 222 "MID_PA_E_SVA_BLOCKED_USS_RL_N" 221 "MID_PA_E_SVA_BLOCKED_USS_RR_N" 220 "MID_PA_E_SWA_INVALID_N" 219 "MID_PA_E_SWCPA_APT_MONITOR_FAILURE_N" 218 "MID_PA_E_SWCPA_INHIBIT_HSS_PWRLOCK_N" 217 "MID_PA_E_SWCPA_INIT_FAILURE_N" 216 "MID_PA_E_SWCPA_PARFAILURE_N" 215 "MID_CAN_EPBInvalidData_N" 214 "MID_PA_E_UBAT_HIGH_N" 213 "MID_PA_E_UBAT_LOW_N" 212 "MID_PA_E_USENS_OVERTEMPERATURE_N" 211 "MID_PA_E_USENS_OVERVOLTAGE_N" 210 "MID_PA_E_USENS_SHORT_2_GND_N" 209 "MID_PA_E_USENS_SHORT_2_UBAT_N" 208 "MID_PA_E_USENS_UNDERVOLTAGE_N" 207 "MID_PA_E_USS_01_NO_COM_N" 206 "MID_PA_E_USS_01_OPEN_N" 205 "MID_PA_E_USS_01_RING_TOO_SHORT_N" 204 "MID_PA_E_USS_01_RINGING_TOO_LONG_N" 203 "MID_PA_E_USS_01_SHORT_2_GND_N" 202 "MID_PA_E_USS_01_SHORT_2_USENS_N" 201 "MID_PA_E_USS_01_STATE_COM_VERIFIED_N" 200 "MID_PA_E_USS_01_STATE_OFFSET_N" 199 "MID_PA_E_USS_01_STATE_PROG_N" 198 "MID_PA_E_USS_01_STATE_TYPE_N" 197 "MID_PA_E_USS_02_NO_COM_N" 196 "MID_PA_E_USS_02_OPEN_N" 195 "MID_PA_E_USS_02_RING_TOO_SHORT_N" 194 "MID_PA_E_USS_02_RINGING_TOO_LONG_N" 193 "MID_PA_E_USS_02_SHORT_2_GND_N" 192 "MID_PA_E_USS_02_SHORT_2_USENS_N" 191 "MID_PA_E_USS_02_STATE_COM_VERIFIED_N" 190 "MID_PA_E_USS_02_STATE_OFFSET_N" 189 "MID_PA_E_USS_02_STATE_PROG_N" 188 "MID_PA_E_USS_02_STATE_TYPE_N" 187 "MID_PA_E_USS_03_NO_COM_N" 186 "MID_PA_E_USS_03_OPEN_N" 185 "MID_PA_E_USS_03_RING_TOO_SHORT_N" 184 "MID_PA_E_USS_03_RINGING_TOO_LONG_N" 183 "MID_PA_E_USS_03_SHORT_2_GND_N" 182 "MID_PA_E_USS_03_SHORT_2_USENS_N" 181 "MID_PA_E_USS_03_STATE_COM_VERIFIED_N" 180 "MID_PA_E_USS_03_STATE_OFFSET_N" 179 "MID_PA_E_USS_03_STATE_PROG_N" 178 "MID_PA_E_USS_03_STATE_TYPE_N" 177 "MID_PA_E_USS_04_NO_COM_N" 176 "MID_PA_E_USS_04_OPEN_N" 175 "MID_PA_E_USS_04_RING_TOO_SHORT_N" 174 "MID_PA_E_USS_04_RINGING_TOO_LONG_N" 173 "MID_PA_E_USS_04_SHORT_2_GND_N" 172 "MID_PA_E_USS_04_SHORT_2_USENS_N" 171 "MID_PA_E_USS_04_STATE_COM_VERIFIED_N" 170 "MID_PA_E_USS_04_STATE_OFFSET_N" 169 "MID_PA_E_USS_04_STATE_PROG_N" 168 "MID_PA_E_USS_04_STATE_TYPE_N" 167 "MID_PA_E_USS_05_NO_COM_N" 166 "MID_PA_E_USS_05_OPEN_N" 165 "MID_PA_E_USS_05_RING_TOO_SHORT_N" 164 "MID_PA_E_USS_05_RINGING_TOO_LONG_N" 163 "MID_PA_E_USS_05_SHORT_2_GND_N" 162 "MID_PA_E_USS_05_SHORT_2_USENS_N" 161 "MID_PA_E_USS_05_STATE_COM_VERIFIED_N" 160 "MID_PA_E_USS_05_STATE_OFFSET_N" 159 "MID_PA_E_USS_05_STATE_PROG_N" 158 "MID_PA_E_USS_05_STATE_TYPE_N" 157 "MID_PA_E_USS_06_NO_COM_N" 156 "MID_PA_E_USS_06_OPEN_N" 155 "MID_PA_E_USS_06_RING_TOO_SHORT_N" 154 "MID_PA_E_USS_06_RINGING_TOO_LONG_N" 153 "MID_PA_E_USS_06_SHORT_2_GND_N" 152 "MID_PA_E_USS_06_SHORT_2_USENS_N" 151 "MID_PA_E_USS_06_STATE_COM_VERIFIED_N" 150 "MID_PA_E_USS_06_STATE_OFFSET_N" 149 "MID_PA_E_USS_06_STATE_PROG_N" 148 "MID_PA_E_USS_06_STATE_TYPE_N" 147 "MID_CAN_ESPInvalidData_N" 146 "MID_CAN_GTWInvalidData_N" 145 "MID_CAN_SCCMInvalidData_N" 144 "MID_CAN_DASLossOfCommunication_N" 143 "MID_CAN_EPASLossOfCommunication_N" 142 "MID_CAN_EPBLossOfCommunication_N" 141 "MID_CAN_ESPLossOfCommunication_N" 140 "MID_CAN_GTWLossOfCommunication_N" 139 "MID_CAN_SCCMLossOfCommunication_N" 138 "MID_PA_E_USS_08_NO_COM_N" 137 "MID_PA_E_USS_08_OPEN_N" 136 "MID_PA_E_USS_08_RING_TOO_SHORT_N" 135 "MID_PA_E_USS_08_RINGING_TOO_LONG_N" 134 "MID_PA_E_USS_08_SHORT_2_GND_N" 133 "MID_PA_E_USS_08_SHORT_2_USENS_N" 132 "MID_PA_E_USS_08_STATE_COM_VERIFIED_N" 131 "MID_PA_E_USS_08_STATE_OFFSET_N" 130 "MID_PA_E_USS_08_STATE_PROG_N" 129 "MID_PA_E_USS_08_STATE_TYPE_N" 128 "MID_PA_E_USS_09_NO_COM_N" 127 "MID_PA_E_USS_09_OPEN_N" 126 "MID_PA_E_USS_09_RING_TOO_SHORT_N" 125 "MID_PA_E_USS_09_RINGING_TOO_LONG_N" 124 "MID_PA_E_USS_09_SHORT_2_GND_N" 123 "MID_PA_E_USS_09_SHORT_2_USENS_N" 122 "MID_PA_E_USS_09_STATE_COM_VERIFIED_N" 121 "MID_PA_E_USS_09_STATE_OFFSET_N" 120 "MID_PA_E_USS_09_STATE_PROG_N" 119 "MID_PA_E_USS_09_STATE_TYPE_N" 118 "MID_PA_E_USS_10_NO_COM_N" 117 "MID_PA_E_USS_10_OPEN_N" 116 "MID_PA_E_USS_10_RING_TOO_SHORT_N" 115 "MID_PA_E_USS_10_RINGING_TOO_LONG_N" 114 "MID_PA_E_USS_10_SHORT_2_GND_N" 113 "MID_PA_E_USS_10_SHORT_2_USENS_N" 112 "MID_PA_E_USS_10_STATE_COM_VERIFIED_N" 111 "MID_PA_E_USS_10_STATE_OFFSET_N" 110 "MID_PA_E_USS_10_STATE_PROG_N" 109 "MID_PA_E_USS_10_STATE_TYPE_N" 108 "MID_PA_E_USS_11_NO_COM_N" 107 "MID_PA_E_USS_11_OPEN_N" 106 "MID_PA_E_USS_11_RING_TOO_SHORT_N" 105 "MID_PA_E_USS_11_RINGING_TOO_LONG_N" 104 "MID_PA_E_USS_11_SHORT_2_GND_N" 103 "MID_PA_E_USS_11_SHORT_2_USENS_N" 102 "MID_PA_E_USS_11_STATE_COM_VERIFIED_N" 101 "MID_PA_E_USS_11_STATE_OFFSET_N" 100 "MID_PA_E_USS_11_STATE_PROG_N" 99 "MID_PA_E_USS_11_STATE_TYPE_N" 98 "MID_PA_E_USS_12_NO_COM_N" 97 "MID_PA_E_USS_12_OPEN_N" 96 "MID_PA_E_USS_12_RING_TOO_SHORT_N" 95 "MID_PA_E_USS_12_RINGING_TOO_LONG_N" 94 "MID_PA_E_USS_12_SHORT_2_GND_N" 93 "MID_PA_E_USS_12_SHORT_2_USENS_N" 92 "MID_PA_E_USS_12_STATE_COM_VERIFIED_N" 91 "MID_PA_E_USS_12_STATE_OFFSET_N" 90 "MID_PA_E_USS_12_STATE_PROG_N" 89 "MID_PA_E_USS_12_STATE_TYPE_N" 88 "MID_PA_E_USS_13_NO_COM_N" 87 "MID_PA_E_USS_13_OPEN_N" 86 "MID_PA_E_USS_13_RING_TOO_SHORT_N" 85 "MID_PA_E_USS_13_RINGING_TOO_LONG_N" 84 "MID_PA_E_USS_13_SHORT_2_GND_N" 83 "MID_PA_E_USS_13_SHORT_2_USENS_N" 82 "MID_PA_E_USS_13_STATE_COM_VERIFIED_N" 81 "MID_PA_E_USS_13_STATE_OFFSET_N" 80 "MID_PA_E_USS_13_STATE_PROG_N" 79 "MID_PA_E_USS_13_STATE_TYPE_N" 78 "MID_PA_E_SVA_BLOCKED_USS_ML_N" 77 "MID_PA_E_SVA_BLOCKED_USS_MR_N" 76 "MID_PA_E_WHEEL_DIR_FL_INVALID_N" 75 "MID_PA_E_WHEEL_DIR_FR_INVALID_N" 74 "MID_PA_E_WHEEL_DIR_RL_INVALID_N" 73 "MID_PA_E_WHEEL_DIR_RR_INVALID_N" 72 "MID_PA_E_WHEEL_ROTATION_FL_INVALID_N" 71 "MID_PA_E_WHEEL_ROTATION_FR_INVALID_N" 70 "MID_PA_E_WHEEL_ROTATION_RL_INVALID_N" 69 "MID_PA_E_WHEEL_ROTATION_RR_INVALID_N" 68 "MID_PA_E_WICFL_INVALID_N" 67 "MID_PA_E_WICFR_INVALID_N" 66 "MID_PA_E_WICRL_INVALID_N" 65 "MID_PA_E_WICRR_INVALID_N" 64 "MID_PA_E_YAW_RATE_INVALID_N" 63 "MID_PDUR_E_INIT_FAILED_N" 62 "MID_PDUR_E_PDU_INSTANCE_LOST_N" 61 "MID_COMM_E_NET_START_IND_CHANNEL_0_N" 60 "MID_SPI_E_DMA_TRANSFER_N" 59 "MID_SPI_E_RECEIVE_OVERFLOW_N" 58 "MID_SPI_E_TRANSFER_TIMEOUT_N" 57 "MID_PA_E_VEHDYNINTERVENTION_TIMEOUT_N" 56 "MID_TRAILER_HITCH_PRES_INVALID_N" 55 "MID_PA_E_CL15_STATE_INVALID_N" 54 "MID_PA_E_YAW_RATE_SIGN_INVALID_N" 53 "MID_PA_E_ESP_WIC_FRONT_TIMEOUT_N" 52 "MID_PA_E_SEQ_CALL_FAILURE_N" 51 "MID_PA_E_HMI_FUNCACTIVATION_TIMEOUT_N" 50 "MID_PA_E_LOWBEAM_INVALID_N" 49 "MID_PA_E_ENGINESTART_TIMEOUT_N" 48 "MID_ADC_E_VREF_N" 47 "MID_PA_E_ESP_YAW_TIMEOUT_N" 46 "MID_PA_E_TCM_PRG_TIMEOUT_N" 45 "MID_WDG_E_MODE_SWITCH_FAILED_N" 44 "MID_WDG_E_DISABLE_REJECTED_N" 43 "MID_PA_E_ESP_WHEELDIR_TIMEOUT_N" 42 "MID_PA_E_SWCPA_E_INIT_FAILURE_N" 41 "MID_PA_E_DIR_INDICATOR_INVALID_N" 40 "MID_PA_E_ESP_WIC_TIMEOUT_N" 39 "MID_PA_E_EPS_SWA_TIMEOUT_N" 38 "MID_PA_E_INSTRCLUSTER4_TIMEOUT_N" 37 "MID_PA_E_INSTRCLUSTER5_TIMEOUT_N" 36 "MID_PA_E_INSTRCLUSTER3_TIMEOUT_N" 35 "MID_PA_E_INSTRCLUSTER2_TIMEOUT_N" 34 "MID_PA_E_ASIC_WTD_RESET_N" 33 "MID_PA_E_INSTRCLUSTER1_TIMEOUT_N" 32 "MID_PA_E_ASIC_LOW_VOLT_RESET_N" 31 "MID_PA_E_POWERMODE_TIMEOUT_N" 30 "MID_PA_E_ESP_PS_TIMEOUT_N" 29 "MID_PA_E_ESP_WIC_REAR_TIMEOUT_N" 28 "MID_PA_E_TRAILER_ATTACH_INVALID_N" 27 "MID_PA_E_EXTERNAL_EPS_FAILURE_N" 26 "MID_PA_E_PSX_ACTIVATION_INVALID_N" 25 "MID_PA_E_ESP_WHEELVELO_TIMEOUT_N" 24 "MID_PA_E_ESP_LONGACC_TIMEOUT_N" 23 "MID_PA_E_VEH_DYN_INTERVENTION_INVALID_N" 22 "MID_ZPA_E_PS_MODE_INVALID_N" 21 "MID_ZPA_E_EPS_ERROR_INVALID_N" 20 "MID_ZPA_E1_ESP_PSState_INVALID_N" 19 "MID_ZPA_E2_BdaUss01BlindnessDetect_N" 18 "MID_ZPA_E2_BdaUss02BlindnessDetect_N" 17 "MID_ZPA_E2_BdaUss03BlindnessDetect_N" 16 "MID_ZPA_E2_BdaUss10BlindnessDetect_N" 15 "MID_ZPA_E2_BdaUss05BlindnessDetect_N" 14 "MID_ZPA_E2_BdaUss11BlindnessDetect_N" 13 "MID_ZPA_E2_BdaUss07BlindnessDetect_N" 12 "MID_ZPA_E2_BdaUss12BlindnessDetect_N" 11 "MID_ZPA_E2_BdaUss06BlindnessDetect_N" 10 "MID_ZPA_E2_BdaUss08BlindnessDetect_N" 9 "MID_ZPA_E2_BdaUss13BlindnessDetect_N" 8 "MID_ZPA_E2_BdaUss09BlindnessDetect_N" 7 "MID_ZPA_E2_BdaUss04BlindnessDetect_N" 6 "MID_ZPA_E2_BdaUss14BlindnessDetect_N" 5 "MID_FLS_E_READ_FAILED_N" 4 "MID_FLS_E_COMPARE_FAILED_N" 3 "MID_FLS_E_ERASE_FAILED_N" 2 "MID_FLS_E_WRITE_FAILED_N" 1 "MID_NO_FAULT_N" 0 "MID_INVALID" ;
VAL_ 1486 PARK_sw042_subCode 254 "MID_ADC_E_TOUT_N" 253 "MID_ADC_E_INIT_FAILURE_N" 252 "MID_CAN_E_TIMEOUT_N" 251 "MID_CANIF_E_FULL_TX_BUFFER_N" 250 "MID_CANIF_E_INVALID_DLC_N" 249 "MID_CANIF_E_INVALID_TXPDUID_N" 248 "MID_CANIF_E_STOPPED_N" 247 "MID_CANNM_E_CANIF_TRANSMIT_ERROR_N" 246 "MID_CANNM_E_INIT_FAILED_N" 245 "MID_CANNM_E_NETWORK_TIMEOUT_N" 244 "MID_CANSM_E_BUSOFF_NETWORK_N" 243 "MID_CANTP_E_COM_DIAMANT_N" 242 "MID_ECU_E_EEP_DATAFLASH_LAYOUT_N" 241 "MID_ECU_E_RAM_N" 240 "MID_ECU_E_ROM_N" 239 "MID_FEE_E_LAYOUT_FAILED_N" 238 "MID_NVM_E_CONFIG_FAILED_N" 237 "MID_CAN_DASInvalidData_N" 236 "MID_CAN_C_BUSOFF_N" 235 "MID_NVM_E_INTEGRITY_FAILED_N" 234 "MID_NVM_E_REQ_FAILED_N" 233 "MID_PA_E_ASIC_COM_FAILURE_N" 232 "MID_PA_E_ASIC_HW_FAILURE_N" 231 "MID_PA_E_ENGINE_START_INVALID_N" 230 "MID_PA_E_EPS_STATUS_INVALID_N" 229 "MID_PA_E_GEAR_INVALID_N" 228 "MID_PA_E_LONG_ACC_INVALID_N" 227 "MID_PA_E_OUTSIDE_TEMP_INVALID_N" 226 "MID_CAN_EPASInvalidData_N" 225 "MID_PA_E_SPEED_INVALID_N" 224 "MID_PA_E_SVA_BLOCKED_USS_FL_N" 223 "MID_PA_E_SVA_BLOCKED_USS_FR_N" 222 "MID_PA_E_SVA_BLOCKED_USS_RL_N" 221 "MID_PA_E_SVA_BLOCKED_USS_RR_N" 220 "MID_PA_E_SWA_INVALID_N" 219 "MID_PA_E_SWCPA_APT_MONITOR_FAILURE_N" 218 "MID_PA_E_SWCPA_INHIBIT_HSS_PWRLOCK_N" 217 "MID_PA_E_SWCPA_INIT_FAILURE_N" 216 "MID_PA_E_SWCPA_PARFAILURE_N" 215 "MID_CAN_EPBInvalidData_N" 214 "MID_PA_E_UBAT_HIGH_N" 213 "MID_PA_E_UBAT_LOW_N" 212 "MID_PA_E_USENS_OVERTEMPERATURE_N" 211 "MID_PA_E_USENS_OVERVOLTAGE_N" 210 "MID_PA_E_USENS_SHORT_2_GND_N" 209 "MID_PA_E_USENS_SHORT_2_UBAT_N" 208 "MID_PA_E_USENS_UNDERVOLTAGE_N" 207 "MID_PA_E_USS_01_NO_COM_N" 206 "MID_PA_E_USS_01_OPEN_N" 205 "MID_PA_E_USS_01_RING_TOO_SHORT_N" 204 "MID_PA_E_USS_01_RINGING_TOO_LONG_N" 203 "MID_PA_E_USS_01_SHORT_2_GND_N" 202 "MID_PA_E_USS_01_SHORT_2_USENS_N" 201 "MID_PA_E_USS_01_STATE_COM_VERIFIED_N" 200 "MID_PA_E_USS_01_STATE_OFFSET_N" 199 "MID_PA_E_USS_01_STATE_PROG_N" 198 "MID_PA_E_USS_01_STATE_TYPE_N" 197 "MID_PA_E_USS_02_NO_COM_N" 196 "MID_PA_E_USS_02_OPEN_N" 195 "MID_PA_E_USS_02_RING_TOO_SHORT_N" 194 "MID_PA_E_USS_02_RINGING_TOO_LONG_N" 193 "MID_PA_E_USS_02_SHORT_2_GND_N" 192 "MID_PA_E_USS_02_SHORT_2_USENS_N" 191 "MID_PA_E_USS_02_STATE_COM_VERIFIED_N" 190 "MID_PA_E_USS_02_STATE_OFFSET_N" 189 "MID_PA_E_USS_02_STATE_PROG_N" 188 "MID_PA_E_USS_02_STATE_TYPE_N" 187 "MID_PA_E_USS_03_NO_COM_N" 186 "MID_PA_E_USS_03_OPEN_N" 185 "MID_PA_E_USS_03_RING_TOO_SHORT_N" 184 "MID_PA_E_USS_03_RINGING_TOO_LONG_N" 183 "MID_PA_E_USS_03_SHORT_2_GND_N" 182 "MID_PA_E_USS_03_SHORT_2_USENS_N" 181 "MID_PA_E_USS_03_STATE_COM_VERIFIED_N" 180 "MID_PA_E_USS_03_STATE_OFFSET_N" 179 "MID_PA_E_USS_03_STATE_PROG_N" 178 "MID_PA_E_USS_03_STATE_TYPE_N" 177 "MID_PA_E_USS_04_NO_COM_N" 176 "MID_PA_E_USS_04_OPEN_N" 175 "MID_PA_E_USS_04_RING_TOO_SHORT_N" 174 "MID_PA_E_USS_04_RINGING_TOO_LONG_N" 173 "MID_PA_E_USS_04_SHORT_2_GND_N" 172 "MID_PA_E_USS_04_SHORT_2_USENS_N" 171 "MID_PA_E_USS_04_STATE_COM_VERIFIED_N" 170 "MID_PA_E_USS_04_STATE_OFFSET_N" 169 "MID_PA_E_USS_04_STATE_PROG_N" 168 "MID_PA_E_USS_04_STATE_TYPE_N" 167 "MID_PA_E_USS_05_NO_COM_N" 166 "MID_PA_E_USS_05_OPEN_N" 165 "MID_PA_E_USS_05_RING_TOO_SHORT_N" 164 "MID_PA_E_USS_05_RINGING_TOO_LONG_N" 163 "MID_PA_E_USS_05_SHORT_2_GND_N" 162 "MID_PA_E_USS_05_SHORT_2_USENS_N" 161 "MID_PA_E_USS_05_STATE_COM_VERIFIED_N" 160 "MID_PA_E_USS_05_STATE_OFFSET_N" 159 "MID_PA_E_USS_05_STATE_PROG_N" 158 "MID_PA_E_USS_05_STATE_TYPE_N" 157 "MID_PA_E_USS_06_NO_COM_N" 156 "MID_PA_E_USS_06_OPEN_N" 155 "MID_PA_E_USS_06_RING_TOO_SHORT_N" 154 "MID_PA_E_USS_06_RINGING_TOO_LONG_N" 153 "MID_PA_E_USS_06_SHORT_2_GND_N" 152 "MID_PA_E_USS_06_SHORT_2_USENS_N" 151 "MID_PA_E_USS_06_STATE_COM_VERIFIED_N" 150 "MID_PA_E_USS_06_STATE_OFFSET_N" 149 "MID_PA_E_USS_06_STATE_PROG_N" 148 "MID_PA_E_USS_06_STATE_TYPE_N" 147 "MID_CAN_ESPInvalidData_N" 146 "MID_CAN_GTWInvalidData_N" 145 "MID_CAN_SCCMInvalidData_N" 144 "MID_CAN_DASLossOfCommunication_N" 143 "MID_CAN_EPASLossOfCommunication_N" 142 "MID_CAN_EPBLossOfCommunication_N" 141 "MID_CAN_ESPLossOfCommunication_N" 140 "MID_CAN_GTWLossOfCommunication_N" 139 "MID_CAN_SCCMLossOfCommunication_N" 138 "MID_PA_E_USS_08_NO_COM_N" 137 "MID_PA_E_USS_08_OPEN_N" 136 "MID_PA_E_USS_08_RING_TOO_SHORT_N" 135 "MID_PA_E_USS_08_RINGING_TOO_LONG_N" 134 "MID_PA_E_USS_08_SHORT_2_GND_N" 133 "MID_PA_E_USS_08_SHORT_2_USENS_N" 132 "MID_PA_E_USS_08_STATE_COM_VERIFIED_N" 131 "MID_PA_E_USS_08_STATE_OFFSET_N" 130 "MID_PA_E_USS_08_STATE_PROG_N" 129 "MID_PA_E_USS_08_STATE_TYPE_N" 128 "MID_PA_E_USS_09_NO_COM_N" 127 "MID_PA_E_USS_09_OPEN_N" 126 "MID_PA_E_USS_09_RING_TOO_SHORT_N" 125 "MID_PA_E_USS_09_RINGING_TOO_LONG_N" 124 "MID_PA_E_USS_09_SHORT_2_GND_N" 123 "MID_PA_E_USS_09_SHORT_2_USENS_N" 122 "MID_PA_E_USS_09_STATE_COM_VERIFIED_N" 121 "MID_PA_E_USS_09_STATE_OFFSET_N" 120 "MID_PA_E_USS_09_STATE_PROG_N" 119 "MID_PA_E_USS_09_STATE_TYPE_N" 118 "MID_PA_E_USS_10_NO_COM_N" 117 "MID_PA_E_USS_10_OPEN_N" 116 "MID_PA_E_USS_10_RING_TOO_SHORT_N" 115 "MID_PA_E_USS_10_RINGING_TOO_LONG_N" 114 "MID_PA_E_USS_10_SHORT_2_GND_N" 113 "MID_PA_E_USS_10_SHORT_2_USENS_N" 112 "MID_PA_E_USS_10_STATE_COM_VERIFIED_N" 111 "MID_PA_E_USS_10_STATE_OFFSET_N" 110 "MID_PA_E_USS_10_STATE_PROG_N" 109 "MID_PA_E_USS_10_STATE_TYPE_N" 108 "MID_PA_E_USS_11_NO_COM_N" 107 "MID_PA_E_USS_11_OPEN_N" 106 "MID_PA_E_USS_11_RING_TOO_SHORT_N" 105 "MID_PA_E_USS_11_RINGING_TOO_LONG_N" 104 "MID_PA_E_USS_11_SHORT_2_GND_N" 103 "MID_PA_E_USS_11_SHORT_2_USENS_N" 102 "MID_PA_E_USS_11_STATE_COM_VERIFIED_N" 101 "MID_PA_E_USS_11_STATE_OFFSET_N" 100 "MID_PA_E_USS_11_STATE_PROG_N" 99 "MID_PA_E_USS_11_STATE_TYPE_N" 98 "MID_PA_E_USS_12_NO_COM_N" 97 "MID_PA_E_USS_12_OPEN_N" 96 "MID_PA_E_USS_12_RING_TOO_SHORT_N" 95 "MID_PA_E_USS_12_RINGING_TOO_LONG_N" 94 "MID_PA_E_USS_12_SHORT_2_GND_N" 93 "MID_PA_E_USS_12_SHORT_2_USENS_N" 92 "MID_PA_E_USS_12_STATE_COM_VERIFIED_N" 91 "MID_PA_E_USS_12_STATE_OFFSET_N" 90 "MID_PA_E_USS_12_STATE_PROG_N" 89 "MID_PA_E_USS_12_STATE_TYPE_N" 88 "MID_PA_E_USS_13_NO_COM_N" 87 "MID_PA_E_USS_13_OPEN_N" 86 "MID_PA_E_USS_13_RING_TOO_SHORT_N" 85 "MID_PA_E_USS_13_RINGING_TOO_LONG_N" 84 "MID_PA_E_USS_13_SHORT_2_GND_N" 83 "MID_PA_E_USS_13_SHORT_2_USENS_N" 82 "MID_PA_E_USS_13_STATE_COM_VERIFIED_N" 81 "MID_PA_E_USS_13_STATE_OFFSET_N" 80 "MID_PA_E_USS_13_STATE_PROG_N" 79 "MID_PA_E_USS_13_STATE_TYPE_N" 78 "MID_PA_E_SVA_BLOCKED_USS_ML_N" 77 "MID_PA_E_SVA_BLOCKED_USS_MR_N" 76 "MID_PA_E_WHEEL_DIR_FL_INVALID_N" 75 "MID_PA_E_WHEEL_DIR_FR_INVALID_N" 74 "MID_PA_E_WHEEL_DIR_RL_INVALID_N" 73 "MID_PA_E_WHEEL_DIR_RR_INVALID_N" 72 "MID_PA_E_WHEEL_ROTATION_FL_INVALID_N" 71 "MID_PA_E_WHEEL_ROTATION_FR_INVALID_N" 70 "MID_PA_E_WHEEL_ROTATION_RL_INVALID_N" 69 "MID_PA_E_WHEEL_ROTATION_RR_INVALID_N" 68 "MID_PA_E_WICFL_INVALID_N" 67 "MID_PA_E_WICFR_INVALID_N" 66 "MID_PA_E_WICRL_INVALID_N" 65 "MID_PA_E_WICRR_INVALID_N" 64 "MID_PA_E_YAW_RATE_INVALID_N" 63 "MID_PDUR_E_INIT_FAILED_N" 62 "MID_PDUR_E_PDU_INSTANCE_LOST_N" 61 "MID_COMM_E_NET_START_IND_CHANNEL_0_N" 60 "MID_SPI_E_DMA_TRANSFER_N" 59 "MID_SPI_E_RECEIVE_OVERFLOW_N" 58 "MID_SPI_E_TRANSFER_TIMEOUT_N" 57 "MID_PA_E_VEHDYNINTERVENTION_TIMEOUT_N" 56 "MID_TRAILER_HITCH_PRES_INVALID_N" 55 "MID_PA_E_CL15_STATE_INVALID_N" 54 "MID_PA_E_YAW_RATE_SIGN_INVALID_N" 53 "MID_PA_E_ESP_WIC_FRONT_TIMEOUT_N" 52 "MID_PA_E_SEQ_CALL_FAILURE_N" 51 "MID_PA_E_HMI_FUNCACTIVATION_TIMEOUT_N" 50 "MID_PA_E_LOWBEAM_INVALID_N" 49 "MID_PA_E_ENGINESTART_TIMEOUT_N" 48 "MID_ADC_E_VREF_N" 47 "MID_PA_E_ESP_YAW_TIMEOUT_N" 46 "MID_PA_E_TCM_PRG_TIMEOUT_N" 45 "MID_WDG_E_MODE_SWITCH_FAILED_N" 44 "MID_WDG_E_DISABLE_REJECTED_N" 43 "MID_PA_E_ESP_WHEELDIR_TIMEOUT_N" 42 "MID_PA_E_SWCPA_E_INIT_FAILURE_N" 41 "MID_PA_E_DIR_INDICATOR_INVALID_N" 40 "MID_PA_E_ESP_WIC_TIMEOUT_N" 39 "MID_PA_E_EPS_SWA_TIMEOUT_N" 38 "MID_PA_E_INSTRCLUSTER4_TIMEOUT_N" 37 "MID_PA_E_INSTRCLUSTER5_TIMEOUT_N" 36 "MID_PA_E_INSTRCLUSTER3_TIMEOUT_N" 35 "MID_PA_E_INSTRCLUSTER2_TIMEOUT_N" 34 "MID_PA_E_ASIC_WTD_RESET_N" 33 "MID_PA_E_INSTRCLUSTER1_TIMEOUT_N" 32 "MID_PA_E_ASIC_LOW_VOLT_RESET_N" 31 "MID_PA_E_POWERMODE_TIMEOUT_N" 30 "MID_PA_E_ESP_PS_TIMEOUT_N" 29 "MID_PA_E_ESP_WIC_REAR_TIMEOUT_N" 28 "MID_PA_E_TRAILER_ATTACH_INVALID_N" 27 "MID_PA_E_EXTERNAL_EPS_FAILURE_N" 26 "MID_PA_E_PSX_ACTIVATION_INVALID_N" 25 "MID_PA_E_ESP_WHEELVELO_TIMEOUT_N" 24 "MID_PA_E_ESP_LONGACC_TIMEOUT_N" 23 "MID_PA_E_VEH_DYN_INTERVENTION_INVALID_N" 22 "MID_ZPA_E_PS_MODE_INVALID_N" 21 "MID_ZPA_E_EPS_ERROR_INVALID_N" 20 "MID_ZPA_E1_ESP_PSState_INVALID_N" 19 "MID_ZPA_E2_BdaUss01BlindnessDetect_N" 18 "MID_ZPA_E2_BdaUss02BlindnessDetect_N" 17 "MID_ZPA_E2_BdaUss03BlindnessDetect_N" 16 "MID_ZPA_E2_BdaUss10BlindnessDetect_N" 15 "MID_ZPA_E2_BdaUss05BlindnessDetect_N" 14 "MID_ZPA_E2_BdaUss11BlindnessDetect_N" 13 "MID_ZPA_E2_BdaUss07BlindnessDetect_N" 12 "MID_ZPA_E2_BdaUss12BlindnessDetect_N" 11 "MID_ZPA_E2_BdaUss06BlindnessDetect_N" 10 "MID_ZPA_E2_BdaUss08BlindnessDetect_N" 9 "MID_ZPA_E2_BdaUss13BlindnessDetect_N" 8 "MID_ZPA_E2_BdaUss09BlindnessDetect_N" 7 "MID_ZPA_E2_BdaUss04BlindnessDetect_N" 6 "MID_ZPA_E2_BdaUss14BlindnessDetect_N" 5 "MID_FLS_E_READ_FAILED_N" 4 "MID_FLS_E_COMPARE_FAILED_N" 3 "MID_FLS_E_ERASE_FAILED_N" 2 "MID_FLS_E_WRITE_FAILED_N" 1 "MID_NO_FAULT_N" 0 "MID_INVALID" ;
VAL_ 1486 PARK_sw043_subCode 254 "MID_ADC_E_TOUT_N" 253 "MID_ADC_E_INIT_FAILURE_N" 252 "MID_CAN_E_TIMEOUT_N" 251 "MID_CANIF_E_FULL_TX_BUFFER_N" 250 "MID_CANIF_E_INVALID_DLC_N" 249 "MID_CANIF_E_INVALID_TXPDUID_N" 248 "MID_CANIF_E_STOPPED_N" 247 "MID_CANNM_E_CANIF_TRANSMIT_ERROR_N" 246 "MID_CANNM_E_INIT_FAILED_N" 245 "MID_CANNM_E_NETWORK_TIMEOUT_N" 244 "MID_CANSM_E_BUSOFF_NETWORK_N" 243 "MID_CANTP_E_COM_DIAMANT_N" 242 "MID_ECU_E_EEP_DATAFLASH_LAYOUT_N" 241 "MID_ECU_E_RAM_N" 240 "MID_ECU_E_ROM_N" 239 "MID_FEE_E_LAYOUT_FAILED_N" 238 "MID_NVM_E_CONFIG_FAILED_N" 237 "MID_CAN_DASInvalidData_N" 236 "MID_CAN_C_BUSOFF_N" 235 "MID_NVM_E_INTEGRITY_FAILED_N" 234 "MID_NVM_E_REQ_FAILED_N" 233 "MID_PA_E_ASIC_COM_FAILURE_N" 232 "MID_PA_E_ASIC_HW_FAILURE_N" 231 "MID_PA_E_ENGINE_START_INVALID_N" 230 "MID_PA_E_EPS_STATUS_INVALID_N" 229 "MID_PA_E_GEAR_INVALID_N" 228 "MID_PA_E_LONG_ACC_INVALID_N" 227 "MID_PA_E_OUTSIDE_TEMP_INVALID_N" 226 "MID_CAN_EPASInvalidData_N" 225 "MID_PA_E_SPEED_INVALID_N" 224 "MID_PA_E_SVA_BLOCKED_USS_FL_N" 223 "MID_PA_E_SVA_BLOCKED_USS_FR_N" 222 "MID_PA_E_SVA_BLOCKED_USS_RL_N" 221 "MID_PA_E_SVA_BLOCKED_USS_RR_N" 220 "MID_PA_E_SWA_INVALID_N" 219 "MID_PA_E_SWCPA_APT_MONITOR_FAILURE_N" 218 "MID_PA_E_SWCPA_INHIBIT_HSS_PWRLOCK_N" 217 "MID_PA_E_SWCPA_INIT_FAILURE_N" 216 "MID_PA_E_SWCPA_PARFAILURE_N" 215 "MID_CAN_EPBInvalidData_N" 214 "MID_PA_E_UBAT_HIGH_N" 213 "MID_PA_E_UBAT_LOW_N" 212 "MID_PA_E_USENS_OVERTEMPERATURE_N" 211 "MID_PA_E_USENS_OVERVOLTAGE_N" 210 "MID_PA_E_USENS_SHORT_2_GND_N" 209 "MID_PA_E_USENS_SHORT_2_UBAT_N" 208 "MID_PA_E_USENS_UNDERVOLTAGE_N" 207 "MID_PA_E_USS_01_NO_COM_N" 206 "MID_PA_E_USS_01_OPEN_N" 205 "MID_PA_E_USS_01_RING_TOO_SHORT_N" 204 "MID_PA_E_USS_01_RINGING_TOO_LONG_N" 203 "MID_PA_E_USS_01_SHORT_2_GND_N" 202 "MID_PA_E_USS_01_SHORT_2_USENS_N" 201 "MID_PA_E_USS_01_STATE_COM_VERIFIED_N" 200 "MID_PA_E_USS_01_STATE_OFFSET_N" 199 "MID_PA_E_USS_01_STATE_PROG_N" 198 "MID_PA_E_USS_01_STATE_TYPE_N" 197 "MID_PA_E_USS_02_NO_COM_N" 196 "MID_PA_E_USS_02_OPEN_N" 195 "MID_PA_E_USS_02_RING_TOO_SHORT_N" 194 "MID_PA_E_USS_02_RINGING_TOO_LONG_N" 193 "MID_PA_E_USS_02_SHORT_2_GND_N" 192 "MID_PA_E_USS_02_SHORT_2_USENS_N" 191 "MID_PA_E_USS_02_STATE_COM_VERIFIED_N" 190 "MID_PA_E_USS_02_STATE_OFFSET_N" 189 "MID_PA_E_USS_02_STATE_PROG_N" 188 "MID_PA_E_USS_02_STATE_TYPE_N" 187 "MID_PA_E_USS_03_NO_COM_N" 186 "MID_PA_E_USS_03_OPEN_N" 185 "MID_PA_E_USS_03_RING_TOO_SHORT_N" 184 "MID_PA_E_USS_03_RINGING_TOO_LONG_N" 183 "MID_PA_E_USS_03_SHORT_2_GND_N" 182 "MID_PA_E_USS_03_SHORT_2_USENS_N" 181 "MID_PA_E_USS_03_STATE_COM_VERIFIED_N" 180 "MID_PA_E_USS_03_STATE_OFFSET_N" 179 "MID_PA_E_USS_03_STATE_PROG_N" 178 "MID_PA_E_USS_03_STATE_TYPE_N" 177 "MID_PA_E_USS_04_NO_COM_N" 176 "MID_PA_E_USS_04_OPEN_N" 175 "MID_PA_E_USS_04_RING_TOO_SHORT_N" 174 "MID_PA_E_USS_04_RINGING_TOO_LONG_N" 173 "MID_PA_E_USS_04_SHORT_2_GND_N" 172 "MID_PA_E_USS_04_SHORT_2_USENS_N" 171 "MID_PA_E_USS_04_STATE_COM_VERIFIED_N" 170 "MID_PA_E_USS_04_STATE_OFFSET_N" 169 "MID_PA_E_USS_04_STATE_PROG_N" 168 "MID_PA_E_USS_04_STATE_TYPE_N" 167 "MID_PA_E_USS_05_NO_COM_N" 166 "MID_PA_E_USS_05_OPEN_N" 165 "MID_PA_E_USS_05_RING_TOO_SHORT_N" 164 "MID_PA_E_USS_05_RINGING_TOO_LONG_N" 163 "MID_PA_E_USS_05_SHORT_2_GND_N" 162 "MID_PA_E_USS_05_SHORT_2_USENS_N" 161 "MID_PA_E_USS_05_STATE_COM_VERIFIED_N" 160 "MID_PA_E_USS_05_STATE_OFFSET_N" 159 "MID_PA_E_USS_05_STATE_PROG_N" 158 "MID_PA_E_USS_05_STATE_TYPE_N" 157 "MID_PA_E_USS_06_NO_COM_N" 156 "MID_PA_E_USS_06_OPEN_N" 155 "MID_PA_E_USS_06_RING_TOO_SHORT_N" 154 "MID_PA_E_USS_06_RINGING_TOO_LONG_N" 153 "MID_PA_E_USS_06_SHORT_2_GND_N" 152 "MID_PA_E_USS_06_SHORT_2_USENS_N" 151 "MID_PA_E_USS_06_STATE_COM_VERIFIED_N" 150 "MID_PA_E_USS_06_STATE_OFFSET_N" 149 "MID_PA_E_USS_06_STATE_PROG_N" 148 "MID_PA_E_USS_06_STATE_TYPE_N" 147 "MID_CAN_ESPInvalidData_N" 146 "MID_CAN_GTWInvalidData_N" 145 "MID_CAN_SCCMInvalidData_N" 144 "MID_CAN_DASLossOfCommunication_N" 143 "MID_CAN_EPASLossOfCommunication_N" 142 "MID_CAN_EPBLossOfCommunication_N" 141 "MID_CAN_ESPLossOfCommunication_N" 140 "MID_CAN_GTWLossOfCommunication_N" 139 "MID_CAN_SCCMLossOfCommunication_N" 138 "MID_PA_E_USS_08_NO_COM_N" 137 "MID_PA_E_USS_08_OPEN_N" 136 "MID_PA_E_USS_08_RING_TOO_SHORT_N" 135 "MID_PA_E_USS_08_RINGING_TOO_LONG_N" 134 "MID_PA_E_USS_08_SHORT_2_GND_N" 133 "MID_PA_E_USS_08_SHORT_2_USENS_N" 132 "MID_PA_E_USS_08_STATE_COM_VERIFIED_N" 131 "MID_PA_E_USS_08_STATE_OFFSET_N" 130 "MID_PA_E_USS_08_STATE_PROG_N" 129 "MID_PA_E_USS_08_STATE_TYPE_N" 128 "MID_PA_E_USS_09_NO_COM_N" 127 "MID_PA_E_USS_09_OPEN_N" 126 "MID_PA_E_USS_09_RING_TOO_SHORT_N" 125 "MID_PA_E_USS_09_RINGING_TOO_LONG_N" 124 "MID_PA_E_USS_09_SHORT_2_GND_N" 123 "MID_PA_E_USS_09_SHORT_2_USENS_N" 122 "MID_PA_E_USS_09_STATE_COM_VERIFIED_N" 121 "MID_PA_E_USS_09_STATE_OFFSET_N" 120 "MID_PA_E_USS_09_STATE_PROG_N" 119 "MID_PA_E_USS_09_STATE_TYPE_N" 118 "MID_PA_E_USS_10_NO_COM_N" 117 "MID_PA_E_USS_10_OPEN_N" 116 "MID_PA_E_USS_10_RING_TOO_SHORT_N" 115 "MID_PA_E_USS_10_RINGING_TOO_LONG_N" 114 "MID_PA_E_USS_10_SHORT_2_GND_N" 113 "MID_PA_E_USS_10_SHORT_2_USENS_N" 112 "MID_PA_E_USS_10_STATE_COM_VERIFIED_N" 111 "MID_PA_E_USS_10_STATE_OFFSET_N" 110 "MID_PA_E_USS_10_STATE_PROG_N" 109 "MID_PA_E_USS_10_STATE_TYPE_N" 108 "MID_PA_E_USS_11_NO_COM_N" 107 "MID_PA_E_USS_11_OPEN_N" 106 "MID_PA_E_USS_11_RING_TOO_SHORT_N" 105 "MID_PA_E_USS_11_RINGING_TOO_LONG_N" 104 "MID_PA_E_USS_11_SHORT_2_GND_N" 103 "MID_PA_E_USS_11_SHORT_2_USENS_N" 102 "MID_PA_E_USS_11_STATE_COM_VERIFIED_N" 101 "MID_PA_E_USS_11_STATE_OFFSET_N" 100 "MID_PA_E_USS_11_STATE_PROG_N" 99 "MID_PA_E_USS_11_STATE_TYPE_N" 98 "MID_PA_E_USS_12_NO_COM_N" 97 "MID_PA_E_USS_12_OPEN_N" 96 "MID_PA_E_USS_12_RING_TOO_SHORT_N" 95 "MID_PA_E_USS_12_RINGING_TOO_LONG_N" 94 "MID_PA_E_USS_12_SHORT_2_GND_N" 93 "MID_PA_E_USS_12_SHORT_2_USENS_N" 92 "MID_PA_E_USS_12_STATE_COM_VERIFIED_N" 91 "MID_PA_E_USS_12_STATE_OFFSET_N" 90 "MID_PA_E_USS_12_STATE_PROG_N" 89 "MID_PA_E_USS_12_STATE_TYPE_N" 88 "MID_PA_E_USS_13_NO_COM_N" 87 "MID_PA_E_USS_13_OPEN_N" 86 "MID_PA_E_USS_13_RING_TOO_SHORT_N" 85 "MID_PA_E_USS_13_RINGING_TOO_LONG_N" 84 "MID_PA_E_USS_13_SHORT_2_GND_N" 83 "MID_PA_E_USS_13_SHORT_2_USENS_N" 82 "MID_PA_E_USS_13_STATE_COM_VERIFIED_N" 81 "MID_PA_E_USS_13_STATE_OFFSET_N" 80 "MID_PA_E_USS_13_STATE_PROG_N" 79 "MID_PA_E_USS_13_STATE_TYPE_N" 78 "MID_PA_E_SVA_BLOCKED_USS_ML_N" 77 "MID_PA_E_SVA_BLOCKED_USS_MR_N" 76 "MID_PA_E_WHEEL_DIR_FL_INVALID_N" 75 "MID_PA_E_WHEEL_DIR_FR_INVALID_N" 74 "MID_PA_E_WHEEL_DIR_RL_INVALID_N" 73 "MID_PA_E_WHEEL_DIR_RR_INVALID_N" 72 "MID_PA_E_WHEEL_ROTATION_FL_INVALID_N" 71 "MID_PA_E_WHEEL_ROTATION_FR_INVALID_N" 70 "MID_PA_E_WHEEL_ROTATION_RL_INVALID_N" 69 "MID_PA_E_WHEEL_ROTATION_RR_INVALID_N" 68 "MID_PA_E_WICFL_INVALID_N" 67 "MID_PA_E_WICFR_INVALID_N" 66 "MID_PA_E_WICRL_INVALID_N" 65 "MID_PA_E_WICRR_INVALID_N" 64 "MID_PA_E_YAW_RATE_INVALID_N" 63 "MID_PDUR_E_INIT_FAILED_N" 62 "MID_PDUR_E_PDU_INSTANCE_LOST_N" 61 "MID_COMM_E_NET_START_IND_CHANNEL_0_N" 60 "MID_SPI_E_DMA_TRANSFER_N" 59 "MID_SPI_E_RECEIVE_OVERFLOW_N" 58 "MID_SPI_E_TRANSFER_TIMEOUT_N" 57 "MID_PA_E_VEHDYNINTERVENTION_TIMEOUT_N" 56 "MID_TRAILER_HITCH_PRES_INVALID_N" 55 "MID_PA_E_CL15_STATE_INVALID_N" 54 "MID_PA_E_YAW_RATE_SIGN_INVALID_N" 53 "MID_PA_E_ESP_WIC_FRONT_TIMEOUT_N" 52 "MID_PA_E_SEQ_CALL_FAILURE_N" 51 "MID_PA_E_HMI_FUNCACTIVATION_TIMEOUT_N" 50 "MID_PA_E_LOWBEAM_INVALID_N" 49 "MID_PA_E_ENGINESTART_TIMEOUT_N" 48 "MID_ADC_E_VREF_N" 47 "MID_PA_E_ESP_YAW_TIMEOUT_N" 46 "MID_PA_E_TCM_PRG_TIMEOUT_N" 45 "MID_WDG_E_MODE_SWITCH_FAILED_N" 44 "MID_WDG_E_DISABLE_REJECTED_N" 43 "MID_PA_E_ESP_WHEELDIR_TIMEOUT_N" 42 "MID_PA_E_SWCPA_E_INIT_FAILURE_N" 41 "MID_PA_E_DIR_INDICATOR_INVALID_N" 40 "MID_PA_E_ESP_WIC_TIMEOUT_N" 39 "MID_PA_E_EPS_SWA_TIMEOUT_N" 38 "MID_PA_E_INSTRCLUSTER4_TIMEOUT_N" 37 "MID_PA_E_INSTRCLUSTER5_TIMEOUT_N" 36 "MID_PA_E_INSTRCLUSTER3_TIMEOUT_N" 35 "MID_PA_E_INSTRCLUSTER2_TIMEOUT_N" 34 "MID_PA_E_ASIC_WTD_RESET_N" 33 "MID_PA_E_INSTRCLUSTER1_TIMEOUT_N" 32 "MID_PA_E_ASIC_LOW_VOLT_RESET_N" 31 "MID_PA_E_POWERMODE_TIMEOUT_N" 30 "MID_PA_E_ESP_PS_TIMEOUT_N" 29 "MID_PA_E_ESP_WIC_REAR_TIMEOUT_N" 28 "MID_PA_E_TRAILER_ATTACH_INVALID_N" 27 "MID_PA_E_EXTERNAL_EPS_FAILURE_N" 26 "MID_PA_E_PSX_ACTIVATION_INVALID_N" 25 "MID_PA_E_ESP_WHEELVELO_TIMEOUT_N" 24 "MID_PA_E_ESP_LONGACC_TIMEOUT_N" 23 "MID_PA_E_VEH_DYN_INTERVENTION_INVALID_N" 22 "MID_ZPA_E_PS_MODE_INVALID_N" 21 "MID_ZPA_E_EPS_ERROR_INVALID_N" 20 "MID_ZPA_E1_ESP_PSState_INVALID_N" 19 "MID_ZPA_E2_BdaUss01BlindnessDetect_N" 18 "MID_ZPA_E2_BdaUss02BlindnessDetect_N" 17 "MID_ZPA_E2_BdaUss03BlindnessDetect_N" 16 "MID_ZPA_E2_BdaUss10BlindnessDetect_N" 15 "MID_ZPA_E2_BdaUss05BlindnessDetect_N" 14 "MID_ZPA_E2_BdaUss11BlindnessDetect_N" 13 "MID_ZPA_E2_BdaUss07BlindnessDetect_N" 12 "MID_ZPA_E2_BdaUss12BlindnessDetect_N" 11 "MID_ZPA_E2_BdaUss06BlindnessDetect_N" 10 "MID_ZPA_E2_BdaUss08BlindnessDetect_N" 9 "MID_ZPA_E2_BdaUss13BlindnessDetect_N" 8 "MID_ZPA_E2_BdaUss09BlindnessDetect_N" 7 "MID_ZPA_E2_BdaUss04BlindnessDetect_N" 6 "MID_ZPA_E2_BdaUss14BlindnessDetect_N" 5 "MID_FLS_E_READ_FAILED_N" 4 "MID_FLS_E_COMPARE_FAILED_N" 3 "MID_FLS_E_ERASE_FAILED_N" 2 "MID_FLS_E_WRITE_FAILED_N" 1 "MID_NO_FAULT_N" 0 "MID_INVALID" ;
VAL_ 1486 PARK_sw044_subCode 254 "MID_ADC_E_TOUT_N" 253 "MID_ADC_E_INIT_FAILURE_N" 252 "MID_CAN_E_TIMEOUT_N" 251 "MID_CANIF_E_FULL_TX_BUFFER_N" 250 "MID_CANIF_E_INVALID_DLC_N" 249 "MID_CANIF_E_INVALID_TXPDUID_N" 248 "MID_CANIF_E_STOPPED_N" 247 "MID_CANNM_E_CANIF_TRANSMIT_ERROR_N" 246 "MID_CANNM_E_INIT_FAILED_N" 245 "MID_CANNM_E_NETWORK_TIMEOUT_N" 244 "MID_CANSM_E_BUSOFF_NETWORK_N" 243 "MID_CANTP_E_COM_DIAMANT_N" 242 "MID_ECU_E_EEP_DATAFLASH_LAYOUT_N" 241 "MID_ECU_E_RAM_N" 240 "MID_ECU_E_ROM_N" 239 "MID_FEE_E_LAYOUT_FAILED_N" 238 "MID_NVM_E_CONFIG_FAILED_N" 237 "MID_CAN_DASInvalidData_N" 236 "MID_CAN_C_BUSOFF_N" 235 "MID_NVM_E_INTEGRITY_FAILED_N" 234 "MID_NVM_E_REQ_FAILED_N" 233 "MID_PA_E_ASIC_COM_FAILURE_N" 232 "MID_PA_E_ASIC_HW_FAILURE_N" 231 "MID_PA_E_ENGINE_START_INVALID_N" 230 "MID_PA_E_EPS_STATUS_INVALID_N" 229 "MID_PA_E_GEAR_INVALID_N" 228 "MID_PA_E_LONG_ACC_INVALID_N" 227 "MID_PA_E_OUTSIDE_TEMP_INVALID_N" 226 "MID_CAN_EPASInvalidData_N" 225 "MID_PA_E_SPEED_INVALID_N" 224 "MID_PA_E_SVA_BLOCKED_USS_FL_N" 223 "MID_PA_E_SVA_BLOCKED_USS_FR_N" 222 "MID_PA_E_SVA_BLOCKED_USS_RL_N" 221 "MID_PA_E_SVA_BLOCKED_USS_RR_N" 220 "MID_PA_E_SWA_INVALID_N" 219 "MID_PA_E_SWCPA_APT_MONITOR_FAILURE_N" 218 "MID_PA_E_SWCPA_INHIBIT_HSS_PWRLOCK_N" 217 "MID_PA_E_SWCPA_INIT_FAILURE_N" 216 "MID_PA_E_SWCPA_PARFAILURE_N" 215 "MID_CAN_EPBInvalidData_N" 214 "MID_PA_E_UBAT_HIGH_N" 213 "MID_PA_E_UBAT_LOW_N" 212 "MID_PA_E_USENS_OVERTEMPERATURE_N" 211 "MID_PA_E_USENS_OVERVOLTAGE_N" 210 "MID_PA_E_USENS_SHORT_2_GND_N" 209 "MID_PA_E_USENS_SHORT_2_UBAT_N" 208 "MID_PA_E_USENS_UNDERVOLTAGE_N" 207 "MID_PA_E_USS_01_NO_COM_N" 206 "MID_PA_E_USS_01_OPEN_N" 205 "MID_PA_E_USS_01_RING_TOO_SHORT_N" 204 "MID_PA_E_USS_01_RINGING_TOO_LONG_N" 203 "MID_PA_E_USS_01_SHORT_2_GND_N" 202 "MID_PA_E_USS_01_SHORT_2_USENS_N" 201 "MID_PA_E_USS_01_STATE_COM_VERIFIED_N" 200 "MID_PA_E_USS_01_STATE_OFFSET_N" 199 "MID_PA_E_USS_01_STATE_PROG_N" 198 "MID_PA_E_USS_01_STATE_TYPE_N" 197 "MID_PA_E_USS_02_NO_COM_N" 196 "MID_PA_E_USS_02_OPEN_N" 195 "MID_PA_E_USS_02_RING_TOO_SHORT_N" 194 "MID_PA_E_USS_02_RINGING_TOO_LONG_N" 193 "MID_PA_E_USS_02_SHORT_2_GND_N" 192 "MID_PA_E_USS_02_SHORT_2_USENS_N" 191 "MID_PA_E_USS_02_STATE_COM_VERIFIED_N" 190 "MID_PA_E_USS_02_STATE_OFFSET_N" 189 "MID_PA_E_USS_02_STATE_PROG_N" 188 "MID_PA_E_USS_02_STATE_TYPE_N" 187 "MID_PA_E_USS_03_NO_COM_N" 186 "MID_PA_E_USS_03_OPEN_N" 185 "MID_PA_E_USS_03_RING_TOO_SHORT_N" 184 "MID_PA_E_USS_03_RINGING_TOO_LONG_N" 183 "MID_PA_E_USS_03_SHORT_2_GND_N" 182 "MID_PA_E_USS_03_SHORT_2_USENS_N" 181 "MID_PA_E_USS_03_STATE_COM_VERIFIED_N" 180 "MID_PA_E_USS_03_STATE_OFFSET_N" 179 "MID_PA_E_USS_03_STATE_PROG_N" 178 "MID_PA_E_USS_03_STATE_TYPE_N" 177 "MID_PA_E_USS_04_NO_COM_N" 176 "MID_PA_E_USS_04_OPEN_N" 175 "MID_PA_E_USS_04_RING_TOO_SHORT_N" 174 "MID_PA_E_USS_04_RINGING_TOO_LONG_N" 173 "MID_PA_E_USS_04_SHORT_2_GND_N" 172 "MID_PA_E_USS_04_SHORT_2_USENS_N" 171 "MID_PA_E_USS_04_STATE_COM_VERIFIED_N" 170 "MID_PA_E_USS_04_STATE_OFFSET_N" 169 "MID_PA_E_USS_04_STATE_PROG_N" 168 "MID_PA_E_USS_04_STATE_TYPE_N" 167 "MID_PA_E_USS_05_NO_COM_N" 166 "MID_PA_E_USS_05_OPEN_N" 165 "MID_PA_E_USS_05_RING_TOO_SHORT_N" 164 "MID_PA_E_USS_05_RINGING_TOO_LONG_N" 163 "MID_PA_E_USS_05_SHORT_2_GND_N" 162 "MID_PA_E_USS_05_SHORT_2_USENS_N" 161 "MID_PA_E_USS_05_STATE_COM_VERIFIED_N" 160 "MID_PA_E_USS_05_STATE_OFFSET_N" 159 "MID_PA_E_USS_05_STATE_PROG_N" 158 "MID_PA_E_USS_05_STATE_TYPE_N" 157 "MID_PA_E_USS_06_NO_COM_N" 156 "MID_PA_E_USS_06_OPEN_N" 155 "MID_PA_E_USS_06_RING_TOO_SHORT_N" 154 "MID_PA_E_USS_06_RINGING_TOO_LONG_N" 153 "MID_PA_E_USS_06_SHORT_2_GND_N" 152 "MID_PA_E_USS_06_SHORT_2_USENS_N" 151 "MID_PA_E_USS_06_STATE_COM_VERIFIED_N" 150 "MID_PA_E_USS_06_STATE_OFFSET_N" 149 "MID_PA_E_USS_06_STATE_PROG_N" 148 "MID_PA_E_USS_06_STATE_TYPE_N" 147 "MID_CAN_ESPInvalidData_N" 146 "MID_CAN_GTWInvalidData_N" 145 "MID_CAN_SCCMInvalidData_N" 144 "MID_CAN_DASLossOfCommunication_N" 143 "MID_CAN_EPASLossOfCommunication_N" 142 "MID_CAN_EPBLossOfCommunication_N" 141 "MID_CAN_ESPLossOfCommunication_N" 140 "MID_CAN_GTWLossOfCommunication_N" 139 "MID_CAN_SCCMLossOfCommunication_N" 138 "MID_PA_E_USS_08_NO_COM_N" 137 "MID_PA_E_USS_08_OPEN_N" 136 "MID_PA_E_USS_08_RING_TOO_SHORT_N" 135 "MID_PA_E_USS_08_RINGING_TOO_LONG_N" 134 "MID_PA_E_USS_08_SHORT_2_GND_N" 133 "MID_PA_E_USS_08_SHORT_2_USENS_N" 132 "MID_PA_E_USS_08_STATE_COM_VERIFIED_N" 131 "MID_PA_E_USS_08_STATE_OFFSET_N" 130 "MID_PA_E_USS_08_STATE_PROG_N" 129 "MID_PA_E_USS_08_STATE_TYPE_N" 128 "MID_PA_E_USS_09_NO_COM_N" 127 "MID_PA_E_USS_09_OPEN_N" 126 "MID_PA_E_USS_09_RING_TOO_SHORT_N" 125 "MID_PA_E_USS_09_RINGING_TOO_LONG_N" 124 "MID_PA_E_USS_09_SHORT_2_GND_N" 123 "MID_PA_E_USS_09_SHORT_2_USENS_N" 122 "MID_PA_E_USS_09_STATE_COM_VERIFIED_N" 121 "MID_PA_E_USS_09_STATE_OFFSET_N" 120 "MID_PA_E_USS_09_STATE_PROG_N" 119 "MID_PA_E_USS_09_STATE_TYPE_N" 118 "MID_PA_E_USS_10_NO_COM_N" 117 "MID_PA_E_USS_10_OPEN_N" 116 "MID_PA_E_USS_10_RING_TOO_SHORT_N" 115 "MID_PA_E_USS_10_RINGING_TOO_LONG_N" 114 "MID_PA_E_USS_10_SHORT_2_GND_N" 113 "MID_PA_E_USS_10_SHORT_2_USENS_N" 112 "MID_PA_E_USS_10_STATE_COM_VERIFIED_N" 111 "MID_PA_E_USS_10_STATE_OFFSET_N" 110 "MID_PA_E_USS_10_STATE_PROG_N" 109 "MID_PA_E_USS_10_STATE_TYPE_N" 108 "MID_PA_E_USS_11_NO_COM_N" 107 "MID_PA_E_USS_11_OPEN_N" 106 "MID_PA_E_USS_11_RING_TOO_SHORT_N" 105 "MID_PA_E_USS_11_RINGING_TOO_LONG_N" 104 "MID_PA_E_USS_11_SHORT_2_GND_N" 103 "MID_PA_E_USS_11_SHORT_2_USENS_N" 102 "MID_PA_E_USS_11_STATE_COM_VERIFIED_N" 101 "MID_PA_E_USS_11_STATE_OFFSET_N" 100 "MID_PA_E_USS_11_STATE_PROG_N" 99 "MID_PA_E_USS_11_STATE_TYPE_N" 98 "MID_PA_E_USS_12_NO_COM_N" 97 "MID_PA_E_USS_12_OPEN_N" 96 "MID_PA_E_USS_12_RING_TOO_SHORT_N" 95 "MID_PA_E_USS_12_RINGING_TOO_LONG_N" 94 "MID_PA_E_USS_12_SHORT_2_GND_N" 93 "MID_PA_E_USS_12_SHORT_2_USENS_N" 92 "MID_PA_E_USS_12_STATE_COM_VERIFIED_N" 91 "MID_PA_E_USS_12_STATE_OFFSET_N" 90 "MID_PA_E_USS_12_STATE_PROG_N" 89 "MID_PA_E_USS_12_STATE_TYPE_N" 88 "MID_PA_E_USS_13_NO_COM_N" 87 "MID_PA_E_USS_13_OPEN_N" 86 "MID_PA_E_USS_13_RING_TOO_SHORT_N" 85 "MID_PA_E_USS_13_RINGING_TOO_LONG_N" 84 "MID_PA_E_USS_13_SHORT_2_GND_N" 83 "MID_PA_E_USS_13_SHORT_2_USENS_N" 82 "MID_PA_E_USS_13_STATE_COM_VERIFIED_N" 81 "MID_PA_E_USS_13_STATE_OFFSET_N" 80 "MID_PA_E_USS_13_STATE_PROG_N" 79 "MID_PA_E_USS_13_STATE_TYPE_N" 78 "MID_PA_E_SVA_BLOCKED_USS_ML_N" 77 "MID_PA_E_SVA_BLOCKED_USS_MR_N" 76 "MID_PA_E_WHEEL_DIR_FL_INVALID_N" 75 "MID_PA_E_WHEEL_DIR_FR_INVALID_N" 74 "MID_PA_E_WHEEL_DIR_RL_INVALID_N" 73 "MID_PA_E_WHEEL_DIR_RR_INVALID_N" 72 "MID_PA_E_WHEEL_ROTATION_FL_INVALID_N" 71 "MID_PA_E_WHEEL_ROTATION_FR_INVALID_N" 70 "MID_PA_E_WHEEL_ROTATION_RL_INVALID_N" 69 "MID_PA_E_WHEEL_ROTATION_RR_INVALID_N" 68 "MID_PA_E_WICFL_INVALID_N" 67 "MID_PA_E_WICFR_INVALID_N" 66 "MID_PA_E_WICRL_INVALID_N" 65 "MID_PA_E_WICRR_INVALID_N" 64 "MID_PA_E_YAW_RATE_INVALID_N" 63 "MID_PDUR_E_INIT_FAILED_N" 62 "MID_PDUR_E_PDU_INSTANCE_LOST_N" 61 "MID_COMM_E_NET_START_IND_CHANNEL_0_N" 60 "MID_SPI_E_DMA_TRANSFER_N" 59 "MID_SPI_E_RECEIVE_OVERFLOW_N" 58 "MID_SPI_E_TRANSFER_TIMEOUT_N" 57 "MID_PA_E_VEHDYNINTERVENTION_TIMEOUT_N" 56 "MID_TRAILER_HITCH_PRES_INVALID_N" 55 "MID_PA_E_CL15_STATE_INVALID_N" 54 "MID_PA_E_YAW_RATE_SIGN_INVALID_N" 53 "MID_PA_E_ESP_WIC_FRONT_TIMEOUT_N" 52 "MID_PA_E_SEQ_CALL_FAILURE_N" 51 "MID_PA_E_HMI_FUNCACTIVATION_TIMEOUT_N" 50 "MID_PA_E_LOWBEAM_INVALID_N" 49 "MID_PA_E_ENGINESTART_TIMEOUT_N" 48 "MID_ADC_E_VREF_N" 47 "MID_PA_E_ESP_YAW_TIMEOUT_N" 46 "MID_PA_E_TCM_PRG_TIMEOUT_N" 45 "MID_WDG_E_MODE_SWITCH_FAILED_N" 44 "MID_WDG_E_DISABLE_REJECTED_N" 43 "MID_PA_E_ESP_WHEELDIR_TIMEOUT_N" 42 "MID_PA_E_SWCPA_E_INIT_FAILURE_N" 41 "MID_PA_E_DIR_INDICATOR_INVALID_N" 40 "MID_PA_E_ESP_WIC_TIMEOUT_N" 39 "MID_PA_E_EPS_SWA_TIMEOUT_N" 38 "MID_PA_E_INSTRCLUSTER4_TIMEOUT_N" 37 "MID_PA_E_INSTRCLUSTER5_TIMEOUT_N" 36 "MID_PA_E_INSTRCLUSTER3_TIMEOUT_N" 35 "MID_PA_E_INSTRCLUSTER2_TIMEOUT_N" 34 "MID_PA_E_ASIC_WTD_RESET_N" 33 "MID_PA_E_INSTRCLUSTER1_TIMEOUT_N" 32 "MID_PA_E_ASIC_LOW_VOLT_RESET_N" 31 "MID_PA_E_POWERMODE_TIMEOUT_N" 30 "MID_PA_E_ESP_PS_TIMEOUT_N" 29 "MID_PA_E_ESP_WIC_REAR_TIMEOUT_N" 28 "MID_PA_E_TRAILER_ATTACH_INVALID_N" 27 "MID_PA_E_EXTERNAL_EPS_FAILURE_N" 26 "MID_PA_E_PSX_ACTIVATION_INVALID_N" 25 "MID_PA_E_ESP_WHEELVELO_TIMEOUT_N" 24 "MID_PA_E_ESP_LONGACC_TIMEOUT_N" 23 "MID_PA_E_VEH_DYN_INTERVENTION_INVALID_N" 22 "MID_ZPA_E_PS_MODE_INVALID_N" 21 "MID_ZPA_E_EPS_ERROR_INVALID_N" 20 "MID_ZPA_E1_ESP_PSState_INVALID_N" 19 "MID_ZPA_E2_BdaUss01BlindnessDetect_N" 18 "MID_ZPA_E2_BdaUss02BlindnessDetect_N" 17 "MID_ZPA_E2_BdaUss03BlindnessDetect_N" 16 "MID_ZPA_E2_BdaUss10BlindnessDetect_N" 15 "MID_ZPA_E2_BdaUss05BlindnessDetect_N" 14 "MID_ZPA_E2_BdaUss11BlindnessDetect_N" 13 "MID_ZPA_E2_BdaUss07BlindnessDetect_N" 12 "MID_ZPA_E2_BdaUss12BlindnessDetect_N" 11 "MID_ZPA_E2_BdaUss06BlindnessDetect_N" 10 "MID_ZPA_E2_BdaUss08BlindnessDetect_N" 9 "MID_ZPA_E2_BdaUss13BlindnessDetect_N" 8 "MID_ZPA_E2_BdaUss09BlindnessDetect_N" 7 "MID_ZPA_E2_BdaUss04BlindnessDetect_N" 6 "MID_ZPA_E2_BdaUss14BlindnessDetect_N" 5 "MID_FLS_E_READ_FAILED_N" 4 "MID_FLS_E_COMPARE_FAILED_N" 3 "MID_FLS_E_ERASE_FAILED_N" 2 "MID_FLS_E_WRITE_FAILED_N" 1 "MID_NO_FAULT_N" 0 "MID_INVALID" ;
VAL_ 1486 PARK_sw045_subCode 254 "MID_ADC_E_TOUT_N" 253 "MID_ADC_E_INIT_FAILURE_N" 252 "MID_CAN_E_TIMEOUT_N" 251 "MID_CANIF_E_FULL_TX_BUFFER_N" 250 "MID_CANIF_E_INVALID_DLC_N" 249 "MID_CANIF_E_INVALID_TXPDUID_N" 248 "MID_CANIF_E_STOPPED_N" 247 "MID_CANNM_E_CANIF_TRANSMIT_ERROR_N" 246 "MID_CANNM_E_INIT_FAILED_N" 245 "MID_CANNM_E_NETWORK_TIMEOUT_N" 244 "MID_CANSM_E_BUSOFF_NETWORK_N" 243 "MID_CANTP_E_COM_DIAMANT_N" 242 "MID_ECU_E_EEP_DATAFLASH_LAYOUT_N" 241 "MID_ECU_E_RAM_N" 240 "MID_ECU_E_ROM_N" 239 "MID_FEE_E_LAYOUT_FAILED_N" 238 "MID_NVM_E_CONFIG_FAILED_N" 237 "MID_CAN_DASInvalidData_N" 236 "MID_CAN_C_BUSOFF_N" 235 "MID_NVM_E_INTEGRITY_FAILED_N" 234 "MID_NVM_E_REQ_FAILED_N" 233 "MID_PA_E_ASIC_COM_FAILURE_N" 232 "MID_PA_E_ASIC_HW_FAILURE_N" 231 "MID_PA_E_ENGINE_START_INVALID_N" 230 "MID_PA_E_EPS_STATUS_INVALID_N" 229 "MID_PA_E_GEAR_INVALID_N" 228 "MID_PA_E_LONG_ACC_INVALID_N" 227 "MID_PA_E_OUTSIDE_TEMP_INVALID_N" 226 "MID_CAN_EPASInvalidData_N" 225 "MID_PA_E_SPEED_INVALID_N" 224 "MID_PA_E_SVA_BLOCKED_USS_FL_N" 223 "MID_PA_E_SVA_BLOCKED_USS_FR_N" 222 "MID_PA_E_SVA_BLOCKED_USS_RL_N" 221 "MID_PA_E_SVA_BLOCKED_USS_RR_N" 220 "MID_PA_E_SWA_INVALID_N" 219 "MID_PA_E_SWCPA_APT_MONITOR_FAILURE_N" 218 "MID_PA_E_SWCPA_INHIBIT_HSS_PWRLOCK_N" 217 "MID_PA_E_SWCPA_INIT_FAILURE_N" 216 "MID_PA_E_SWCPA_PARFAILURE_N" 215 "MID_CAN_EPBInvalidData_N" 214 "MID_PA_E_UBAT_HIGH_N" 213 "MID_PA_E_UBAT_LOW_N" 212 "MID_PA_E_USENS_OVERTEMPERATURE_N" 211 "MID_PA_E_USENS_OVERVOLTAGE_N" 210 "MID_PA_E_USENS_SHORT_2_GND_N" 209 "MID_PA_E_USENS_SHORT_2_UBAT_N" 208 "MID_PA_E_USENS_UNDERVOLTAGE_N" 207 "MID_PA_E_USS_01_NO_COM_N" 206 "MID_PA_E_USS_01_OPEN_N" 205 "MID_PA_E_USS_01_RING_TOO_SHORT_N" 204 "MID_PA_E_USS_01_RINGING_TOO_LONG_N" 203 "MID_PA_E_USS_01_SHORT_2_GND_N" 202 "MID_PA_E_USS_01_SHORT_2_USENS_N" 201 "MID_PA_E_USS_01_STATE_COM_VERIFIED_N" 200 "MID_PA_E_USS_01_STATE_OFFSET_N" 199 "MID_PA_E_USS_01_STATE_PROG_N" 198 "MID_PA_E_USS_01_STATE_TYPE_N" 197 "MID_PA_E_USS_02_NO_COM_N" 196 "MID_PA_E_USS_02_OPEN_N" 195 "MID_PA_E_USS_02_RING_TOO_SHORT_N" 194 "MID_PA_E_USS_02_RINGING_TOO_LONG_N" 193 "MID_PA_E_USS_02_SHORT_2_GND_N" 192 "MID_PA_E_USS_02_SHORT_2_USENS_N" 191 "MID_PA_E_USS_02_STATE_COM_VERIFIED_N" 190 "MID_PA_E_USS_02_STATE_OFFSET_N" 189 "MID_PA_E_USS_02_STATE_PROG_N" 188 "MID_PA_E_USS_02_STATE_TYPE_N" 187 "MID_PA_E_USS_03_NO_COM_N" 186 "MID_PA_E_USS_03_OPEN_N" 185 "MID_PA_E_USS_03_RING_TOO_SHORT_N" 184 "MID_PA_E_USS_03_RINGING_TOO_LONG_N" 183 "MID_PA_E_USS_03_SHORT_2_GND_N" 182 "MID_PA_E_USS_03_SHORT_2_USENS_N" 181 "MID_PA_E_USS_03_STATE_COM_VERIFIED_N" 180 "MID_PA_E_USS_03_STATE_OFFSET_N" 179 "MID_PA_E_USS_03_STATE_PROG_N" 178 "MID_PA_E_USS_03_STATE_TYPE_N" 177 "MID_PA_E_USS_04_NO_COM_N" 176 "MID_PA_E_USS_04_OPEN_N" 175 "MID_PA_E_USS_04_RING_TOO_SHORT_N" 174 "MID_PA_E_USS_04_RINGING_TOO_LONG_N" 173 "MID_PA_E_USS_04_SHORT_2_GND_N" 172 "MID_PA_E_USS_04_SHORT_2_USENS_N" 171 "MID_PA_E_USS_04_STATE_COM_VERIFIED_N" 170 "MID_PA_E_USS_04_STATE_OFFSET_N" 169 "MID_PA_E_USS_04_STATE_PROG_N" 168 "MID_PA_E_USS_04_STATE_TYPE_N" 167 "MID_PA_E_USS_05_NO_COM_N" 166 "MID_PA_E_USS_05_OPEN_N" 165 "MID_PA_E_USS_05_RING_TOO_SHORT_N" 164 "MID_PA_E_USS_05_RINGING_TOO_LONG_N" 163 "MID_PA_E_USS_05_SHORT_2_GND_N" 162 "MID_PA_E_USS_05_SHORT_2_USENS_N" 161 "MID_PA_E_USS_05_STATE_COM_VERIFIED_N" 160 "MID_PA_E_USS_05_STATE_OFFSET_N" 159 "MID_PA_E_USS_05_STATE_PROG_N" 158 "MID_PA_E_USS_05_STATE_TYPE_N" 157 "MID_PA_E_USS_06_NO_COM_N" 156 "MID_PA_E_USS_06_OPEN_N" 155 "MID_PA_E_USS_06_RING_TOO_SHORT_N" 154 "MID_PA_E_USS_06_RINGING_TOO_LONG_N" 153 "MID_PA_E_USS_06_SHORT_2_GND_N" 152 "MID_PA_E_USS_06_SHORT_2_USENS_N" 151 "MID_PA_E_USS_06_STATE_COM_VERIFIED_N" 150 "MID_PA_E_USS_06_STATE_OFFSET_N" 149 "MID_PA_E_USS_06_STATE_PROG_N" 148 "MID_PA_E_USS_06_STATE_TYPE_N" 147 "MID_CAN_ESPInvalidData_N" 146 "MID_CAN_GTWInvalidData_N" 145 "MID_CAN_SCCMInvalidData_N" 144 "MID_CAN_DASLossOfCommunication_N" 143 "MID_CAN_EPASLossOfCommunication_N" 142 "MID_CAN_EPBLossOfCommunication_N" 141 "MID_CAN_ESPLossOfCommunication_N" 140 "MID_CAN_GTWLossOfCommunication_N" 139 "MID_CAN_SCCMLossOfCommunication_N" 138 "MID_PA_E_USS_08_NO_COM_N" 137 "MID_PA_E_USS_08_OPEN_N" 136 "MID_PA_E_USS_08_RING_TOO_SHORT_N" 135 "MID_PA_E_USS_08_RINGING_TOO_LONG_N" 134 "MID_PA_E_USS_08_SHORT_2_GND_N" 133 "MID_PA_E_USS_08_SHORT_2_USENS_N" 132 "MID_PA_E_USS_08_STATE_COM_VERIFIED_N" 131 "MID_PA_E_USS_08_STATE_OFFSET_N" 130 "MID_PA_E_USS_08_STATE_PROG_N" 129 "MID_PA_E_USS_08_STATE_TYPE_N" 128 "MID_PA_E_USS_09_NO_COM_N" 127 "MID_PA_E_USS_09_OPEN_N" 126 "MID_PA_E_USS_09_RING_TOO_SHORT_N" 125 "MID_PA_E_USS_09_RINGING_TOO_LONG_N" 124 "MID_PA_E_USS_09_SHORT_2_GND_N" 123 "MID_PA_E_USS_09_SHORT_2_USENS_N" 122 "MID_PA_E_USS_09_STATE_COM_VERIFIED_N" 121 "MID_PA_E_USS_09_STATE_OFFSET_N" 120 "MID_PA_E_USS_09_STATE_PROG_N" 119 "MID_PA_E_USS_09_STATE_TYPE_N" 118 "MID_PA_E_USS_10_NO_COM_N" 117 "MID_PA_E_USS_10_OPEN_N" 116 "MID_PA_E_USS_10_RING_TOO_SHORT_N" 115 "MID_PA_E_USS_10_RINGING_TOO_LONG_N" 114 "MID_PA_E_USS_10_SHORT_2_GND_N" 113 "MID_PA_E_USS_10_SHORT_2_USENS_N" 112 "MID_PA_E_USS_10_STATE_COM_VERIFIED_N" 111 "MID_PA_E_USS_10_STATE_OFFSET_N" 110 "MID_PA_E_USS_10_STATE_PROG_N" 109 "MID_PA_E_USS_10_STATE_TYPE_N" 108 "MID_PA_E_USS_11_NO_COM_N" 107 "MID_PA_E_USS_11_OPEN_N" 106 "MID_PA_E_USS_11_RING_TOO_SHORT_N" 105 "MID_PA_E_USS_11_RINGING_TOO_LONG_N" 104 "MID_PA_E_USS_11_SHORT_2_GND_N" 103 "MID_PA_E_USS_11_SHORT_2_USENS_N" 102 "MID_PA_E_USS_11_STATE_COM_VERIFIED_N" 101 "MID_PA_E_USS_11_STATE_OFFSET_N" 100 "MID_PA_E_USS_11_STATE_PROG_N" 99 "MID_PA_E_USS_11_STATE_TYPE_N" 98 "MID_PA_E_USS_12_NO_COM_N" 97 "MID_PA_E_USS_12_OPEN_N" 96 "MID_PA_E_USS_12_RING_TOO_SHORT_N" 95 "MID_PA_E_USS_12_RINGING_TOO_LONG_N" 94 "MID_PA_E_USS_12_SHORT_2_GND_N" 93 "MID_PA_E_USS_12_SHORT_2_USENS_N" 92 "MID_PA_E_USS_12_STATE_COM_VERIFIED_N" 91 "MID_PA_E_USS_12_STATE_OFFSET_N" 90 "MID_PA_E_USS_12_STATE_PROG_N" 89 "MID_PA_E_USS_12_STATE_TYPE_N" 88 "MID_PA_E_USS_13_NO_COM_N" 87 "MID_PA_E_USS_13_OPEN_N" 86 "MID_PA_E_USS_13_RING_TOO_SHORT_N" 85 "MID_PA_E_USS_13_RINGING_TOO_LONG_N" 84 "MID_PA_E_USS_13_SHORT_2_GND_N" 83 "MID_PA_E_USS_13_SHORT_2_USENS_N" 82 "MID_PA_E_USS_13_STATE_COM_VERIFIED_N" 81 "MID_PA_E_USS_13_STATE_OFFSET_N" 80 "MID_PA_E_USS_13_STATE_PROG_N" 79 "MID_PA_E_USS_13_STATE_TYPE_N" 78 "MID_PA_E_SVA_BLOCKED_USS_ML_N" 77 "MID_PA_E_SVA_BLOCKED_USS_MR_N" 76 "MID_PA_E_WHEEL_DIR_FL_INVALID_N" 75 "MID_PA_E_WHEEL_DIR_FR_INVALID_N" 74 "MID_PA_E_WHEEL_DIR_RL_INVALID_N" 73 "MID_PA_E_WHEEL_DIR_RR_INVALID_N" 72 "MID_PA_E_WHEEL_ROTATION_FL_INVALID_N" 71 "MID_PA_E_WHEEL_ROTATION_FR_INVALID_N" 70 "MID_PA_E_WHEEL_ROTATION_RL_INVALID_N" 69 "MID_PA_E_WHEEL_ROTATION_RR_INVALID_N" 68 "MID_PA_E_WICFL_INVALID_N" 67 "MID_PA_E_WICFR_INVALID_N" 66 "MID_PA_E_WICRL_INVALID_N" 65 "MID_PA_E_WICRR_INVALID_N" 64 "MID_PA_E_YAW_RATE_INVALID_N" 63 "MID_PDUR_E_INIT_FAILED_N" 62 "MID_PDUR_E_PDU_INSTANCE_LOST_N" 61 "MID_COMM_E_NET_START_IND_CHANNEL_0_N" 60 "MID_SPI_E_DMA_TRANSFER_N" 59 "MID_SPI_E_RECEIVE_OVERFLOW_N" 58 "MID_SPI_E_TRANSFER_TIMEOUT_N" 57 "MID_PA_E_VEHDYNINTERVENTION_TIMEOUT_N" 56 "MID_TRAILER_HITCH_PRES_INVALID_N" 55 "MID_PA_E_CL15_STATE_INVALID_N" 54 "MID_PA_E_YAW_RATE_SIGN_INVALID_N" 53 "MID_PA_E_ESP_WIC_FRONT_TIMEOUT_N" 52 "MID_PA_E_SEQ_CALL_FAILURE_N" 51 "MID_PA_E_HMI_FUNCACTIVATION_TIMEOUT_N" 50 "MID_PA_E_LOWBEAM_INVALID_N" 49 "MID_PA_E_ENGINESTART_TIMEOUT_N" 48 "MID_ADC_E_VREF_N" 47 "MID_PA_E_ESP_YAW_TIMEOUT_N" 46 "MID_PA_E_TCM_PRG_TIMEOUT_N" 45 "MID_WDG_E_MODE_SWITCH_FAILED_N" 44 "MID_WDG_E_DISABLE_REJECTED_N" 43 "MID_PA_E_ESP_WHEELDIR_TIMEOUT_N" 42 "MID_PA_E_SWCPA_E_INIT_FAILURE_N" 41 "MID_PA_E_DIR_INDICATOR_INVALID_N" 40 "MID_PA_E_ESP_WIC_TIMEOUT_N" 39 "MID_PA_E_EPS_SWA_TIMEOUT_N" 38 "MID_PA_E_INSTRCLUSTER4_TIMEOUT_N" 37 "MID_PA_E_INSTRCLUSTER5_TIMEOUT_N" 36 "MID_PA_E_INSTRCLUSTER3_TIMEOUT_N" 35 "MID_PA_E_INSTRCLUSTER2_TIMEOUT_N" 34 "MID_PA_E_ASIC_WTD_RESET_N" 33 "MID_PA_E_INSTRCLUSTER1_TIMEOUT_N" 32 "MID_PA_E_ASIC_LOW_VOLT_RESET_N" 31 "MID_PA_E_POWERMODE_TIMEOUT_N" 30 "MID_PA_E_ESP_PS_TIMEOUT_N" 29 "MID_PA_E_ESP_WIC_REAR_TIMEOUT_N" 28 "MID_PA_E_TRAILER_ATTACH_INVALID_N" 27 "MID_PA_E_EXTERNAL_EPS_FAILURE_N" 26 "MID_PA_E_PSX_ACTIVATION_INVALID_N" 25 "MID_PA_E_ESP_WHEELVELO_TIMEOUT_N" 24 "MID_PA_E_ESP_LONGACC_TIMEOUT_N" 23 "MID_PA_E_VEH_DYN_INTERVENTION_INVALID_N" 22 "MID_ZPA_E_PS_MODE_INVALID_N" 21 "MID_ZPA_E_EPS_ERROR_INVALID_N" 20 "MID_ZPA_E1_ESP_PSState_INVALID_N" 19 "MID_ZPA_E2_BdaUss01BlindnessDetect_N" 18 "MID_ZPA_E2_BdaUss02BlindnessDetect_N" 17 "MID_ZPA_E2_BdaUss03BlindnessDetect_N" 16 "MID_ZPA_E2_BdaUss10BlindnessDetect_N" 15 "MID_ZPA_E2_BdaUss05BlindnessDetect_N" 14 "MID_ZPA_E2_BdaUss11BlindnessDetect_N" 13 "MID_ZPA_E2_BdaUss07BlindnessDetect_N" 12 "MID_ZPA_E2_BdaUss12BlindnessDetect_N" 11 "MID_ZPA_E2_BdaUss06BlindnessDetect_N" 10 "MID_ZPA_E2_BdaUss08BlindnessDetect_N" 9 "MID_ZPA_E2_BdaUss13BlindnessDetect_N" 8 "MID_ZPA_E2_BdaUss09BlindnessDetect_N" 7 "MID_ZPA_E2_BdaUss04BlindnessDetect_N" 6 "MID_ZPA_E2_BdaUss14BlindnessDetect_N" 5 "MID_FLS_E_READ_FAILED_N" 4 "MID_FLS_E_COMPARE_FAILED_N" 3 "MID_FLS_E_ERASE_FAILED_N" 2 "MID_FLS_E_WRITE_FAILED_N" 1 "MID_NO_FAULT_N" 0 "MID_INVALID" ;
VAL_ 1486 PARK_sw046_subCode 254 "MID_ADC_E_TOUT_N" 253 "MID_ADC_E_INIT_FAILURE_N" 252 "MID_CAN_E_TIMEOUT_N" 251 "MID_CANIF_E_FULL_TX_BUFFER_N" 250 "MID_CANIF_E_INVALID_DLC_N" 249 "MID_CANIF_E_INVALID_TXPDUID_N" 248 "MID_CANIF_E_STOPPED_N" 247 "MID_CANNM_E_CANIF_TRANSMIT_ERROR_N" 246 "MID_CANNM_E_INIT_FAILED_N" 245 "MID_CANNM_E_NETWORK_TIMEOUT_N" 244 "MID_CANSM_E_BUSOFF_NETWORK_N" 243 "MID_CANTP_E_COM_DIAMANT_N" 242 "MID_ECU_E_EEP_DATAFLASH_LAYOUT_N" 241 "MID_ECU_E_RAM_N" 240 "MID_ECU_E_ROM_N" 239 "MID_FEE_E_LAYOUT_FAILED_N" 238 "MID_NVM_E_CONFIG_FAILED_N" 237 "MID_CAN_DASInvalidData_N" 236 "MID_CAN_C_BUSOFF_N" 235 "MID_NVM_E_INTEGRITY_FAILED_N" 234 "MID_NVM_E_REQ_FAILED_N" 233 "MID_PA_E_ASIC_COM_FAILURE_N" 232 "MID_PA_E_ASIC_HW_FAILURE_N" 231 "MID_PA_E_ENGINE_START_INVALID_N" 230 "MID_PA_E_EPS_STATUS_INVALID_N" 229 "MID_PA_E_GEAR_INVALID_N" 228 "MID_PA_E_LONG_ACC_INVALID_N" 227 "MID_PA_E_OUTSIDE_TEMP_INVALID_N" 226 "MID_CAN_EPASInvalidData_N" 225 "MID_PA_E_SPEED_INVALID_N" 224 "MID_PA_E_SVA_BLOCKED_USS_FL_N" 223 "MID_PA_E_SVA_BLOCKED_USS_FR_N" 222 "MID_PA_E_SVA_BLOCKED_USS_RL_N" 221 "MID_PA_E_SVA_BLOCKED_USS_RR_N" 220 "MID_PA_E_SWA_INVALID_N" 219 "MID_PA_E_SWCPA_APT_MONITOR_FAILURE_N" 218 "MID_PA_E_SWCPA_INHIBIT_HSS_PWRLOCK_N" 217 "MID_PA_E_SWCPA_INIT_FAILURE_N" 216 "MID_PA_E_SWCPA_PARFAILURE_N" 215 "MID_CAN_EPBInvalidData_N" 214 "MID_PA_E_UBAT_HIGH_N" 213 "MID_PA_E_UBAT_LOW_N" 212 "MID_PA_E_USENS_OVERTEMPERATURE_N" 211 "MID_PA_E_USENS_OVERVOLTAGE_N" 210 "MID_PA_E_USENS_SHORT_2_GND_N" 209 "MID_PA_E_USENS_SHORT_2_UBAT_N" 208 "MID_PA_E_USENS_UNDERVOLTAGE_N" 207 "MID_PA_E_USS_01_NO_COM_N" 206 "MID_PA_E_USS_01_OPEN_N" 205 "MID_PA_E_USS_01_RING_TOO_SHORT_N" 204 "MID_PA_E_USS_01_RINGING_TOO_LONG_N" 203 "MID_PA_E_USS_01_SHORT_2_GND_N" 202 "MID_PA_E_USS_01_SHORT_2_USENS_N" 201 "MID_PA_E_USS_01_STATE_COM_VERIFIED_N" 200 "MID_PA_E_USS_01_STATE_OFFSET_N" 199 "MID_PA_E_USS_01_STATE_PROG_N" 198 "MID_PA_E_USS_01_STATE_TYPE_N" 197 "MID_PA_E_USS_02_NO_COM_N" 196 "MID_PA_E_USS_02_OPEN_N" 195 "MID_PA_E_USS_02_RING_TOO_SHORT_N" 194 "MID_PA_E_USS_02_RINGING_TOO_LONG_N" 193 "MID_PA_E_USS_02_SHORT_2_GND_N" 192 "MID_PA_E_USS_02_SHORT_2_USENS_N" 191 "MID_PA_E_USS_02_STATE_COM_VERIFIED_N" 190 "MID_PA_E_USS_02_STATE_OFFSET_N" 189 "MID_PA_E_USS_02_STATE_PROG_N" 188 "MID_PA_E_USS_02_STATE_TYPE_N" 187 "MID_PA_E_USS_03_NO_COM_N" 186 "MID_PA_E_USS_03_OPEN_N" 185 "MID_PA_E_USS_03_RING_TOO_SHORT_N" 184 "MID_PA_E_USS_03_RINGING_TOO_LONG_N" 183 "MID_PA_E_USS_03_SHORT_2_GND_N" 182 "MID_PA_E_USS_03_SHORT_2_USENS_N" 181 "MID_PA_E_USS_03_STATE_COM_VERIFIED_N" 180 "MID_PA_E_USS_03_STATE_OFFSET_N" 179 "MID_PA_E_USS_03_STATE_PROG_N" 178 "MID_PA_E_USS_03_STATE_TYPE_N" 177 "MID_PA_E_USS_04_NO_COM_N" 176 "MID_PA_E_USS_04_OPEN_N" 175 "MID_PA_E_USS_04_RING_TOO_SHORT_N" 174 "MID_PA_E_USS_04_RINGING_TOO_LONG_N" 173 "MID_PA_E_USS_04_SHORT_2_GND_N" 172 "MID_PA_E_USS_04_SHORT_2_USENS_N" 171 "MID_PA_E_USS_04_STATE_COM_VERIFIED_N" 170 "MID_PA_E_USS_04_STATE_OFFSET_N" 169 "MID_PA_E_USS_04_STATE_PROG_N" 168 "MID_PA_E_USS_04_STATE_TYPE_N" 167 "MID_PA_E_USS_05_NO_COM_N" 166 "MID_PA_E_USS_05_OPEN_N" 165 "MID_PA_E_USS_05_RING_TOO_SHORT_N" 164 "MID_PA_E_USS_05_RINGING_TOO_LONG_N" 163 "MID_PA_E_USS_05_SHORT_2_GND_N" 162 "MID_PA_E_USS_05_SHORT_2_USENS_N" 161 "MID_PA_E_USS_05_STATE_COM_VERIFIED_N" 160 "MID_PA_E_USS_05_STATE_OFFSET_N" 159 "MID_PA_E_USS_05_STATE_PROG_N" 158 "MID_PA_E_USS_05_STATE_TYPE_N" 157 "MID_PA_E_USS_06_NO_COM_N" 156 "MID_PA_E_USS_06_OPEN_N" 155 "MID_PA_E_USS_06_RING_TOO_SHORT_N" 154 "MID_PA_E_USS_06_RINGING_TOO_LONG_N" 153 "MID_PA_E_USS_06_SHORT_2_GND_N" 152 "MID_PA_E_USS_06_SHORT_2_USENS_N" 151 "MID_PA_E_USS_06_STATE_COM_VERIFIED_N" 150 "MID_PA_E_USS_06_STATE_OFFSET_N" 149 "MID_PA_E_USS_06_STATE_PROG_N" 148 "MID_PA_E_USS_06_STATE_TYPE_N" 147 "MID_CAN_ESPInvalidData_N" 146 "MID_CAN_GTWInvalidData_N" 145 "MID_CAN_SCCMInvalidData_N" 144 "MID_CAN_DASLossOfCommunication_N" 143 "MID_CAN_EPASLossOfCommunication_N" 142 "MID_CAN_EPBLossOfCommunication_N" 141 "MID_CAN_ESPLossOfCommunication_N" 140 "MID_CAN_GTWLossOfCommunication_N" 139 "MID_CAN_SCCMLossOfCommunication_N" 138 "MID_PA_E_USS_08_NO_COM_N" 137 "MID_PA_E_USS_08_OPEN_N" 136 "MID_PA_E_USS_08_RING_TOO_SHORT_N" 135 "MID_PA_E_USS_08_RINGING_TOO_LONG_N" 134 "MID_PA_E_USS_08_SHORT_2_GND_N" 133 "MID_PA_E_USS_08_SHORT_2_USENS_N" 132 "MID_PA_E_USS_08_STATE_COM_VERIFIED_N" 131 "MID_PA_E_USS_08_STATE_OFFSET_N" 130 "MID_PA_E_USS_08_STATE_PROG_N" 129 "MID_PA_E_USS_08_STATE_TYPE_N" 128 "MID_PA_E_USS_09_NO_COM_N" 127 "MID_PA_E_USS_09_OPEN_N" 126 "MID_PA_E_USS_09_RING_TOO_SHORT_N" 125 "MID_PA_E_USS_09_RINGING_TOO_LONG_N" 124 "MID_PA_E_USS_09_SHORT_2_GND_N" 123 "MID_PA_E_USS_09_SHORT_2_USENS_N" 122 "MID_PA_E_USS_09_STATE_COM_VERIFIED_N" 121 "MID_PA_E_USS_09_STATE_OFFSET_N" 120 "MID_PA_E_USS_09_STATE_PROG_N" 119 "MID_PA_E_USS_09_STATE_TYPE_N" 118 "MID_PA_E_USS_10_NO_COM_N" 117 "MID_PA_E_USS_10_OPEN_N" 116 "MID_PA_E_USS_10_RING_TOO_SHORT_N" 115 "MID_PA_E_USS_10_RINGING_TOO_LONG_N" 114 "MID_PA_E_USS_10_SHORT_2_GND_N" 113 "MID_PA_E_USS_10_SHORT_2_USENS_N" 112 "MID_PA_E_USS_10_STATE_COM_VERIFIED_N" 111 "MID_PA_E_USS_10_STATE_OFFSET_N" 110 "MID_PA_E_USS_10_STATE_PROG_N" 109 "MID_PA_E_USS_10_STATE_TYPE_N" 108 "MID_PA_E_USS_11_NO_COM_N" 107 "MID_PA_E_USS_11_OPEN_N" 106 "MID_PA_E_USS_11_RING_TOO_SHORT_N" 105 "MID_PA_E_USS_11_RINGING_TOO_LONG_N" 104 "MID_PA_E_USS_11_SHORT_2_GND_N" 103 "MID_PA_E_USS_11_SHORT_2_USENS_N" 102 "MID_PA_E_USS_11_STATE_COM_VERIFIED_N" 101 "MID_PA_E_USS_11_STATE_OFFSET_N" 100 "MID_PA_E_USS_11_STATE_PROG_N" 99 "MID_PA_E_USS_11_STATE_TYPE_N" 98 "MID_PA_E_USS_12_NO_COM_N" 97 "MID_PA_E_USS_12_OPEN_N" 96 "MID_PA_E_USS_12_RING_TOO_SHORT_N" 95 "MID_PA_E_USS_12_RINGING_TOO_LONG_N" 94 "MID_PA_E_USS_12_SHORT_2_GND_N" 93 "MID_PA_E_USS_12_SHORT_2_USENS_N" 92 "MID_PA_E_USS_12_STATE_COM_VERIFIED_N" 91 "MID_PA_E_USS_12_STATE_OFFSET_N" 90 "MID_PA_E_USS_12_STATE_PROG_N" 89 "MID_PA_E_USS_12_STATE_TYPE_N" 88 "MID_PA_E_USS_13_NO_COM_N" 87 "MID_PA_E_USS_13_OPEN_N" 86 "MID_PA_E_USS_13_RING_TOO_SHORT_N" 85 "MID_PA_E_USS_13_RINGING_TOO_LONG_N" 84 "MID_PA_E_USS_13_SHORT_2_GND_N" 83 "MID_PA_E_USS_13_SHORT_2_USENS_N" 82 "MID_PA_E_USS_13_STATE_COM_VERIFIED_N" 81 "MID_PA_E_USS_13_STATE_OFFSET_N" 80 "MID_PA_E_USS_13_STATE_PROG_N" 79 "MID_PA_E_USS_13_STATE_TYPE_N" 78 "MID_PA_E_SVA_BLOCKED_USS_ML_N" 77 "MID_PA_E_SVA_BLOCKED_USS_MR_N" 76 "MID_PA_E_WHEEL_DIR_FL_INVALID_N" 75 "MID_PA_E_WHEEL_DIR_FR_INVALID_N" 74 "MID_PA_E_WHEEL_DIR_RL_INVALID_N" 73 "MID_PA_E_WHEEL_DIR_RR_INVALID_N" 72 "MID_PA_E_WHEEL_ROTATION_FL_INVALID_N" 71 "MID_PA_E_WHEEL_ROTATION_FR_INVALID_N" 70 "MID_PA_E_WHEEL_ROTATION_RL_INVALID_N" 69 "MID_PA_E_WHEEL_ROTATION_RR_INVALID_N" 68 "MID_PA_E_WICFL_INVALID_N" 67 "MID_PA_E_WICFR_INVALID_N" 66 "MID_PA_E_WICRL_INVALID_N" 65 "MID_PA_E_WICRR_INVALID_N" 64 "MID_PA_E_YAW_RATE_INVALID_N" 63 "MID_PDUR_E_INIT_FAILED_N" 62 "MID_PDUR_E_PDU_INSTANCE_LOST_N" 61 "MID_COMM_E_NET_START_IND_CHANNEL_0_N" 60 "MID_SPI_E_DMA_TRANSFER_N" 59 "MID_SPI_E_RECEIVE_OVERFLOW_N" 58 "MID_SPI_E_TRANSFER_TIMEOUT_N" 57 "MID_PA_E_VEHDYNINTERVENTION_TIMEOUT_N" 56 "MID_TRAILER_HITCH_PRES_INVALID_N" 55 "MID_PA_E_CL15_STATE_INVALID_N" 54 "MID_PA_E_YAW_RATE_SIGN_INVALID_N" 53 "MID_PA_E_ESP_WIC_FRONT_TIMEOUT_N" 52 "MID_PA_E_SEQ_CALL_FAILURE_N" 51 "MID_PA_E_HMI_FUNCACTIVATION_TIMEOUT_N" 50 "MID_PA_E_LOWBEAM_INVALID_N" 49 "MID_PA_E_ENGINESTART_TIMEOUT_N" 48 "MID_ADC_E_VREF_N" 47 "MID_PA_E_ESP_YAW_TIMEOUT_N" 46 "MID_PA_E_TCM_PRG_TIMEOUT_N" 45 "MID_WDG_E_MODE_SWITCH_FAILED_N" 44 "MID_WDG_E_DISABLE_REJECTED_N" 43 "MID_PA_E_ESP_WHEELDIR_TIMEOUT_N" 42 "MID_PA_E_SWCPA_E_INIT_FAILURE_N" 41 "MID_PA_E_DIR_INDICATOR_INVALID_N" 40 "MID_PA_E_ESP_WIC_TIMEOUT_N" 39 "MID_PA_E_EPS_SWA_TIMEOUT_N" 38 "MID_PA_E_INSTRCLUSTER4_TIMEOUT_N" 37 "MID_PA_E_INSTRCLUSTER5_TIMEOUT_N" 36 "MID_PA_E_INSTRCLUSTER3_TIMEOUT_N" 35 "MID_PA_E_INSTRCLUSTER2_TIMEOUT_N" 34 "MID_PA_E_ASIC_WTD_RESET_N" 33 "MID_PA_E_INSTRCLUSTER1_TIMEOUT_N" 32 "MID_PA_E_ASIC_LOW_VOLT_RESET_N" 31 "MID_PA_E_POWERMODE_TIMEOUT_N" 30 "MID_PA_E_ESP_PS_TIMEOUT_N" 29 "MID_PA_E_ESP_WIC_REAR_TIMEOUT_N" 28 "MID_PA_E_TRAILER_ATTACH_INVALID_N" 27 "MID_PA_E_EXTERNAL_EPS_FAILURE_N" 26 "MID_PA_E_PSX_ACTIVATION_INVALID_N" 25 "MID_PA_E_ESP_WHEELVELO_TIMEOUT_N" 24 "MID_PA_E_ESP_LONGACC_TIMEOUT_N" 23 "MID_PA_E_VEH_DYN_INTERVENTION_INVALID_N" 22 "MID_ZPA_E_PS_MODE_INVALID_N" 21 "MID_ZPA_E_EPS_ERROR_INVALID_N" 20 "MID_ZPA_E1_ESP_PSState_INVALID_N" 19 "MID_ZPA_E2_BdaUss01BlindnessDetect_N" 18 "MID_ZPA_E2_BdaUss02BlindnessDetect_N" 17 "MID_ZPA_E2_BdaUss03BlindnessDetect_N" 16 "MID_ZPA_E2_BdaUss10BlindnessDetect_N" 15 "MID_ZPA_E2_BdaUss05BlindnessDetect_N" 14 "MID_ZPA_E2_BdaUss11BlindnessDetect_N" 13 "MID_ZPA_E2_BdaUss07BlindnessDetect_N" 12 "MID_ZPA_E2_BdaUss12BlindnessDetect_N" 11 "MID_ZPA_E2_BdaUss06BlindnessDetect_N" 10 "MID_ZPA_E2_BdaUss08BlindnessDetect_N" 9 "MID_ZPA_E2_BdaUss13BlindnessDetect_N" 8 "MID_ZPA_E2_BdaUss09BlindnessDetect_N" 7 "MID_ZPA_E2_BdaUss04BlindnessDetect_N" 6 "MID_ZPA_E2_BdaUss14BlindnessDetect_N" 5 "MID_FLS_E_READ_FAILED_N" 4 "MID_FLS_E_COMPARE_FAILED_N" 3 "MID_FLS_E_ERASE_FAILED_N" 2 "MID_FLS_E_WRITE_FAILED_N" 1 "MID_NO_FAULT_N" 0 "MID_INVALID" ;
VAL_ 1486 PARK_sw047_subCode 254 "MID_ADC_E_TOUT_N" 253 "MID_ADC_E_INIT_FAILURE_N" 252 "MID_CAN_E_TIMEOUT_N" 251 "MID_CANIF_E_FULL_TX_BUFFER_N" 250 "MID_CANIF_E_INVALID_DLC_N" 249 "MID_CANIF_E_INVALID_TXPDUID_N" 248 "MID_CANIF_E_STOPPED_N" 247 "MID_CANNM_E_CANIF_TRANSMIT_ERROR_N" 246 "MID_CANNM_E_INIT_FAILED_N" 245 "MID_CANNM_E_NETWORK_TIMEOUT_N" 244 "MID_CANSM_E_BUSOFF_NETWORK_N" 243 "MID_CANTP_E_COM_DIAMANT_N" 242 "MID_ECU_E_EEP_DATAFLASH_LAYOUT_N" 241 "MID_ECU_E_RAM_N" 240 "MID_ECU_E_ROM_N" 239 "MID_FEE_E_LAYOUT_FAILED_N" 238 "MID_NVM_E_CONFIG_FAILED_N" 237 "MID_CAN_DASInvalidData_N" 236 "MID_CAN_C_BUSOFF_N" 235 "MID_NVM_E_INTEGRITY_FAILED_N" 234 "MID_NVM_E_REQ_FAILED_N" 233 "MID_PA_E_ASIC_COM_FAILURE_N" 232 "MID_PA_E_ASIC_HW_FAILURE_N" 231 "MID_PA_E_ENGINE_START_INVALID_N" 230 "MID_PA_E_EPS_STATUS_INVALID_N" 229 "MID_PA_E_GEAR_INVALID_N" 228 "MID_PA_E_LONG_ACC_INVALID_N" 227 "MID_PA_E_OUTSIDE_TEMP_INVALID_N" 226 "MID_CAN_EPASInvalidData_N" 225 "MID_PA_E_SPEED_INVALID_N" 224 "MID_PA_E_SVA_BLOCKED_USS_FL_N" 223 "MID_PA_E_SVA_BLOCKED_USS_FR_N" 222 "MID_PA_E_SVA_BLOCKED_USS_RL_N" 221 "MID_PA_E_SVA_BLOCKED_USS_RR_N" 220 "MID_PA_E_SWA_INVALID_N" 219 "MID_PA_E_SWCPA_APT_MONITOR_FAILURE_N" 218 "MID_PA_E_SWCPA_INHIBIT_HSS_PWRLOCK_N" 217 "MID_PA_E_SWCPA_INIT_FAILURE_N" 216 "MID_PA_E_SWCPA_PARFAILURE_N" 215 "MID_CAN_EPBInvalidData_N" 214 "MID_PA_E_UBAT_HIGH_N" 213 "MID_PA_E_UBAT_LOW_N" 212 "MID_PA_E_USENS_OVERTEMPERATURE_N" 211 "MID_PA_E_USENS_OVERVOLTAGE_N" 210 "MID_PA_E_USENS_SHORT_2_GND_N" 209 "MID_PA_E_USENS_SHORT_2_UBAT_N" 208 "MID_PA_E_USENS_UNDERVOLTAGE_N" 207 "MID_PA_E_USS_01_NO_COM_N" 206 "MID_PA_E_USS_01_OPEN_N" 205 "MID_PA_E_USS_01_RING_TOO_SHORT_N" 204 "MID_PA_E_USS_01_RINGING_TOO_LONG_N" 203 "MID_PA_E_USS_01_SHORT_2_GND_N" 202 "MID_PA_E_USS_01_SHORT_2_USENS_N" 201 "MID_PA_E_USS_01_STATE_COM_VERIFIED_N" 200 "MID_PA_E_USS_01_STATE_OFFSET_N" 199 "MID_PA_E_USS_01_STATE_PROG_N" 198 "MID_PA_E_USS_01_STATE_TYPE_N" 197 "MID_PA_E_USS_02_NO_COM_N" 196 "MID_PA_E_USS_02_OPEN_N" 195 "MID_PA_E_USS_02_RING_TOO_SHORT_N" 194 "MID_PA_E_USS_02_RINGING_TOO_LONG_N" 193 "MID_PA_E_USS_02_SHORT_2_GND_N" 192 "MID_PA_E_USS_02_SHORT_2_USENS_N" 191 "MID_PA_E_USS_02_STATE_COM_VERIFIED_N" 190 "MID_PA_E_USS_02_STATE_OFFSET_N" 189 "MID_PA_E_USS_02_STATE_PROG_N" 188 "MID_PA_E_USS_02_STATE_TYPE_N" 187 "MID_PA_E_USS_03_NO_COM_N" 186 "MID_PA_E_USS_03_OPEN_N" 185 "MID_PA_E_USS_03_RING_TOO_SHORT_N" 184 "MID_PA_E_USS_03_RINGING_TOO_LONG_N" 183 "MID_PA_E_USS_03_SHORT_2_GND_N" 182 "MID_PA_E_USS_03_SHORT_2_USENS_N" 181 "MID_PA_E_USS_03_STATE_COM_VERIFIED_N" 180 "MID_PA_E_USS_03_STATE_OFFSET_N" 179 "MID_PA_E_USS_03_STATE_PROG_N" 178 "MID_PA_E_USS_03_STATE_TYPE_N" 177 "MID_PA_E_USS_04_NO_COM_N" 176 "MID_PA_E_USS_04_OPEN_N" 175 "MID_PA_E_USS_04_RING_TOO_SHORT_N" 174 "MID_PA_E_USS_04_RINGING_TOO_LONG_N" 173 "MID_PA_E_USS_04_SHORT_2_GND_N" 172 "MID_PA_E_USS_04_SHORT_2_USENS_N" 171 "MID_PA_E_USS_04_STATE_COM_VERIFIED_N" 170 "MID_PA_E_USS_04_STATE_OFFSET_N" 169 "MID_PA_E_USS_04_STATE_PROG_N" 168 "MID_PA_E_USS_04_STATE_TYPE_N" 167 "MID_PA_E_USS_05_NO_COM_N" 166 "MID_PA_E_USS_05_OPEN_N" 165 "MID_PA_E_USS_05_RING_TOO_SHORT_N" 164 "MID_PA_E_USS_05_RINGING_TOO_LONG_N" 163 "MID_PA_E_USS_05_SHORT_2_GND_N" 162 "MID_PA_E_USS_05_SHORT_2_USENS_N" 161 "MID_PA_E_USS_05_STATE_COM_VERIFIED_N" 160 "MID_PA_E_USS_05_STATE_OFFSET_N" 159 "MID_PA_E_USS_05_STATE_PROG_N" 158 "MID_PA_E_USS_05_STATE_TYPE_N" 157 "MID_PA_E_USS_06_NO_COM_N" 156 "MID_PA_E_USS_06_OPEN_N" 155 "MID_PA_E_USS_06_RING_TOO_SHORT_N" 154 "MID_PA_E_USS_06_RINGING_TOO_LONG_N" 153 "MID_PA_E_USS_06_SHORT_2_GND_N" 152 "MID_PA_E_USS_06_SHORT_2_USENS_N" 151 "MID_PA_E_USS_06_STATE_COM_VERIFIED_N" 150 "MID_PA_E_USS_06_STATE_OFFSET_N" 149 "MID_PA_E_USS_06_STATE_PROG_N" 148 "MID_PA_E_USS_06_STATE_TYPE_N" 147 "MID_CAN_ESPInvalidData_N" 146 "MID_CAN_GTWInvalidData_N" 145 "MID_CAN_SCCMInvalidData_N" 144 "MID_CAN_DASLossOfCommunication_N" 143 "MID_CAN_EPASLossOfCommunication_N" 142 "MID_CAN_EPBLossOfCommunication_N" 141 "MID_CAN_ESPLossOfCommunication_N" 140 "MID_CAN_GTWLossOfCommunication_N" 139 "MID_CAN_SCCMLossOfCommunication_N" 138 "MID_PA_E_USS_08_NO_COM_N" 137 "MID_PA_E_USS_08_OPEN_N" 136 "MID_PA_E_USS_08_RING_TOO_SHORT_N" 135 "MID_PA_E_USS_08_RINGING_TOO_LONG_N" 134 "MID_PA_E_USS_08_SHORT_2_GND_N" 133 "MID_PA_E_USS_08_SHORT_2_USENS_N" 132 "MID_PA_E_USS_08_STATE_COM_VERIFIED_N" 131 "MID_PA_E_USS_08_STATE_OFFSET_N" 130 "MID_PA_E_USS_08_STATE_PROG_N" 129 "MID_PA_E_USS_08_STATE_TYPE_N" 128 "MID_PA_E_USS_09_NO_COM_N" 127 "MID_PA_E_USS_09_OPEN_N" 126 "MID_PA_E_USS_09_RING_TOO_SHORT_N" 125 "MID_PA_E_USS_09_RINGING_TOO_LONG_N" 124 "MID_PA_E_USS_09_SHORT_2_GND_N" 123 "MID_PA_E_USS_09_SHORT_2_USENS_N" 122 "MID_PA_E_USS_09_STATE_COM_VERIFIED_N" 121 "MID_PA_E_USS_09_STATE_OFFSET_N" 120 "MID_PA_E_USS_09_STATE_PROG_N" 119 "MID_PA_E_USS_09_STATE_TYPE_N" 118 "MID_PA_E_USS_10_NO_COM_N" 117 "MID_PA_E_USS_10_OPEN_N" 116 "MID_PA_E_USS_10_RING_TOO_SHORT_N" 115 "MID_PA_E_USS_10_RINGING_TOO_LONG_N" 114 "MID_PA_E_USS_10_SHORT_2_GND_N" 113 "MID_PA_E_USS_10_SHORT_2_USENS_N" 112 "MID_PA_E_USS_10_STATE_COM_VERIFIED_N" 111 "MID_PA_E_USS_10_STATE_OFFSET_N" 110 "MID_PA_E_USS_10_STATE_PROG_N" 109 "MID_PA_E_USS_10_STATE_TYPE_N" 108 "MID_PA_E_USS_11_NO_COM_N" 107 "MID_PA_E_USS_11_OPEN_N" 106 "MID_PA_E_USS_11_RING_TOO_SHORT_N" 105 "MID_PA_E_USS_11_RINGING_TOO_LONG_N" 104 "MID_PA_E_USS_11_SHORT_2_GND_N" 103 "MID_PA_E_USS_11_SHORT_2_USENS_N" 102 "MID_PA_E_USS_11_STATE_COM_VERIFIED_N" 101 "MID_PA_E_USS_11_STATE_OFFSET_N" 100 "MID_PA_E_USS_11_STATE_PROG_N" 99 "MID_PA_E_USS_11_STATE_TYPE_N" 98 "MID_PA_E_USS_12_NO_COM_N" 97 "MID_PA_E_USS_12_OPEN_N" 96 "MID_PA_E_USS_12_RING_TOO_SHORT_N" 95 "MID_PA_E_USS_12_RINGING_TOO_LONG_N" 94 "MID_PA_E_USS_12_SHORT_2_GND_N" 93 "MID_PA_E_USS_12_SHORT_2_USENS_N" 92 "MID_PA_E_USS_12_STATE_COM_VERIFIED_N" 91 "MID_PA_E_USS_12_STATE_OFFSET_N" 90 "MID_PA_E_USS_12_STATE_PROG_N" 89 "MID_PA_E_USS_12_STATE_TYPE_N" 88 "MID_PA_E_USS_13_NO_COM_N" 87 "MID_PA_E_USS_13_OPEN_N" 86 "MID_PA_E_USS_13_RING_TOO_SHORT_N" 85 "MID_PA_E_USS_13_RINGING_TOO_LONG_N" 84 "MID_PA_E_USS_13_SHORT_2_GND_N" 83 "MID_PA_E_USS_13_SHORT_2_USENS_N" 82 "MID_PA_E_USS_13_STATE_COM_VERIFIED_N" 81 "MID_PA_E_USS_13_STATE_OFFSET_N" 80 "MID_PA_E_USS_13_STATE_PROG_N" 79 "MID_PA_E_USS_13_STATE_TYPE_N" 78 "MID_PA_E_SVA_BLOCKED_USS_ML_N" 77 "MID_PA_E_SVA_BLOCKED_USS_MR_N" 76 "MID_PA_E_WHEEL_DIR_FL_INVALID_N" 75 "MID_PA_E_WHEEL_DIR_FR_INVALID_N" 74 "MID_PA_E_WHEEL_DIR_RL_INVALID_N" 73 "MID_PA_E_WHEEL_DIR_RR_INVALID_N" 72 "MID_PA_E_WHEEL_ROTATION_FL_INVALID_N" 71 "MID_PA_E_WHEEL_ROTATION_FR_INVALID_N" 70 "MID_PA_E_WHEEL_ROTATION_RL_INVALID_N" 69 "MID_PA_E_WHEEL_ROTATION_RR_INVALID_N" 68 "MID_PA_E_WICFL_INVALID_N" 67 "MID_PA_E_WICFR_INVALID_N" 66 "MID_PA_E_WICRL_INVALID_N" 65 "MID_PA_E_WICRR_INVALID_N" 64 "MID_PA_E_YAW_RATE_INVALID_N" 63 "MID_PDUR_E_INIT_FAILED_N" 62 "MID_PDUR_E_PDU_INSTANCE_LOST_N" 61 "MID_COMM_E_NET_START_IND_CHANNEL_0_N" 60 "MID_SPI_E_DMA_TRANSFER_N" 59 "MID_SPI_E_RECEIVE_OVERFLOW_N" 58 "MID_SPI_E_TRANSFER_TIMEOUT_N" 57 "MID_PA_E_VEHDYNINTERVENTION_TIMEOUT_N" 56 "MID_TRAILER_HITCH_PRES_INVALID_N" 55 "MID_PA_E_CL15_STATE_INVALID_N" 54 "MID_PA_E_YAW_RATE_SIGN_INVALID_N" 53 "MID_PA_E_ESP_WIC_FRONT_TIMEOUT_N" 52 "MID_PA_E_SEQ_CALL_FAILURE_N" 51 "MID_PA_E_HMI_FUNCACTIVATION_TIMEOUT_N" 50 "MID_PA_E_LOWBEAM_INVALID_N" 49 "MID_PA_E_ENGINESTART_TIMEOUT_N" 48 "MID_ADC_E_VREF_N" 47 "MID_PA_E_ESP_YAW_TIMEOUT_N" 46 "MID_PA_E_TCM_PRG_TIMEOUT_N" 45 "MID_WDG_E_MODE_SWITCH_FAILED_N" 44 "MID_WDG_E_DISABLE_REJECTED_N" 43 "MID_PA_E_ESP_WHEELDIR_TIMEOUT_N" 42 "MID_PA_E_SWCPA_E_INIT_FAILURE_N" 41 "MID_PA_E_DIR_INDICATOR_INVALID_N" 40 "MID_PA_E_ESP_WIC_TIMEOUT_N" 39 "MID_PA_E_EPS_SWA_TIMEOUT_N" 38 "MID_PA_E_INSTRCLUSTER4_TIMEOUT_N" 37 "MID_PA_E_INSTRCLUSTER5_TIMEOUT_N" 36 "MID_PA_E_INSTRCLUSTER3_TIMEOUT_N" 35 "MID_PA_E_INSTRCLUSTER2_TIMEOUT_N" 34 "MID_PA_E_ASIC_WTD_RESET_N" 33 "MID_PA_E_INSTRCLUSTER1_TIMEOUT_N" 32 "MID_PA_E_ASIC_LOW_VOLT_RESET_N" 31 "MID_PA_E_POWERMODE_TIMEOUT_N" 30 "MID_PA_E_ESP_PS_TIMEOUT_N" 29 "MID_PA_E_ESP_WIC_REAR_TIMEOUT_N" 28 "MID_PA_E_TRAILER_ATTACH_INVALID_N" 27 "MID_PA_E_EXTERNAL_EPS_FAILURE_N" 26 "MID_PA_E_PSX_ACTIVATION_INVALID_N" 25 "MID_PA_E_ESP_WHEELVELO_TIMEOUT_N" 24 "MID_PA_E_ESP_LONGACC_TIMEOUT_N" 23 "MID_PA_E_VEH_DYN_INTERVENTION_INVALID_N" 22 "MID_ZPA_E_PS_MODE_INVALID_N" 21 "MID_ZPA_E_EPS_ERROR_INVALID_N" 20 "MID_ZPA_E1_ESP_PSState_INVALID_N" 19 "MID_ZPA_E2_BdaUss01BlindnessDetect_N" 18 "MID_ZPA_E2_BdaUss02BlindnessDetect_N" 17 "MID_ZPA_E2_BdaUss03BlindnessDetect_N" 16 "MID_ZPA_E2_BdaUss10BlindnessDetect_N" 15 "MID_ZPA_E2_BdaUss05BlindnessDetect_N" 14 "MID_ZPA_E2_BdaUss11BlindnessDetect_N" 13 "MID_ZPA_E2_BdaUss07BlindnessDetect_N" 12 "MID_ZPA_E2_BdaUss12BlindnessDetect_N" 11 "MID_ZPA_E2_BdaUss06BlindnessDetect_N" 10 "MID_ZPA_E2_BdaUss08BlindnessDetect_N" 9 "MID_ZPA_E2_BdaUss13BlindnessDetect_N" 8 "MID_ZPA_E2_BdaUss09BlindnessDetect_N" 7 "MID_ZPA_E2_BdaUss04BlindnessDetect_N" 6 "MID_ZPA_E2_BdaUss14BlindnessDetect_N" 5 "MID_FLS_E_READ_FAILED_N" 4 "MID_FLS_E_COMPARE_FAILED_N" 3 "MID_FLS_E_ERASE_FAILED_N" 2 "MID_FLS_E_WRITE_FAILED_N" 1 "MID_NO_FAULT_N" 0 "MID_INVALID" ;
VAL_ 1486 PARK_sw048_subCode 254 "MID_ADC_E_TOUT_N" 253 "MID_ADC_E_INIT_FAILURE_N" 252 "MID_CAN_E_TIMEOUT_N" 251 "MID_CANIF_E_FULL_TX_BUFFER_N" 250 "MID_CANIF_E_INVALID_DLC_N" 249 "MID_CANIF_E_INVALID_TXPDUID_N" 248 "MID_CANIF_E_STOPPED_N" 247 "MID_CANNM_E_CANIF_TRANSMIT_ERROR_N" 246 "MID_CANNM_E_INIT_FAILED_N" 245 "MID_CANNM_E_NETWORK_TIMEOUT_N" 244 "MID_CANSM_E_BUSOFF_NETWORK_N" 243 "MID_CANTP_E_COM_DIAMANT_N" 242 "MID_ECU_E_EEP_DATAFLASH_LAYOUT_N" 241 "MID_ECU_E_RAM_N" 240 "MID_ECU_E_ROM_N" 239 "MID_FEE_E_LAYOUT_FAILED_N" 238 "MID_NVM_E_CONFIG_FAILED_N" 237 "MID_CAN_DASInvalidData_N" 236 "MID_CAN_C_BUSOFF_N" 235 "MID_NVM_E_INTEGRITY_FAILED_N" 234 "MID_NVM_E_REQ_FAILED_N" 233 "MID_PA_E_ASIC_COM_FAILURE_N" 232 "MID_PA_E_ASIC_HW_FAILURE_N" 231 "MID_PA_E_ENGINE_START_INVALID_N" 230 "MID_PA_E_EPS_STATUS_INVALID_N" 229 "MID_PA_E_GEAR_INVALID_N" 228 "MID_PA_E_LONG_ACC_INVALID_N" 227 "MID_PA_E_OUTSIDE_TEMP_INVALID_N" 226 "MID_CAN_EPASInvalidData_N" 225 "MID_PA_E_SPEED_INVALID_N" 224 "MID_PA_E_SVA_BLOCKED_USS_FL_N" 223 "MID_PA_E_SVA_BLOCKED_USS_FR_N" 222 "MID_PA_E_SVA_BLOCKED_USS_RL_N" 221 "MID_PA_E_SVA_BLOCKED_USS_RR_N" 220 "MID_PA_E_SWA_INVALID_N" 219 "MID_PA_E_SWCPA_APT_MONITOR_FAILURE_N" 218 "MID_PA_E_SWCPA_INHIBIT_HSS_PWRLOCK_N" 217 "MID_PA_E_SWCPA_INIT_FAILURE_N" 216 "MID_PA_E_SWCPA_PARFAILURE_N" 215 "MID_CAN_EPBInvalidData_N" 214 "MID_PA_E_UBAT_HIGH_N" 213 "MID_PA_E_UBAT_LOW_N" 212 "MID_PA_E_USENS_OVERTEMPERATURE_N" 211 "MID_PA_E_USENS_OVERVOLTAGE_N" 210 "MID_PA_E_USENS_SHORT_2_GND_N" 209 "MID_PA_E_USENS_SHORT_2_UBAT_N" 208 "MID_PA_E_USENS_UNDERVOLTAGE_N" 207 "MID_PA_E_USS_01_NO_COM_N" 206 "MID_PA_E_USS_01_OPEN_N" 205 "MID_PA_E_USS_01_RING_TOO_SHORT_N" 204 "MID_PA_E_USS_01_RINGING_TOO_LONG_N" 203 "MID_PA_E_USS_01_SHORT_2_GND_N" 202 "MID_PA_E_USS_01_SHORT_2_USENS_N" 201 "MID_PA_E_USS_01_STATE_COM_VERIFIED_N" 200 "MID_PA_E_USS_01_STATE_OFFSET_N" 199 "MID_PA_E_USS_01_STATE_PROG_N" 198 "MID_PA_E_USS_01_STATE_TYPE_N" 197 "MID_PA_E_USS_02_NO_COM_N" 196 "MID_PA_E_USS_02_OPEN_N" 195 "MID_PA_E_USS_02_RING_TOO_SHORT_N" 194 "MID_PA_E_USS_02_RINGING_TOO_LONG_N" 193 "MID_PA_E_USS_02_SHORT_2_GND_N" 192 "MID_PA_E_USS_02_SHORT_2_USENS_N" 191 "MID_PA_E_USS_02_STATE_COM_VERIFIED_N" 190 "MID_PA_E_USS_02_STATE_OFFSET_N" 189 "MID_PA_E_USS_02_STATE_PROG_N" 188 "MID_PA_E_USS_02_STATE_TYPE_N" 187 "MID_PA_E_USS_03_NO_COM_N" 186 "MID_PA_E_USS_03_OPEN_N" 185 "MID_PA_E_USS_03_RING_TOO_SHORT_N" 184 "MID_PA_E_USS_03_RINGING_TOO_LONG_N" 183 "MID_PA_E_USS_03_SHORT_2_GND_N" 182 "MID_PA_E_USS_03_SHORT_2_USENS_N" 181 "MID_PA_E_USS_03_STATE_COM_VERIFIED_N" 180 "MID_PA_E_USS_03_STATE_OFFSET_N" 179 "MID_PA_E_USS_03_STATE_PROG_N" 178 "MID_PA_E_USS_03_STATE_TYPE_N" 177 "MID_PA_E_USS_04_NO_COM_N" 176 "MID_PA_E_USS_04_OPEN_N" 175 "MID_PA_E_USS_04_RING_TOO_SHORT_N" 174 "MID_PA_E_USS_04_RINGING_TOO_LONG_N" 173 "MID_PA_E_USS_04_SHORT_2_GND_N" 172 "MID_PA_E_USS_04_SHORT_2_USENS_N" 171 "MID_PA_E_USS_04_STATE_COM_VERIFIED_N" 170 "MID_PA_E_USS_04_STATE_OFFSET_N" 169 "MID_PA_E_USS_04_STATE_PROG_N" 168 "MID_PA_E_USS_04_STATE_TYPE_N" 167 "MID_PA_E_USS_05_NO_COM_N" 166 "MID_PA_E_USS_05_OPEN_N" 165 "MID_PA_E_USS_05_RING_TOO_SHORT_N" 164 "MID_PA_E_USS_05_RINGING_TOO_LONG_N" 163 "MID_PA_E_USS_05_SHORT_2_GND_N" 162 "MID_PA_E_USS_05_SHORT_2_USENS_N" 161 "MID_PA_E_USS_05_STATE_COM_VERIFIED_N" 160 "MID_PA_E_USS_05_STATE_OFFSET_N" 159 "MID_PA_E_USS_05_STATE_PROG_N" 158 "MID_PA_E_USS_05_STATE_TYPE_N" 157 "MID_PA_E_USS_06_NO_COM_N" 156 "MID_PA_E_USS_06_OPEN_N" 155 "MID_PA_E_USS_06_RING_TOO_SHORT_N" 154 "MID_PA_E_USS_06_RINGING_TOO_LONG_N" 153 "MID_PA_E_USS_06_SHORT_2_GND_N" 152 "MID_PA_E_USS_06_SHORT_2_USENS_N" 151 "MID_PA_E_USS_06_STATE_COM_VERIFIED_N" 150 "MID_PA_E_USS_06_STATE_OFFSET_N" 149 "MID_PA_E_USS_06_STATE_PROG_N" 148 "MID_PA_E_USS_06_STATE_TYPE_N" 147 "MID_CAN_ESPInvalidData_N" 146 "MID_CAN_GTWInvalidData_N" 145 "MID_CAN_SCCMInvalidData_N" 144 "MID_CAN_DASLossOfCommunication_N" 143 "MID_CAN_EPASLossOfCommunication_N" 142 "MID_CAN_EPBLossOfCommunication_N" 141 "MID_CAN_ESPLossOfCommunication_N" 140 "MID_CAN_GTWLossOfCommunication_N" 139 "MID_CAN_SCCMLossOfCommunication_N" 138 "MID_PA_E_USS_08_NO_COM_N" 137 "MID_PA_E_USS_08_OPEN_N" 136 "MID_PA_E_USS_08_RING_TOO_SHORT_N" 135 "MID_PA_E_USS_08_RINGING_TOO_LONG_N" 134 "MID_PA_E_USS_08_SHORT_2_GND_N" 133 "MID_PA_E_USS_08_SHORT_2_USENS_N" 132 "MID_PA_E_USS_08_STATE_COM_VERIFIED_N" 131 "MID_PA_E_USS_08_STATE_OFFSET_N" 130 "MID_PA_E_USS_08_STATE_PROG_N" 129 "MID_PA_E_USS_08_STATE_TYPE_N" 128 "MID_PA_E_USS_09_NO_COM_N" 127 "MID_PA_E_USS_09_OPEN_N" 126 "MID_PA_E_USS_09_RING_TOO_SHORT_N" 125 "MID_PA_E_USS_09_RINGING_TOO_LONG_N" 124 "MID_PA_E_USS_09_SHORT_2_GND_N" 123 "MID_PA_E_USS_09_SHORT_2_USENS_N" 122 "MID_PA_E_USS_09_STATE_COM_VERIFIED_N" 121 "MID_PA_E_USS_09_STATE_OFFSET_N" 120 "MID_PA_E_USS_09_STATE_PROG_N" 119 "MID_PA_E_USS_09_STATE_TYPE_N" 118 "MID_PA_E_USS_10_NO_COM_N" 117 "MID_PA_E_USS_10_OPEN_N" 116 "MID_PA_E_USS_10_RING_TOO_SHORT_N" 115 "MID_PA_E_USS_10_RINGING_TOO_LONG_N" 114 "MID_PA_E_USS_10_SHORT_2_GND_N" 113 "MID_PA_E_USS_10_SHORT_2_USENS_N" 112 "MID_PA_E_USS_10_STATE_COM_VERIFIED_N" 111 "MID_PA_E_USS_10_STATE_OFFSET_N" 110 "MID_PA_E_USS_10_STATE_PROG_N" 109 "MID_PA_E_USS_10_STATE_TYPE_N" 108 "MID_PA_E_USS_11_NO_COM_N" 107 "MID_PA_E_USS_11_OPEN_N" 106 "MID_PA_E_USS_11_RING_TOO_SHORT_N" 105 "MID_PA_E_USS_11_RINGING_TOO_LONG_N" 104 "MID_PA_E_USS_11_SHORT_2_GND_N" 103 "MID_PA_E_USS_11_SHORT_2_USENS_N" 102 "MID_PA_E_USS_11_STATE_COM_VERIFIED_N" 101 "MID_PA_E_USS_11_STATE_OFFSET_N" 100 "MID_PA_E_USS_11_STATE_PROG_N" 99 "MID_PA_E_USS_11_STATE_TYPE_N" 98 "MID_PA_E_USS_12_NO_COM_N" 97 "MID_PA_E_USS_12_OPEN_N" 96 "MID_PA_E_USS_12_RING_TOO_SHORT_N" 95 "MID_PA_E_USS_12_RINGING_TOO_LONG_N" 94 "MID_PA_E_USS_12_SHORT_2_GND_N" 93 "MID_PA_E_USS_12_SHORT_2_USENS_N" 92 "MID_PA_E_USS_12_STATE_COM_VERIFIED_N" 91 "MID_PA_E_USS_12_STATE_OFFSET_N" 90 "MID_PA_E_USS_12_STATE_PROG_N" 89 "MID_PA_E_USS_12_STATE_TYPE_N" 88 "MID_PA_E_USS_13_NO_COM_N" 87 "MID_PA_E_USS_13_OPEN_N" 86 "MID_PA_E_USS_13_RING_TOO_SHORT_N" 85 "MID_PA_E_USS_13_RINGING_TOO_LONG_N" 84 "MID_PA_E_USS_13_SHORT_2_GND_N" 83 "MID_PA_E_USS_13_SHORT_2_USENS_N" 82 "MID_PA_E_USS_13_STATE_COM_VERIFIED_N" 81 "MID_PA_E_USS_13_STATE_OFFSET_N" 80 "MID_PA_E_USS_13_STATE_PROG_N" 79 "MID_PA_E_USS_13_STATE_TYPE_N" 78 "MID_PA_E_SVA_BLOCKED_USS_ML_N" 77 "MID_PA_E_SVA_BLOCKED_USS_MR_N" 76 "MID_PA_E_WHEEL_DIR_FL_INVALID_N" 75 "MID_PA_E_WHEEL_DIR_FR_INVALID_N" 74 "MID_PA_E_WHEEL_DIR_RL_INVALID_N" 73 "MID_PA_E_WHEEL_DIR_RR_INVALID_N" 72 "MID_PA_E_WHEEL_ROTATION_FL_INVALID_N" 71 "MID_PA_E_WHEEL_ROTATION_FR_INVALID_N" 70 "MID_PA_E_WHEEL_ROTATION_RL_INVALID_N" 69 "MID_PA_E_WHEEL_ROTATION_RR_INVALID_N" 68 "MID_PA_E_WICFL_INVALID_N" 67 "MID_PA_E_WICFR_INVALID_N" 66 "MID_PA_E_WICRL_INVALID_N" 65 "MID_PA_E_WICRR_INVALID_N" 64 "MID_PA_E_YAW_RATE_INVALID_N" 63 "MID_PDUR_E_INIT_FAILED_N" 62 "MID_PDUR_E_PDU_INSTANCE_LOST_N" 61 "MID_COMM_E_NET_START_IND_CHANNEL_0_N" 60 "MID_SPI_E_DMA_TRANSFER_N" 59 "MID_SPI_E_RECEIVE_OVERFLOW_N" 58 "MID_SPI_E_TRANSFER_TIMEOUT_N" 57 "MID_PA_E_VEHDYNINTERVENTION_TIMEOUT_N" 56 "MID_TRAILER_HITCH_PRES_INVALID_N" 55 "MID_PA_E_CL15_STATE_INVALID_N" 54 "MID_PA_E_YAW_RATE_SIGN_INVALID_N" 53 "MID_PA_E_ESP_WIC_FRONT_TIMEOUT_N" 52 "MID_PA_E_SEQ_CALL_FAILURE_N" 51 "MID_PA_E_HMI_FUNCACTIVATION_TIMEOUT_N" 50 "MID_PA_E_LOWBEAM_INVALID_N" 49 "MID_PA_E_ENGINESTART_TIMEOUT_N" 48 "MID_ADC_E_VREF_N" 47 "MID_PA_E_ESP_YAW_TIMEOUT_N" 46 "MID_PA_E_TCM_PRG_TIMEOUT_N" 45 "MID_WDG_E_MODE_SWITCH_FAILED_N" 44 "MID_WDG_E_DISABLE_REJECTED_N" 43 "MID_PA_E_ESP_WHEELDIR_TIMEOUT_N" 42 "MID_PA_E_SWCPA_E_INIT_FAILURE_N" 41 "MID_PA_E_DIR_INDICATOR_INVALID_N" 40 "MID_PA_E_ESP_WIC_TIMEOUT_N" 39 "MID_PA_E_EPS_SWA_TIMEOUT_N" 38 "MID_PA_E_INSTRCLUSTER4_TIMEOUT_N" 37 "MID_PA_E_INSTRCLUSTER5_TIMEOUT_N" 36 "MID_PA_E_INSTRCLUSTER3_TIMEOUT_N" 35 "MID_PA_E_INSTRCLUSTER2_TIMEOUT_N" 34 "MID_PA_E_ASIC_WTD_RESET_N" 33 "MID_PA_E_INSTRCLUSTER1_TIMEOUT_N" 32 "MID_PA_E_ASIC_LOW_VOLT_RESET_N" 31 "MID_PA_E_POWERMODE_TIMEOUT_N" 30 "MID_PA_E_ESP_PS_TIMEOUT_N" 29 "MID_PA_E_ESP_WIC_REAR_TIMEOUT_N" 28 "MID_PA_E_TRAILER_ATTACH_INVALID_N" 27 "MID_PA_E_EXTERNAL_EPS_FAILURE_N" 26 "MID_PA_E_PSX_ACTIVATION_INVALID_N" 25 "MID_PA_E_ESP_WHEELVELO_TIMEOUT_N" 24 "MID_PA_E_ESP_LONGACC_TIMEOUT_N" 23 "MID_PA_E_VEH_DYN_INTERVENTION_INVALID_N" 22 "MID_ZPA_E_PS_MODE_INVALID_N" 21 "MID_ZPA_E_EPS_ERROR_INVALID_N" 20 "MID_ZPA_E1_ESP_PSState_INVALID_N" 19 "MID_ZPA_E2_BdaUss01BlindnessDetect_N" 18 "MID_ZPA_E2_BdaUss02BlindnessDetect_N" 17 "MID_ZPA_E2_BdaUss03BlindnessDetect_N" 16 "MID_ZPA_E2_BdaUss10BlindnessDetect_N" 15 "MID_ZPA_E2_BdaUss05BlindnessDetect_N" 14 "MID_ZPA_E2_BdaUss11BlindnessDetect_N" 13 "MID_ZPA_E2_BdaUss07BlindnessDetect_N" 12 "MID_ZPA_E2_BdaUss12BlindnessDetect_N" 11 "MID_ZPA_E2_BdaUss06BlindnessDetect_N" 10 "MID_ZPA_E2_BdaUss08BlindnessDetect_N" 9 "MID_ZPA_E2_BdaUss13BlindnessDetect_N" 8 "MID_ZPA_E2_BdaUss09BlindnessDetect_N" 7 "MID_ZPA_E2_BdaUss04BlindnessDetect_N" 6 "MID_ZPA_E2_BdaUss14BlindnessDetect_N" 5 "MID_FLS_E_READ_FAILED_N" 4 "MID_FLS_E_COMPARE_FAILED_N" 3 "MID_FLS_E_ERASE_FAILED_N" 2 "MID_FLS_E_WRITE_FAILED_N" 1 "MID_NO_FAULT_N" 0 "MID_INVALID" ;
VAL_ 1486 PARK_sw049_subCode 254 "MID_ADC_E_TOUT_N" 253 "MID_ADC_E_INIT_FAILURE_N" 252 "MID_CAN_E_TIMEOUT_N" 251 "MID_CANIF_E_FULL_TX_BUFFER_N" 250 "MID_CANIF_E_INVALID_DLC_N" 249 "MID_CANIF_E_INVALID_TXPDUID_N" 248 "MID_CANIF_E_STOPPED_N" 247 "MID_CANNM_E_CANIF_TRANSMIT_ERROR_N" 246 "MID_CANNM_E_INIT_FAILED_N" 245 "MID_CANNM_E_NETWORK_TIMEOUT_N" 244 "MID_CANSM_E_BUSOFF_NETWORK_N" 243 "MID_CANTP_E_COM_DIAMANT_N" 242 "MID_ECU_E_EEP_DATAFLASH_LAYOUT_N" 241 "MID_ECU_E_RAM_N" 240 "MID_ECU_E_ROM_N" 239 "MID_FEE_E_LAYOUT_FAILED_N" 238 "MID_NVM_E_CONFIG_FAILED_N" 237 "MID_CAN_DASInvalidData_N" 236 "MID_CAN_C_BUSOFF_N" 235 "MID_NVM_E_INTEGRITY_FAILED_N" 234 "MID_NVM_E_REQ_FAILED_N" 233 "MID_PA_E_ASIC_COM_FAILURE_N" 232 "MID_PA_E_ASIC_HW_FAILURE_N" 231 "MID_PA_E_ENGINE_START_INVALID_N" 230 "MID_PA_E_EPS_STATUS_INVALID_N" 229 "MID_PA_E_GEAR_INVALID_N" 228 "MID_PA_E_LONG_ACC_INVALID_N" 227 "MID_PA_E_OUTSIDE_TEMP_INVALID_N" 226 "MID_CAN_EPASInvalidData_N" 225 "MID_PA_E_SPEED_INVALID_N" 224 "MID_PA_E_SVA_BLOCKED_USS_FL_N" 223 "MID_PA_E_SVA_BLOCKED_USS_FR_N" 222 "MID_PA_E_SVA_BLOCKED_USS_RL_N" 221 "MID_PA_E_SVA_BLOCKED_USS_RR_N" 220 "MID_PA_E_SWA_INVALID_N" 219 "MID_PA_E_SWCPA_APT_MONITOR_FAILURE_N" 218 "MID_PA_E_SWCPA_INHIBIT_HSS_PWRLOCK_N" 217 "MID_PA_E_SWCPA_INIT_FAILURE_N" 216 "MID_PA_E_SWCPA_PARFAILURE_N" 215 "MID_CAN_EPBInvalidData_N" 214 "MID_PA_E_UBAT_HIGH_N" 213 "MID_PA_E_UBAT_LOW_N" 212 "MID_PA_E_USENS_OVERTEMPERATURE_N" 211 "MID_PA_E_USENS_OVERVOLTAGE_N" 210 "MID_PA_E_USENS_SHORT_2_GND_N" 209 "MID_PA_E_USENS_SHORT_2_UBAT_N" 208 "MID_PA_E_USENS_UNDERVOLTAGE_N" 207 "MID_PA_E_USS_01_NO_COM_N" 206 "MID_PA_E_USS_01_OPEN_N" 205 "MID_PA_E_USS_01_RING_TOO_SHORT_N" 204 "MID_PA_E_USS_01_RINGING_TOO_LONG_N" 203 "MID_PA_E_USS_01_SHORT_2_GND_N" 202 "MID_PA_E_USS_01_SHORT_2_USENS_N" 201 "MID_PA_E_USS_01_STATE_COM_VERIFIED_N" 200 "MID_PA_E_USS_01_STATE_OFFSET_N" 199 "MID_PA_E_USS_01_STATE_PROG_N" 198 "MID_PA_E_USS_01_STATE_TYPE_N" 197 "MID_PA_E_USS_02_NO_COM_N" 196 "MID_PA_E_USS_02_OPEN_N" 195 "MID_PA_E_USS_02_RING_TOO_SHORT_N" 194 "MID_PA_E_USS_02_RINGING_TOO_LONG_N" 193 "MID_PA_E_USS_02_SHORT_2_GND_N" 192 "MID_PA_E_USS_02_SHORT_2_USENS_N" 191 "MID_PA_E_USS_02_STATE_COM_VERIFIED_N" 190 "MID_PA_E_USS_02_STATE_OFFSET_N" 189 "MID_PA_E_USS_02_STATE_PROG_N" 188 "MID_PA_E_USS_02_STATE_TYPE_N" 187 "MID_PA_E_USS_03_NO_COM_N" 186 "MID_PA_E_USS_03_OPEN_N" 185 "MID_PA_E_USS_03_RING_TOO_SHORT_N" 184 "MID_PA_E_USS_03_RINGING_TOO_LONG_N" 183 "MID_PA_E_USS_03_SHORT_2_GND_N" 182 "MID_PA_E_USS_03_SHORT_2_USENS_N" 181 "MID_PA_E_USS_03_STATE_COM_VERIFIED_N" 180 "MID_PA_E_USS_03_STATE_OFFSET_N" 179 "MID_PA_E_USS_03_STATE_PROG_N" 178 "MID_PA_E_USS_03_STATE_TYPE_N" 177 "MID_PA_E_USS_04_NO_COM_N" 176 "MID_PA_E_USS_04_OPEN_N" 175 "MID_PA_E_USS_04_RING_TOO_SHORT_N" 174 "MID_PA_E_USS_04_RINGING_TOO_LONG_N" 173 "MID_PA_E_USS_04_SHORT_2_GND_N" 172 "MID_PA_E_USS_04_SHORT_2_USENS_N" 171 "MID_PA_E_USS_04_STATE_COM_VERIFIED_N" 170 "MID_PA_E_USS_04_STATE_OFFSET_N" 169 "MID_PA_E_USS_04_STATE_PROG_N" 168 "MID_PA_E_USS_04_STATE_TYPE_N" 167 "MID_PA_E_USS_05_NO_COM_N" 166 "MID_PA_E_USS_05_OPEN_N" 165 "MID_PA_E_USS_05_RING_TOO_SHORT_N" 164 "MID_PA_E_USS_05_RINGING_TOO_LONG_N" 163 "MID_PA_E_USS_05_SHORT_2_GND_N" 162 "MID_PA_E_USS_05_SHORT_2_USENS_N" 161 "MID_PA_E_USS_05_STATE_COM_VERIFIED_N" 160 "MID_PA_E_USS_05_STATE_OFFSET_N" 159 "MID_PA_E_USS_05_STATE_PROG_N" 158 "MID_PA_E_USS_05_STATE_TYPE_N" 157 "MID_PA_E_USS_06_NO_COM_N" 156 "MID_PA_E_USS_06_OPEN_N" 155 "MID_PA_E_USS_06_RING_TOO_SHORT_N" 154 "MID_PA_E_USS_06_RINGING_TOO_LONG_N" 153 "MID_PA_E_USS_06_SHORT_2_GND_N" 152 "MID_PA_E_USS_06_SHORT_2_USENS_N" 151 "MID_PA_E_USS_06_STATE_COM_VERIFIED_N" 150 "MID_PA_E_USS_06_STATE_OFFSET_N" 149 "MID_PA_E_USS_06_STATE_PROG_N" 148 "MID_PA_E_USS_06_STATE_TYPE_N" 147 "MID_CAN_ESPInvalidData_N" 146 "MID_CAN_GTWInvalidData_N" 145 "MID_CAN_SCCMInvalidData_N" 144 "MID_CAN_DASLossOfCommunication_N" 143 "MID_CAN_EPASLossOfCommunication_N" 142 "MID_CAN_EPBLossOfCommunication_N" 141 "MID_CAN_ESPLossOfCommunication_N" 140 "MID_CAN_GTWLossOfCommunication_N" 139 "MID_CAN_SCCMLossOfCommunication_N" 138 "MID_PA_E_USS_08_NO_COM_N" 137 "MID_PA_E_USS_08_OPEN_N" 136 "MID_PA_E_USS_08_RING_TOO_SHORT_N" 135 "MID_PA_E_USS_08_RINGING_TOO_LONG_N" 134 "MID_PA_E_USS_08_SHORT_2_GND_N" 133 "MID_PA_E_USS_08_SHORT_2_USENS_N" 132 "MID_PA_E_USS_08_STATE_COM_VERIFIED_N" 131 "MID_PA_E_USS_08_STATE_OFFSET_N" 130 "MID_PA_E_USS_08_STATE_PROG_N" 129 "MID_PA_E_USS_08_STATE_TYPE_N" 128 "MID_PA_E_USS_09_NO_COM_N" 127 "MID_PA_E_USS_09_OPEN_N" 126 "MID_PA_E_USS_09_RING_TOO_SHORT_N" 125 "MID_PA_E_USS_09_RINGING_TOO_LONG_N" 124 "MID_PA_E_USS_09_SHORT_2_GND_N" 123 "MID_PA_E_USS_09_SHORT_2_USENS_N" 122 "MID_PA_E_USS_09_STATE_COM_VERIFIED_N" 121 "MID_PA_E_USS_09_STATE_OFFSET_N" 120 "MID_PA_E_USS_09_STATE_PROG_N" 119 "MID_PA_E_USS_09_STATE_TYPE_N" 118 "MID_PA_E_USS_10_NO_COM_N" 117 "MID_PA_E_USS_10_OPEN_N" 116 "MID_PA_E_USS_10_RING_TOO_SHORT_N" 115 "MID_PA_E_USS_10_RINGING_TOO_LONG_N" 114 "MID_PA_E_USS_10_SHORT_2_GND_N" 113 "MID_PA_E_USS_10_SHORT_2_USENS_N" 112 "MID_PA_E_USS_10_STATE_COM_VERIFIED_N" 111 "MID_PA_E_USS_10_STATE_OFFSET_N" 110 "MID_PA_E_USS_10_STATE_PROG_N" 109 "MID_PA_E_USS_10_STATE_TYPE_N" 108 "MID_PA_E_USS_11_NO_COM_N" 107 "MID_PA_E_USS_11_OPEN_N" 106 "MID_PA_E_USS_11_RING_TOO_SHORT_N" 105 "MID_PA_E_USS_11_RINGING_TOO_LONG_N" 104 "MID_PA_E_USS_11_SHORT_2_GND_N" 103 "MID_PA_E_USS_11_SHORT_2_USENS_N" 102 "MID_PA_E_USS_11_STATE_COM_VERIFIED_N" 101 "MID_PA_E_USS_11_STATE_OFFSET_N" 100 "MID_PA_E_USS_11_STATE_PROG_N" 99 "MID_PA_E_USS_11_STATE_TYPE_N" 98 "MID_PA_E_USS_12_NO_COM_N" 97 "MID_PA_E_USS_12_OPEN_N" 96 "MID_PA_E_USS_12_RING_TOO_SHORT_N" 95 "MID_PA_E_USS_12_RINGING_TOO_LONG_N" 94 "MID_PA_E_USS_12_SHORT_2_GND_N" 93 "MID_PA_E_USS_12_SHORT_2_USENS_N" 92 "MID_PA_E_USS_12_STATE_COM_VERIFIED_N" 91 "MID_PA_E_USS_12_STATE_OFFSET_N" 90 "MID_PA_E_USS_12_STATE_PROG_N" 89 "MID_PA_E_USS_12_STATE_TYPE_N" 88 "MID_PA_E_USS_13_NO_COM_N" 87 "MID_PA_E_USS_13_OPEN_N" 86 "MID_PA_E_USS_13_RING_TOO_SHORT_N" 85 "MID_PA_E_USS_13_RINGING_TOO_LONG_N" 84 "MID_PA_E_USS_13_SHORT_2_GND_N" 83 "MID_PA_E_USS_13_SHORT_2_USENS_N" 82 "MID_PA_E_USS_13_STATE_COM_VERIFIED_N" 81 "MID_PA_E_USS_13_STATE_OFFSET_N" 80 "MID_PA_E_USS_13_STATE_PROG_N" 79 "MID_PA_E_USS_13_STATE_TYPE_N" 78 "MID_PA_E_SVA_BLOCKED_USS_ML_N" 77 "MID_PA_E_SVA_BLOCKED_USS_MR_N" 76 "MID_PA_E_WHEEL_DIR_FL_INVALID_N" 75 "MID_PA_E_WHEEL_DIR_FR_INVALID_N" 74 "MID_PA_E_WHEEL_DIR_RL_INVALID_N" 73 "MID_PA_E_WHEEL_DIR_RR_INVALID_N" 72 "MID_PA_E_WHEEL_ROTATION_FL_INVALID_N" 71 "MID_PA_E_WHEEL_ROTATION_FR_INVALID_N" 70 "MID_PA_E_WHEEL_ROTATION_RL_INVALID_N" 69 "MID_PA_E_WHEEL_ROTATION_RR_INVALID_N" 68 "MID_PA_E_WICFL_INVALID_N" 67 "MID_PA_E_WICFR_INVALID_N" 66 "MID_PA_E_WICRL_INVALID_N" 65 "MID_PA_E_WICRR_INVALID_N" 64 "MID_PA_E_YAW_RATE_INVALID_N" 63 "MID_PDUR_E_INIT_FAILED_N" 62 "MID_PDUR_E_PDU_INSTANCE_LOST_N" 61 "MID_COMM_E_NET_START_IND_CHANNEL_0_N" 60 "MID_SPI_E_DMA_TRANSFER_N" 59 "MID_SPI_E_RECEIVE_OVERFLOW_N" 58 "MID_SPI_E_TRANSFER_TIMEOUT_N" 57 "MID_PA_E_VEHDYNINTERVENTION_TIMEOUT_N" 56 "MID_TRAILER_HITCH_PRES_INVALID_N" 55 "MID_PA_E_CL15_STATE_INVALID_N" 54 "MID_PA_E_YAW_RATE_SIGN_INVALID_N" 53 "MID_PA_E_ESP_WIC_FRONT_TIMEOUT_N" 52 "MID_PA_E_SEQ_CALL_FAILURE_N" 51 "MID_PA_E_HMI_FUNCACTIVATION_TIMEOUT_N" 50 "MID_PA_E_LOWBEAM_INVALID_N" 49 "MID_PA_E_ENGINESTART_TIMEOUT_N" 48 "MID_ADC_E_VREF_N" 47 "MID_PA_E_ESP_YAW_TIMEOUT_N" 46 "MID_PA_E_TCM_PRG_TIMEOUT_N" 45 "MID_WDG_E_MODE_SWITCH_FAILED_N" 44 "MID_WDG_E_DISABLE_REJECTED_N" 43 "MID_PA_E_ESP_WHEELDIR_TIMEOUT_N" 42 "MID_PA_E_SWCPA_E_INIT_FAILURE_N" 41 "MID_PA_E_DIR_INDICATOR_INVALID_N" 40 "MID_PA_E_ESP_WIC_TIMEOUT_N" 39 "MID_PA_E_EPS_SWA_TIMEOUT_N" 38 "MID_PA_E_INSTRCLUSTER4_TIMEOUT_N" 37 "MID_PA_E_INSTRCLUSTER5_TIMEOUT_N" 36 "MID_PA_E_INSTRCLUSTER3_TIMEOUT_N" 35 "MID_PA_E_INSTRCLUSTER2_TIMEOUT_N" 34 "MID_PA_E_ASIC_WTD_RESET_N" 33 "MID_PA_E_INSTRCLUSTER1_TIMEOUT_N" 32 "MID_PA_E_ASIC_LOW_VOLT_RESET_N" 31 "MID_PA_E_POWERMODE_TIMEOUT_N" 30 "MID_PA_E_ESP_PS_TIMEOUT_N" 29 "MID_PA_E_ESP_WIC_REAR_TIMEOUT_N" 28 "MID_PA_E_TRAILER_ATTACH_INVALID_N" 27 "MID_PA_E_EXTERNAL_EPS_FAILURE_N" 26 "MID_PA_E_PSX_ACTIVATION_INVALID_N" 25 "MID_PA_E_ESP_WHEELVELO_TIMEOUT_N" 24 "MID_PA_E_ESP_LONGACC_TIMEOUT_N" 23 "MID_PA_E_VEH_DYN_INTERVENTION_INVALID_N" 22 "MID_ZPA_E_PS_MODE_INVALID_N" 21 "MID_ZPA_E_EPS_ERROR_INVALID_N" 20 "MID_ZPA_E1_ESP_PSState_INVALID_N" 19 "MID_ZPA_E2_BdaUss01BlindnessDetect_N" 18 "MID_ZPA_E2_BdaUss02BlindnessDetect_N" 17 "MID_ZPA_E2_BdaUss03BlindnessDetect_N" 16 "MID_ZPA_E2_BdaUss10BlindnessDetect_N" 15 "MID_ZPA_E2_BdaUss05BlindnessDetect_N" 14 "MID_ZPA_E2_BdaUss11BlindnessDetect_N" 13 "MID_ZPA_E2_BdaUss07BlindnessDetect_N" 12 "MID_ZPA_E2_BdaUss12BlindnessDetect_N" 11 "MID_ZPA_E2_BdaUss06BlindnessDetect_N" 10 "MID_ZPA_E2_BdaUss08BlindnessDetect_N" 9 "MID_ZPA_E2_BdaUss13BlindnessDetect_N" 8 "MID_ZPA_E2_BdaUss09BlindnessDetect_N" 7 "MID_ZPA_E2_BdaUss04BlindnessDetect_N" 6 "MID_ZPA_E2_BdaUss14BlindnessDetect_N" 5 "MID_FLS_E_READ_FAILED_N" 4 "MID_FLS_E_COMPARE_FAILED_N" 3 "MID_FLS_E_ERASE_FAILED_N" 2 "MID_FLS_E_WRITE_FAILED_N" 1 "MID_NO_FAULT_N" 0 "MID_INVALID" ;
VAL_ 1486 PARK_sw050_subCode 254 "MID_ADC_E_TOUT_N" 253 "MID_ADC_E_INIT_FAILURE_N" 252 "MID_CAN_E_TIMEOUT_N" 251 "MID_CANIF_E_FULL_TX_BUFFER_N" 250 "MID_CANIF_E_INVALID_DLC_N" 249 "MID_CANIF_E_INVALID_TXPDUID_N" 248 "MID_CANIF_E_STOPPED_N" 247 "MID_CANNM_E_CANIF_TRANSMIT_ERROR_N" 246 "MID_CANNM_E_INIT_FAILED_N" 245 "MID_CANNM_E_NETWORK_TIMEOUT_N" 244 "MID_CANSM_E_BUSOFF_NETWORK_N" 243 "MID_CANTP_E_COM_DIAMANT_N" 242 "MID_ECU_E_EEP_DATAFLASH_LAYOUT_N" 241 "MID_ECU_E_RAM_N" 240 "MID_ECU_E_ROM_N" 239 "MID_FEE_E_LAYOUT_FAILED_N" 238 "MID_NVM_E_CONFIG_FAILED_N" 237 "MID_CAN_DASInvalidData_N" 236 "MID_CAN_C_BUSOFF_N" 235 "MID_NVM_E_INTEGRITY_FAILED_N" 234 "MID_NVM_E_REQ_FAILED_N" 233 "MID_PA_E_ASIC_COM_FAILURE_N" 232 "MID_PA_E_ASIC_HW_FAILURE_N" 231 "MID_PA_E_ENGINE_START_INVALID_N" 230 "MID_PA_E_EPS_STATUS_INVALID_N" 229 "MID_PA_E_GEAR_INVALID_N" 228 "MID_PA_E_LONG_ACC_INVALID_N" 227 "MID_PA_E_OUTSIDE_TEMP_INVALID_N" 226 "MID_CAN_EPASInvalidData_N" 225 "MID_PA_E_SPEED_INVALID_N" 224 "MID_PA_E_SVA_BLOCKED_USS_FL_N" 223 "MID_PA_E_SVA_BLOCKED_USS_FR_N" 222 "MID_PA_E_SVA_BLOCKED_USS_RL_N" 221 "MID_PA_E_SVA_BLOCKED_USS_RR_N" 220 "MID_PA_E_SWA_INVALID_N" 219 "MID_PA_E_SWCPA_APT_MONITOR_FAILURE_N" 218 "MID_PA_E_SWCPA_INHIBIT_HSS_PWRLOCK_N" 217 "MID_PA_E_SWCPA_INIT_FAILURE_N" 216 "MID_PA_E_SWCPA_PARFAILURE_N" 215 "MID_CAN_EPBInvalidData_N" 214 "MID_PA_E_UBAT_HIGH_N" 213 "MID_PA_E_UBAT_LOW_N" 212 "MID_PA_E_USENS_OVERTEMPERATURE_N" 211 "MID_PA_E_USENS_OVERVOLTAGE_N" 210 "MID_PA_E_USENS_SHORT_2_GND_N" 209 "MID_PA_E_USENS_SHORT_2_UBAT_N" 208 "MID_PA_E_USENS_UNDERVOLTAGE_N" 207 "MID_PA_E_USS_01_NO_COM_N" 206 "MID_PA_E_USS_01_OPEN_N" 205 "MID_PA_E_USS_01_RING_TOO_SHORT_N" 204 "MID_PA_E_USS_01_RINGING_TOO_LONG_N" 203 "MID_PA_E_USS_01_SHORT_2_GND_N" 202 "MID_PA_E_USS_01_SHORT_2_USENS_N" 201 "MID_PA_E_USS_01_STATE_COM_VERIFIED_N" 200 "MID_PA_E_USS_01_STATE_OFFSET_N" 199 "MID_PA_E_USS_01_STATE_PROG_N" 198 "MID_PA_E_USS_01_STATE_TYPE_N" 197 "MID_PA_E_USS_02_NO_COM_N" 196 "MID_PA_E_USS_02_OPEN_N" 195 "MID_PA_E_USS_02_RING_TOO_SHORT_N" 194 "MID_PA_E_USS_02_RINGING_TOO_LONG_N" 193 "MID_PA_E_USS_02_SHORT_2_GND_N" 192 "MID_PA_E_USS_02_SHORT_2_USENS_N" 191 "MID_PA_E_USS_02_STATE_COM_VERIFIED_N" 190 "MID_PA_E_USS_02_STATE_OFFSET_N" 189 "MID_PA_E_USS_02_STATE_PROG_N" 188 "MID_PA_E_USS_02_STATE_TYPE_N" 187 "MID_PA_E_USS_03_NO_COM_N" 186 "MID_PA_E_USS_03_OPEN_N" 185 "MID_PA_E_USS_03_RING_TOO_SHORT_N" 184 "MID_PA_E_USS_03_RINGING_TOO_LONG_N" 183 "MID_PA_E_USS_03_SHORT_2_GND_N" 182 "MID_PA_E_USS_03_SHORT_2_USENS_N" 181 "MID_PA_E_USS_03_STATE_COM_VERIFIED_N" 180 "MID_PA_E_USS_03_STATE_OFFSET_N" 179 "MID_PA_E_USS_03_STATE_PROG_N" 178 "MID_PA_E_USS_03_STATE_TYPE_N" 177 "MID_PA_E_USS_04_NO_COM_N" 176 "MID_PA_E_USS_04_OPEN_N" 175 "MID_PA_E_USS_04_RING_TOO_SHORT_N" 174 "MID_PA_E_USS_04_RINGING_TOO_LONG_N" 173 "MID_PA_E_USS_04_SHORT_2_GND_N" 172 "MID_PA_E_USS_04_SHORT_2_USENS_N" 171 "MID_PA_E_USS_04_STATE_COM_VERIFIED_N" 170 "MID_PA_E_USS_04_STATE_OFFSET_N" 169 "MID_PA_E_USS_04_STATE_PROG_N" 168 "MID_PA_E_USS_04_STATE_TYPE_N" 167 "MID_PA_E_USS_05_NO_COM_N" 166 "MID_PA_E_USS_05_OPEN_N" 165 "MID_PA_E_USS_05_RING_TOO_SHORT_N" 164 "MID_PA_E_USS_05_RINGING_TOO_LONG_N" 163 "MID_PA_E_USS_05_SHORT_2_GND_N" 162 "MID_PA_E_USS_05_SHORT_2_USENS_N" 161 "MID_PA_E_USS_05_STATE_COM_VERIFIED_N" 160 "MID_PA_E_USS_05_STATE_OFFSET_N" 159 "MID_PA_E_USS_05_STATE_PROG_N" 158 "MID_PA_E_USS_05_STATE_TYPE_N" 157 "MID_PA_E_USS_06_NO_COM_N" 156 "MID_PA_E_USS_06_OPEN_N" 155 "MID_PA_E_USS_06_RING_TOO_SHORT_N" 154 "MID_PA_E_USS_06_RINGING_TOO_LONG_N" 153 "MID_PA_E_USS_06_SHORT_2_GND_N" 152 "MID_PA_E_USS_06_SHORT_2_USENS_N" 151 "MID_PA_E_USS_06_STATE_COM_VERIFIED_N" 150 "MID_PA_E_USS_06_STATE_OFFSET_N" 149 "MID_PA_E_USS_06_STATE_PROG_N" 148 "MID_PA_E_USS_06_STATE_TYPE_N" 147 "MID_CAN_ESPInvalidData_N" 146 "MID_CAN_GTWInvalidData_N" 145 "MID_CAN_SCCMInvalidData_N" 144 "MID_CAN_DASLossOfCommunication_N" 143 "MID_CAN_EPASLossOfCommunication_N" 142 "MID_CAN_EPBLossOfCommunication_N" 141 "MID_CAN_ESPLossOfCommunication_N" 140 "MID_CAN_GTWLossOfCommunication_N" 139 "MID_CAN_SCCMLossOfCommunication_N" 138 "MID_PA_E_USS_08_NO_COM_N" 137 "MID_PA_E_USS_08_OPEN_N" 136 "MID_PA_E_USS_08_RING_TOO_SHORT_N" 135 "MID_PA_E_USS_08_RINGING_TOO_LONG_N" 134 "MID_PA_E_USS_08_SHORT_2_GND_N" 133 "MID_PA_E_USS_08_SHORT_2_USENS_N" 132 "MID_PA_E_USS_08_STATE_COM_VERIFIED_N" 131 "MID_PA_E_USS_08_STATE_OFFSET_N" 130 "MID_PA_E_USS_08_STATE_PROG_N" 129 "MID_PA_E_USS_08_STATE_TYPE_N" 128 "MID_PA_E_USS_09_NO_COM_N" 127 "MID_PA_E_USS_09_OPEN_N" 126 "MID_PA_E_USS_09_RING_TOO_SHORT_N" 125 "MID_PA_E_USS_09_RINGING_TOO_LONG_N" 124 "MID_PA_E_USS_09_SHORT_2_GND_N" 123 "MID_PA_E_USS_09_SHORT_2_USENS_N" 122 "MID_PA_E_USS_09_STATE_COM_VERIFIED_N" 121 "MID_PA_E_USS_09_STATE_OFFSET_N" 120 "MID_PA_E_USS_09_STATE_PROG_N" 119 "MID_PA_E_USS_09_STATE_TYPE_N" 118 "MID_PA_E_USS_10_NO_COM_N" 117 "MID_PA_E_USS_10_OPEN_N" 116 "MID_PA_E_USS_10_RING_TOO_SHORT_N" 115 "MID_PA_E_USS_10_RINGING_TOO_LONG_N" 114 "MID_PA_E_USS_10_SHORT_2_GND_N" 113 "MID_PA_E_USS_10_SHORT_2_USENS_N" 112 "MID_PA_E_USS_10_STATE_COM_VERIFIED_N" 111 "MID_PA_E_USS_10_STATE_OFFSET_N" 110 "MID_PA_E_USS_10_STATE_PROG_N" 109 "MID_PA_E_USS_10_STATE_TYPE_N" 108 "MID_PA_E_USS_11_NO_COM_N" 107 "MID_PA_E_USS_11_OPEN_N" 106 "MID_PA_E_USS_11_RING_TOO_SHORT_N" 105 "MID_PA_E_USS_11_RINGING_TOO_LONG_N" 104 "MID_PA_E_USS_11_SHORT_2_GND_N" 103 "MID_PA_E_USS_11_SHORT_2_USENS_N" 102 "MID_PA_E_USS_11_STATE_COM_VERIFIED_N" 101 "MID_PA_E_USS_11_STATE_OFFSET_N" 100 "MID_PA_E_USS_11_STATE_PROG_N" 99 "MID_PA_E_USS_11_STATE_TYPE_N" 98 "MID_PA_E_USS_12_NO_COM_N" 97 "MID_PA_E_USS_12_OPEN_N" 96 "MID_PA_E_USS_12_RING_TOO_SHORT_N" 95 "MID_PA_E_USS_12_RINGING_TOO_LONG_N" 94 "MID_PA_E_USS_12_SHORT_2_GND_N" 93 "MID_PA_E_USS_12_SHORT_2_USENS_N" 92 "MID_PA_E_USS_12_STATE_COM_VERIFIED_N" 91 "MID_PA_E_USS_12_STATE_OFFSET_N" 90 "MID_PA_E_USS_12_STATE_PROG_N" 89 "MID_PA_E_USS_12_STATE_TYPE_N" 88 "MID_PA_E_USS_13_NO_COM_N" 87 "MID_PA_E_USS_13_OPEN_N" 86 "MID_PA_E_USS_13_RING_TOO_SHORT_N" 85 "MID_PA_E_USS_13_RINGING_TOO_LONG_N" 84 "MID_PA_E_USS_13_SHORT_2_GND_N" 83 "MID_PA_E_USS_13_SHORT_2_USENS_N" 82 "MID_PA_E_USS_13_STATE_COM_VERIFIED_N" 81 "MID_PA_E_USS_13_STATE_OFFSET_N" 80 "MID_PA_E_USS_13_STATE_PROG_N" 79 "MID_PA_E_USS_13_STATE_TYPE_N" 78 "MID_PA_E_SVA_BLOCKED_USS_ML_N" 77 "MID_PA_E_SVA_BLOCKED_USS_MR_N" 76 "MID_PA_E_WHEEL_DIR_FL_INVALID_N" 75 "MID_PA_E_WHEEL_DIR_FR_INVALID_N" 74 "MID_PA_E_WHEEL_DIR_RL_INVALID_N" 73 "MID_PA_E_WHEEL_DIR_RR_INVALID_N" 72 "MID_PA_E_WHEEL_ROTATION_FL_INVALID_N" 71 "MID_PA_E_WHEEL_ROTATION_FR_INVALID_N" 70 "MID_PA_E_WHEEL_ROTATION_RL_INVALID_N" 69 "MID_PA_E_WHEEL_ROTATION_RR_INVALID_N" 68 "MID_PA_E_WICFL_INVALID_N" 67 "MID_PA_E_WICFR_INVALID_N" 66 "MID_PA_E_WICRL_INVALID_N" 65 "MID_PA_E_WICRR_INVALID_N" 64 "MID_PA_E_YAW_RATE_INVALID_N" 63 "MID_PDUR_E_INIT_FAILED_N" 62 "MID_PDUR_E_PDU_INSTANCE_LOST_N" 61 "MID_COMM_E_NET_START_IND_CHANNEL_0_N" 60 "MID_SPI_E_DMA_TRANSFER_N" 59 "MID_SPI_E_RECEIVE_OVERFLOW_N" 58 "MID_SPI_E_TRANSFER_TIMEOUT_N" 57 "MID_PA_E_VEHDYNINTERVENTION_TIMEOUT_N" 56 "MID_TRAILER_HITCH_PRES_INVALID_N" 55 "MID_PA_E_CL15_STATE_INVALID_N" 54 "MID_PA_E_YAW_RATE_SIGN_INVALID_N" 53 "MID_PA_E_ESP_WIC_FRONT_TIMEOUT_N" 52 "MID_PA_E_SEQ_CALL_FAILURE_N" 51 "MID_PA_E_HMI_FUNCACTIVATION_TIMEOUT_N" 50 "MID_PA_E_LOWBEAM_INVALID_N" 49 "MID_PA_E_ENGINESTART_TIMEOUT_N" 48 "MID_ADC_E_VREF_N" 47 "MID_PA_E_ESP_YAW_TIMEOUT_N" 46 "MID_PA_E_TCM_PRG_TIMEOUT_N" 45 "MID_WDG_E_MODE_SWITCH_FAILED_N" 44 "MID_WDG_E_DISABLE_REJECTED_N" 43 "MID_PA_E_ESP_WHEELDIR_TIMEOUT_N" 42 "MID_PA_E_SWCPA_E_INIT_FAILURE_N" 41 "MID_PA_E_DIR_INDICATOR_INVALID_N" 40 "MID_PA_E_ESP_WIC_TIMEOUT_N" 39 "MID_PA_E_EPS_SWA_TIMEOUT_N" 38 "MID_PA_E_INSTRCLUSTER4_TIMEOUT_N" 37 "MID_PA_E_INSTRCLUSTER5_TIMEOUT_N" 36 "MID_PA_E_INSTRCLUSTER3_TIMEOUT_N" 35 "MID_PA_E_INSTRCLUSTER2_TIMEOUT_N" 34 "MID_PA_E_ASIC_WTD_RESET_N" 33 "MID_PA_E_INSTRCLUSTER1_TIMEOUT_N" 32 "MID_PA_E_ASIC_LOW_VOLT_RESET_N" 31 "MID_PA_E_POWERMODE_TIMEOUT_N" 30 "MID_PA_E_ESP_PS_TIMEOUT_N" 29 "MID_PA_E_ESP_WIC_REAR_TIMEOUT_N" 28 "MID_PA_E_TRAILER_ATTACH_INVALID_N" 27 "MID_PA_E_EXTERNAL_EPS_FAILURE_N" 26 "MID_PA_E_PSX_ACTIVATION_INVALID_N" 25 "MID_PA_E_ESP_WHEELVELO_TIMEOUT_N" 24 "MID_PA_E_ESP_LONGACC_TIMEOUT_N" 23 "MID_PA_E_VEH_DYN_INTERVENTION_INVALID_N" 22 "MID_ZPA_E_PS_MODE_INVALID_N" 21 "MID_ZPA_E_EPS_ERROR_INVALID_N" 20 "MID_ZPA_E1_ESP_PSState_INVALID_N" 19 "MID_ZPA_E2_BdaUss01BlindnessDetect_N" 18 "MID_ZPA_E2_BdaUss02BlindnessDetect_N" 17 "MID_ZPA_E2_BdaUss03BlindnessDetect_N" 16 "MID_ZPA_E2_BdaUss10BlindnessDetect_N" 15 "MID_ZPA_E2_BdaUss05BlindnessDetect_N" 14 "MID_ZPA_E2_BdaUss11BlindnessDetect_N" 13 "MID_ZPA_E2_BdaUss07BlindnessDetect_N" 12 "MID_ZPA_E2_BdaUss12BlindnessDetect_N" 11 "MID_ZPA_E2_BdaUss06BlindnessDetect_N" 10 "MID_ZPA_E2_BdaUss08BlindnessDetect_N" 9 "MID_ZPA_E2_BdaUss13BlindnessDetect_N" 8 "MID_ZPA_E2_BdaUss09BlindnessDetect_N" 7 "MID_ZPA_E2_BdaUss04BlindnessDetect_N" 6 "MID_ZPA_E2_BdaUss14BlindnessDetect_N" 5 "MID_FLS_E_READ_FAILED_N" 4 "MID_FLS_E_COMPARE_FAILED_N" 3 "MID_FLS_E_ERASE_FAILED_N" 2 "MID_FLS_E_WRITE_FAILED_N" 1 "MID_NO_FAULT_N" 0 "MID_INVALID" ;
VAL_ 1486 PARK_sw051_subCode 254 "MID_ADC_E_TOUT_N" 253 "MID_ADC_E_INIT_FAILURE_N" 252 "MID_CAN_E_TIMEOUT_N" 251 "MID_CANIF_E_FULL_TX_BUFFER_N" 250 "MID_CANIF_E_INVALID_DLC_N" 249 "MID_CANIF_E_INVALID_TXPDUID_N" 248 "MID_CANIF_E_STOPPED_N" 247 "MID_CANNM_E_CANIF_TRANSMIT_ERROR_N" 246 "MID_CANNM_E_INIT_FAILED_N" 245 "MID_CANNM_E_NETWORK_TIMEOUT_N" 244 "MID_CANSM_E_BUSOFF_NETWORK_N" 243 "MID_CANTP_E_COM_DIAMANT_N" 242 "MID_ECU_E_EEP_DATAFLASH_LAYOUT_N" 241 "MID_ECU_E_RAM_N" 240 "MID_ECU_E_ROM_N" 239 "MID_FEE_E_LAYOUT_FAILED_N" 238 "MID_NVM_E_CONFIG_FAILED_N" 237 "MID_CAN_DASInvalidData_N" 236 "MID_CAN_C_BUSOFF_N" 235 "MID_NVM_E_INTEGRITY_FAILED_N" 234 "MID_NVM_E_REQ_FAILED_N" 233 "MID_PA_E_ASIC_COM_FAILURE_N" 232 "MID_PA_E_ASIC_HW_FAILURE_N" 231 "MID_PA_E_ENGINE_START_INVALID_N" 230 "MID_PA_E_EPS_STATUS_INVALID_N" 229 "MID_PA_E_GEAR_INVALID_N" 228 "MID_PA_E_LONG_ACC_INVALID_N" 227 "MID_PA_E_OUTSIDE_TEMP_INVALID_N" 226 "MID_CAN_EPASInvalidData_N" 225 "MID_PA_E_SPEED_INVALID_N" 224 "MID_PA_E_SVA_BLOCKED_USS_FL_N" 223 "MID_PA_E_SVA_BLOCKED_USS_FR_N" 222 "MID_PA_E_SVA_BLOCKED_USS_RL_N" 221 "MID_PA_E_SVA_BLOCKED_USS_RR_N" 220 "MID_PA_E_SWA_INVALID_N" 219 "MID_PA_E_SWCPA_APT_MONITOR_FAILURE_N" 218 "MID_PA_E_SWCPA_INHIBIT_HSS_PWRLOCK_N" 217 "MID_PA_E_SWCPA_INIT_FAILURE_N" 216 "MID_PA_E_SWCPA_PARFAILURE_N" 215 "MID_CAN_EPBInvalidData_N" 214 "MID_PA_E_UBAT_HIGH_N" 213 "MID_PA_E_UBAT_LOW_N" 212 "MID_PA_E_USENS_OVERTEMPERATURE_N" 211 "MID_PA_E_USENS_OVERVOLTAGE_N" 210 "MID_PA_E_USENS_SHORT_2_GND_N" 209 "MID_PA_E_USENS_SHORT_2_UBAT_N" 208 "MID_PA_E_USENS_UNDERVOLTAGE_N" 207 "MID_PA_E_USS_01_NO_COM_N" 206 "MID_PA_E_USS_01_OPEN_N" 205 "MID_PA_E_USS_01_RING_TOO_SHORT_N" 204 "MID_PA_E_USS_01_RINGING_TOO_LONG_N" 203 "MID_PA_E_USS_01_SHORT_2_GND_N" 202 "MID_PA_E_USS_01_SHORT_2_USENS_N" 201 "MID_PA_E_USS_01_STATE_COM_VERIFIED_N" 200 "MID_PA_E_USS_01_STATE_OFFSET_N" 199 "MID_PA_E_USS_01_STATE_PROG_N" 198 "MID_PA_E_USS_01_STATE_TYPE_N" 197 "MID_PA_E_USS_02_NO_COM_N" 196 "MID_PA_E_USS_02_OPEN_N" 195 "MID_PA_E_USS_02_RING_TOO_SHORT_N" 194 "MID_PA_E_USS_02_RINGING_TOO_LONG_N" 193 "MID_PA_E_USS_02_SHORT_2_GND_N" 192 "MID_PA_E_USS_02_SHORT_2_USENS_N" 191 "MID_PA_E_USS_02_STATE_COM_VERIFIED_N" 190 "MID_PA_E_USS_02_STATE_OFFSET_N" 189 "MID_PA_E_USS_02_STATE_PROG_N" 188 "MID_PA_E_USS_02_STATE_TYPE_N" 187 "MID_PA_E_USS_03_NO_COM_N" 186 "MID_PA_E_USS_03_OPEN_N" 185 "MID_PA_E_USS_03_RING_TOO_SHORT_N" 184 "MID_PA_E_USS_03_RINGING_TOO_LONG_N" 183 "MID_PA_E_USS_03_SHORT_2_GND_N" 182 "MID_PA_E_USS_03_SHORT_2_USENS_N" 181 "MID_PA_E_USS_03_STATE_COM_VERIFIED_N" 180 "MID_PA_E_USS_03_STATE_OFFSET_N" 179 "MID_PA_E_USS_03_STATE_PROG_N" 178 "MID_PA_E_USS_03_STATE_TYPE_N" 177 "MID_PA_E_USS_04_NO_COM_N" 176 "MID_PA_E_USS_04_OPEN_N" 175 "MID_PA_E_USS_04_RING_TOO_SHORT_N" 174 "MID_PA_E_USS_04_RINGING_TOO_LONG_N" 173 "MID_PA_E_USS_04_SHORT_2_GND_N" 172 "MID_PA_E_USS_04_SHORT_2_USENS_N" 171 "MID_PA_E_USS_04_STATE_COM_VERIFIED_N" 170 "MID_PA_E_USS_04_STATE_OFFSET_N" 169 "MID_PA_E_USS_04_STATE_PROG_N" 168 "MID_PA_E_USS_04_STATE_TYPE_N" 167 "MID_PA_E_USS_05_NO_COM_N" 166 "MID_PA_E_USS_05_OPEN_N" 165 "MID_PA_E_USS_05_RING_TOO_SHORT_N" 164 "MID_PA_E_USS_05_RINGING_TOO_LONG_N" 163 "MID_PA_E_USS_05_SHORT_2_GND_N" 162 "MID_PA_E_USS_05_SHORT_2_USENS_N" 161 "MID_PA_E_USS_05_STATE_COM_VERIFIED_N" 160 "MID_PA_E_USS_05_STATE_OFFSET_N" 159 "MID_PA_E_USS_05_STATE_PROG_N" 158 "MID_PA_E_USS_05_STATE_TYPE_N" 157 "MID_PA_E_USS_06_NO_COM_N" 156 "MID_PA_E_USS_06_OPEN_N" 155 "MID_PA_E_USS_06_RING_TOO_SHORT_N" 154 "MID_PA_E_USS_06_RINGING_TOO_LONG_N" 153 "MID_PA_E_USS_06_SHORT_2_GND_N" 152 "MID_PA_E_USS_06_SHORT_2_USENS_N" 151 "MID_PA_E_USS_06_STATE_COM_VERIFIED_N" 150 "MID_PA_E_USS_06_STATE_OFFSET_N" 149 "MID_PA_E_USS_06_STATE_PROG_N" 148 "MID_PA_E_USS_06_STATE_TYPE_N" 147 "MID_CAN_ESPInvalidData_N" 146 "MID_CAN_GTWInvalidData_N" 145 "MID_CAN_SCCMInvalidData_N" 144 "MID_CAN_DASLossOfCommunication_N" 143 "MID_CAN_EPASLossOfCommunication_N" 142 "MID_CAN_EPBLossOfCommunication_N" 141 "MID_CAN_ESPLossOfCommunication_N" 140 "MID_CAN_GTWLossOfCommunication_N" 139 "MID_CAN_SCCMLossOfCommunication_N" 138 "MID_PA_E_USS_08_NO_COM_N" 137 "MID_PA_E_USS_08_OPEN_N" 136 "MID_PA_E_USS_08_RING_TOO_SHORT_N" 135 "MID_PA_E_USS_08_RINGING_TOO_LONG_N" 134 "MID_PA_E_USS_08_SHORT_2_GND_N" 133 "MID_PA_E_USS_08_SHORT_2_USENS_N" 132 "MID_PA_E_USS_08_STATE_COM_VERIFIED_N" 131 "MID_PA_E_USS_08_STATE_OFFSET_N" 130 "MID_PA_E_USS_08_STATE_PROG_N" 129 "MID_PA_E_USS_08_STATE_TYPE_N" 128 "MID_PA_E_USS_09_NO_COM_N" 127 "MID_PA_E_USS_09_OPEN_N" 126 "MID_PA_E_USS_09_RING_TOO_SHORT_N" 125 "MID_PA_E_USS_09_RINGING_TOO_LONG_N" 124 "MID_PA_E_USS_09_SHORT_2_GND_N" 123 "MID_PA_E_USS_09_SHORT_2_USENS_N" 122 "MID_PA_E_USS_09_STATE_COM_VERIFIED_N" 121 "MID_PA_E_USS_09_STATE_OFFSET_N" 120 "MID_PA_E_USS_09_STATE_PROG_N" 119 "MID_PA_E_USS_09_STATE_TYPE_N" 118 "MID_PA_E_USS_10_NO_COM_N" 117 "MID_PA_E_USS_10_OPEN_N" 116 "MID_PA_E_USS_10_RING_TOO_SHORT_N" 115 "MID_PA_E_USS_10_RINGING_TOO_LONG_N" 114 "MID_PA_E_USS_10_SHORT_2_GND_N" 113 "MID_PA_E_USS_10_SHORT_2_USENS_N" 112 "MID_PA_E_USS_10_STATE_COM_VERIFIED_N" 111 "MID_PA_E_USS_10_STATE_OFFSET_N" 110 "MID_PA_E_USS_10_STATE_PROG_N" 109 "MID_PA_E_USS_10_STATE_TYPE_N" 108 "MID_PA_E_USS_11_NO_COM_N" 107 "MID_PA_E_USS_11_OPEN_N" 106 "MID_PA_E_USS_11_RING_TOO_SHORT_N" 105 "MID_PA_E_USS_11_RINGING_TOO_LONG_N" 104 "MID_PA_E_USS_11_SHORT_2_GND_N" 103 "MID_PA_E_USS_11_SHORT_2_USENS_N" 102 "MID_PA_E_USS_11_STATE_COM_VERIFIED_N" 101 "MID_PA_E_USS_11_STATE_OFFSET_N" 100 "MID_PA_E_USS_11_STATE_PROG_N" 99 "MID_PA_E_USS_11_STATE_TYPE_N" 98 "MID_PA_E_USS_12_NO_COM_N" 97 "MID_PA_E_USS_12_OPEN_N" 96 "MID_PA_E_USS_12_RING_TOO_SHORT_N" 95 "MID_PA_E_USS_12_RINGING_TOO_LONG_N" 94 "MID_PA_E_USS_12_SHORT_2_GND_N" 93 "MID_PA_E_USS_12_SHORT_2_USENS_N" 92 "MID_PA_E_USS_12_STATE_COM_VERIFIED_N" 91 "MID_PA_E_USS_12_STATE_OFFSET_N" 90 "MID_PA_E_USS_12_STATE_PROG_N" 89 "MID_PA_E_USS_12_STATE_TYPE_N" 88 "MID_PA_E_USS_13_NO_COM_N" 87 "MID_PA_E_USS_13_OPEN_N" 86 "MID_PA_E_USS_13_RING_TOO_SHORT_N" 85 "MID_PA_E_USS_13_RINGING_TOO_LONG_N" 84 "MID_PA_E_USS_13_SHORT_2_GND_N" 83 "MID_PA_E_USS_13_SHORT_2_USENS_N" 82 "MID_PA_E_USS_13_STATE_COM_VERIFIED_N" 81 "MID_PA_E_USS_13_STATE_OFFSET_N" 80 "MID_PA_E_USS_13_STATE_PROG_N" 79 "MID_PA_E_USS_13_STATE_TYPE_N" 78 "MID_PA_E_SVA_BLOCKED_USS_ML_N" 77 "MID_PA_E_SVA_BLOCKED_USS_MR_N" 76 "MID_PA_E_WHEEL_DIR_FL_INVALID_N" 75 "MID_PA_E_WHEEL_DIR_FR_INVALID_N" 74 "MID_PA_E_WHEEL_DIR_RL_INVALID_N" 73 "MID_PA_E_WHEEL_DIR_RR_INVALID_N" 72 "MID_PA_E_WHEEL_ROTATION_FL_INVALID_N" 71 "MID_PA_E_WHEEL_ROTATION_FR_INVALID_N" 70 "MID_PA_E_WHEEL_ROTATION_RL_INVALID_N" 69 "MID_PA_E_WHEEL_ROTATION_RR_INVALID_N" 68 "MID_PA_E_WICFL_INVALID_N" 67 "MID_PA_E_WICFR_INVALID_N" 66 "MID_PA_E_WICRL_INVALID_N" 65 "MID_PA_E_WICRR_INVALID_N" 64 "MID_PA_E_YAW_RATE_INVALID_N" 63 "MID_PDUR_E_INIT_FAILED_N" 62 "MID_PDUR_E_PDU_INSTANCE_LOST_N" 61 "MID_COMM_E_NET_START_IND_CHANNEL_0_N" 60 "MID_SPI_E_DMA_TRANSFER_N" 59 "MID_SPI_E_RECEIVE_OVERFLOW_N" 58 "MID_SPI_E_TRANSFER_TIMEOUT_N" 57 "MID_PA_E_VEHDYNINTERVENTION_TIMEOUT_N" 56 "MID_TRAILER_HITCH_PRES_INVALID_N" 55 "MID_PA_E_CL15_STATE_INVALID_N" 54 "MID_PA_E_YAW_RATE_SIGN_INVALID_N" 53 "MID_PA_E_ESP_WIC_FRONT_TIMEOUT_N" 52 "MID_PA_E_SEQ_CALL_FAILURE_N" 51 "MID_PA_E_HMI_FUNCACTIVATION_TIMEOUT_N" 50 "MID_PA_E_LOWBEAM_INVALID_N" 49 "MID_PA_E_ENGINESTART_TIMEOUT_N" 48 "MID_ADC_E_VREF_N" 47 "MID_PA_E_ESP_YAW_TIMEOUT_N" 46 "MID_PA_E_TCM_PRG_TIMEOUT_N" 45 "MID_WDG_E_MODE_SWITCH_FAILED_N" 44 "MID_WDG_E_DISABLE_REJECTED_N" 43 "MID_PA_E_ESP_WHEELDIR_TIMEOUT_N" 42 "MID_PA_E_SWCPA_E_INIT_FAILURE_N" 41 "MID_PA_E_DIR_INDICATOR_INVALID_N" 40 "MID_PA_E_ESP_WIC_TIMEOUT_N" 39 "MID_PA_E_EPS_SWA_TIMEOUT_N" 38 "MID_PA_E_INSTRCLUSTER4_TIMEOUT_N" 37 "MID_PA_E_INSTRCLUSTER5_TIMEOUT_N" 36 "MID_PA_E_INSTRCLUSTER3_TIMEOUT_N" 35 "MID_PA_E_INSTRCLUSTER2_TIMEOUT_N" 34 "MID_PA_E_ASIC_WTD_RESET_N" 33 "MID_PA_E_INSTRCLUSTER1_TIMEOUT_N" 32 "MID_PA_E_ASIC_LOW_VOLT_RESET_N" 31 "MID_PA_E_POWERMODE_TIMEOUT_N" 30 "MID_PA_E_ESP_PS_TIMEOUT_N" 29 "MID_PA_E_ESP_WIC_REAR_TIMEOUT_N" 28 "MID_PA_E_TRAILER_ATTACH_INVALID_N" 27 "MID_PA_E_EXTERNAL_EPS_FAILURE_N" 26 "MID_PA_E_PSX_ACTIVATION_INVALID_N" 25 "MID_PA_E_ESP_WHEELVELO_TIMEOUT_N" 24 "MID_PA_E_ESP_LONGACC_TIMEOUT_N" 23 "MID_PA_E_VEH_DYN_INTERVENTION_INVALID_N" 22 "MID_ZPA_E_PS_MODE_INVALID_N" 21 "MID_ZPA_E_EPS_ERROR_INVALID_N" 20 "MID_ZPA_E1_ESP_PSState_INVALID_N" 19 "MID_ZPA_E2_BdaUss01BlindnessDetect_N" 18 "MID_ZPA_E2_BdaUss02BlindnessDetect_N" 17 "MID_ZPA_E2_BdaUss03BlindnessDetect_N" 16 "MID_ZPA_E2_BdaUss10BlindnessDetect_N" 15 "MID_ZPA_E2_BdaUss05BlindnessDetect_N" 14 "MID_ZPA_E2_BdaUss11BlindnessDetect_N" 13 "MID_ZPA_E2_BdaUss07BlindnessDetect_N" 12 "MID_ZPA_E2_BdaUss12BlindnessDetect_N" 11 "MID_ZPA_E2_BdaUss06BlindnessDetect_N" 10 "MID_ZPA_E2_BdaUss08BlindnessDetect_N" 9 "MID_ZPA_E2_BdaUss13BlindnessDetect_N" 8 "MID_ZPA_E2_BdaUss09BlindnessDetect_N" 7 "MID_ZPA_E2_BdaUss04BlindnessDetect_N" 6 "MID_ZPA_E2_BdaUss14BlindnessDetect_N" 5 "MID_FLS_E_READ_FAILED_N" 4 "MID_FLS_E_COMPARE_FAILED_N" 3 "MID_FLS_E_ERASE_FAILED_N" 2 "MID_FLS_E_WRITE_FAILED_N" 1 "MID_NO_FAULT_N" 0 "MID_INVALID" ;
VAL_ 1486 PARK_sw052_ambTemp 255 "UNKNOWN" ;
VAL_ 1486 PARK_sw052_voltage 255 "UNKNOWN" ;
VAL_ 1486 PARK_sw052_subCode 254 "MID_ADC_E_TOUT_N" 253 "MID_ADC_E_INIT_FAILURE_N" 252 "MID_CAN_E_TIMEOUT_N" 251 "MID_CANIF_E_FULL_TX_BUFFER_N" 250 "MID_CANIF_E_INVALID_DLC_N" 249 "MID_CANIF_E_INVALID_TXPDUID_N" 248 "MID_CANIF_E_STOPPED_N" 247 "MID_CANNM_E_CANIF_TRANSMIT_ERROR_N" 246 "MID_CANNM_E_INIT_FAILED_N" 245 "MID_CANNM_E_NETWORK_TIMEOUT_N" 244 "MID_CANSM_E_BUSOFF_NETWORK_N" 243 "MID_CANTP_E_COM_DIAMANT_N" 242 "MID_ECU_E_EEP_DATAFLASH_LAYOUT_N" 241 "MID_ECU_E_RAM_N" 240 "MID_ECU_E_ROM_N" 239 "MID_FEE_E_LAYOUT_FAILED_N" 238 "MID_NVM_E_CONFIG_FAILED_N" 237 "MID_CAN_DASInvalidData_N" 236 "MID_CAN_C_BUSOFF_N" 235 "MID_NVM_E_INTEGRITY_FAILED_N" 234 "MID_NVM_E_REQ_FAILED_N" 233 "MID_PA_E_ASIC_COM_FAILURE_N" 232 "MID_PA_E_ASIC_HW_FAILURE_N" 231 "MID_PA_E_ENGINE_START_INVALID_N" 230 "MID_PA_E_EPS_STATUS_INVALID_N" 229 "MID_PA_E_GEAR_INVALID_N" 228 "MID_PA_E_LONG_ACC_INVALID_N" 227 "MID_PA_E_OUTSIDE_TEMP_INVALID_N" 226 "MID_CAN_EPASInvalidData_N" 225 "MID_PA_E_SPEED_INVALID_N" 224 "MID_PA_E_SVA_BLOCKED_USS_FL_N" 223 "MID_PA_E_SVA_BLOCKED_USS_FR_N" 222 "MID_PA_E_SVA_BLOCKED_USS_RL_N" 221 "MID_PA_E_SVA_BLOCKED_USS_RR_N" 220 "MID_PA_E_SWA_INVALID_N" 219 "MID_PA_E_SWCPA_APT_MONITOR_FAILURE_N" 218 "MID_PA_E_SWCPA_INHIBIT_HSS_PWRLOCK_N" 217 "MID_PA_E_SWCPA_INIT_FAILURE_N" 216 "MID_PA_E_SWCPA_PARFAILURE_N" 215 "MID_CAN_EPBInvalidData_N" 214 "MID_PA_E_UBAT_HIGH_N" 213 "MID_PA_E_UBAT_LOW_N" 212 "MID_PA_E_USENS_OVERTEMPERATURE_N" 211 "MID_PA_E_USENS_OVERVOLTAGE_N" 210 "MID_PA_E_USENS_SHORT_2_GND_N" 209 "MID_PA_E_USENS_SHORT_2_UBAT_N" 208 "MID_PA_E_USENS_UNDERVOLTAGE_N" 207 "MID_PA_E_USS_01_NO_COM_N" 206 "MID_PA_E_USS_01_OPEN_N" 205 "MID_PA_E_USS_01_RING_TOO_SHORT_N" 204 "MID_PA_E_USS_01_RINGING_TOO_LONG_N" 203 "MID_PA_E_USS_01_SHORT_2_GND_N" 202 "MID_PA_E_USS_01_SHORT_2_USENS_N" 201 "MID_PA_E_USS_01_STATE_COM_VERIFIED_N" 200 "MID_PA_E_USS_01_STATE_OFFSET_N" 199 "MID_PA_E_USS_01_STATE_PROG_N" 198 "MID_PA_E_USS_01_STATE_TYPE_N" 197 "MID_PA_E_USS_02_NO_COM_N" 196 "MID_PA_E_USS_02_OPEN_N" 195 "MID_PA_E_USS_02_RING_TOO_SHORT_N" 194 "MID_PA_E_USS_02_RINGING_TOO_LONG_N" 193 "MID_PA_E_USS_02_SHORT_2_GND_N" 192 "MID_PA_E_USS_02_SHORT_2_USENS_N" 191 "MID_PA_E_USS_02_STATE_COM_VERIFIED_N" 190 "MID_PA_E_USS_02_STATE_OFFSET_N" 189 "MID_PA_E_USS_02_STATE_PROG_N" 188 "MID_PA_E_USS_02_STATE_TYPE_N" 187 "MID_PA_E_USS_03_NO_COM_N" 186 "MID_PA_E_USS_03_OPEN_N" 185 "MID_PA_E_USS_03_RING_TOO_SHORT_N" 184 "MID_PA_E_USS_03_RINGING_TOO_LONG_N" 183 "MID_PA_E_USS_03_SHORT_2_GND_N" 182 "MID_PA_E_USS_03_SHORT_2_USENS_N" 181 "MID_PA_E_USS_03_STATE_COM_VERIFIED_N" 180 "MID_PA_E_USS_03_STATE_OFFSET_N" 179 "MID_PA_E_USS_03_STATE_PROG_N" 178 "MID_PA_E_USS_03_STATE_TYPE_N" 177 "MID_PA_E_USS_04_NO_COM_N" 176 "MID_PA_E_USS_04_OPEN_N" 175 "MID_PA_E_USS_04_RING_TOO_SHORT_N" 174 "MID_PA_E_USS_04_RINGING_TOO_LONG_N" 173 "MID_PA_E_USS_04_SHORT_2_GND_N" 172 "MID_PA_E_USS_04_SHORT_2_USENS_N" 171 "MID_PA_E_USS_04_STATE_COM_VERIFIED_N" 170 "MID_PA_E_USS_04_STATE_OFFSET_N" 169 "MID_PA_E_USS_04_STATE_PROG_N" 168 "MID_PA_E_USS_04_STATE_TYPE_N" 167 "MID_PA_E_USS_05_NO_COM_N" 166 "MID_PA_E_USS_05_OPEN_N" 165 "MID_PA_E_USS_05_RING_TOO_SHORT_N" 164 "MID_PA_E_USS_05_RINGING_TOO_LONG_N" 163 "MID_PA_E_USS_05_SHORT_2_GND_N" 162 "MID_PA_E_USS_05_SHORT_2_USENS_N" 161 "MID_PA_E_USS_05_STATE_COM_VERIFIED_N" 160 "MID_PA_E_USS_05_STATE_OFFSET_N" 159 "MID_PA_E_USS_05_STATE_PROG_N" 158 "MID_PA_E_USS_05_STATE_TYPE_N" 157 "MID_PA_E_USS_06_NO_COM_N" 156 "MID_PA_E_USS_06_OPEN_N" 155 "MID_PA_E_USS_06_RING_TOO_SHORT_N" 154 "MID_PA_E_USS_06_RINGING_TOO_LONG_N" 153 "MID_PA_E_USS_06_SHORT_2_GND_N" 152 "MID_PA_E_USS_06_SHORT_2_USENS_N" 151 "MID_PA_E_USS_06_STATE_COM_VERIFIED_N" 150 "MID_PA_E_USS_06_STATE_OFFSET_N" 149 "MID_PA_E_USS_06_STATE_PROG_N" 148 "MID_PA_E_USS_06_STATE_TYPE_N" 147 "MID_CAN_ESPInvalidData_N" 146 "MID_CAN_GTWInvalidData_N" 145 "MID_CAN_SCCMInvalidData_N" 144 "MID_CAN_DASLossOfCommunication_N" 143 "MID_CAN_EPASLossOfCommunication_N" 142 "MID_CAN_EPBLossOfCommunication_N" 141 "MID_CAN_ESPLossOfCommunication_N" 140 "MID_CAN_GTWLossOfCommunication_N" 139 "MID_CAN_SCCMLossOfCommunication_N" 138 "MID_PA_E_USS_08_NO_COM_N" 137 "MID_PA_E_USS_08_OPEN_N" 136 "MID_PA_E_USS_08_RING_TOO_SHORT_N" 135 "MID_PA_E_USS_08_RINGING_TOO_LONG_N" 134 "MID_PA_E_USS_08_SHORT_2_GND_N" 133 "MID_PA_E_USS_08_SHORT_2_USENS_N" 132 "MID_PA_E_USS_08_STATE_COM_VERIFIED_N" 131 "MID_PA_E_USS_08_STATE_OFFSET_N" 130 "MID_PA_E_USS_08_STATE_PROG_N" 129 "MID_PA_E_USS_08_STATE_TYPE_N" 128 "MID_PA_E_USS_09_NO_COM_N" 127 "MID_PA_E_USS_09_OPEN_N" 126 "MID_PA_E_USS_09_RING_TOO_SHORT_N" 125 "MID_PA_E_USS_09_RINGING_TOO_LONG_N" 124 "MID_PA_E_USS_09_SHORT_2_GND_N" 123 "MID_PA_E_USS_09_SHORT_2_USENS_N" 122 "MID_PA_E_USS_09_STATE_COM_VERIFIED_N" 121 "MID_PA_E_USS_09_STATE_OFFSET_N" 120 "MID_PA_E_USS_09_STATE_PROG_N" 119 "MID_PA_E_USS_09_STATE_TYPE_N" 118 "MID_PA_E_USS_10_NO_COM_N" 117 "MID_PA_E_USS_10_OPEN_N" 116 "MID_PA_E_USS_10_RING_TOO_SHORT_N" 115 "MID_PA_E_USS_10_RINGING_TOO_LONG_N" 114 "MID_PA_E_USS_10_SHORT_2_GND_N" 113 "MID_PA_E_USS_10_SHORT_2_USENS_N" 112 "MID_PA_E_USS_10_STATE_COM_VERIFIED_N" 111 "MID_PA_E_USS_10_STATE_OFFSET_N" 110 "MID_PA_E_USS_10_STATE_PROG_N" 109 "MID_PA_E_USS_10_STATE_TYPE_N" 108 "MID_PA_E_USS_11_NO_COM_N" 107 "MID_PA_E_USS_11_OPEN_N" 106 "MID_PA_E_USS_11_RING_TOO_SHORT_N" 105 "MID_PA_E_USS_11_RINGING_TOO_LONG_N" 104 "MID_PA_E_USS_11_SHORT_2_GND_N" 103 "MID_PA_E_USS_11_SHORT_2_USENS_N" 102 "MID_PA_E_USS_11_STATE_COM_VERIFIED_N" 101 "MID_PA_E_USS_11_STATE_OFFSET_N" 100 "MID_PA_E_USS_11_STATE_PROG_N" 99 "MID_PA_E_USS_11_STATE_TYPE_N" 98 "MID_PA_E_USS_12_NO_COM_N" 97 "MID_PA_E_USS_12_OPEN_N" 96 "MID_PA_E_USS_12_RING_TOO_SHORT_N" 95 "MID_PA_E_USS_12_RINGING_TOO_LONG_N" 94 "MID_PA_E_USS_12_SHORT_2_GND_N" 93 "MID_PA_E_USS_12_SHORT_2_USENS_N" 92 "MID_PA_E_USS_12_STATE_COM_VERIFIED_N" 91 "MID_PA_E_USS_12_STATE_OFFSET_N" 90 "MID_PA_E_USS_12_STATE_PROG_N" 89 "MID_PA_E_USS_12_STATE_TYPE_N" 88 "MID_PA_E_USS_13_NO_COM_N" 87 "MID_PA_E_USS_13_OPEN_N" 86 "MID_PA_E_USS_13_RING_TOO_SHORT_N" 85 "MID_PA_E_USS_13_RINGING_TOO_LONG_N" 84 "MID_PA_E_USS_13_SHORT_2_GND_N" 83 "MID_PA_E_USS_13_SHORT_2_USENS_N" 82 "MID_PA_E_USS_13_STATE_COM_VERIFIED_N" 81 "MID_PA_E_USS_13_STATE_OFFSET_N" 80 "MID_PA_E_USS_13_STATE_PROG_N" 79 "MID_PA_E_USS_13_STATE_TYPE_N" 78 "MID_PA_E_SVA_BLOCKED_USS_ML_N" 77 "MID_PA_E_SVA_BLOCKED_USS_MR_N" 76 "MID_PA_E_WHEEL_DIR_FL_INVALID_N" 75 "MID_PA_E_WHEEL_DIR_FR_INVALID_N" 74 "MID_PA_E_WHEEL_DIR_RL_INVALID_N" 73 "MID_PA_E_WHEEL_DIR_RR_INVALID_N" 72 "MID_PA_E_WHEEL_ROTATION_FL_INVALID_N" 71 "MID_PA_E_WHEEL_ROTATION_FR_INVALID_N" 70 "MID_PA_E_WHEEL_ROTATION_RL_INVALID_N" 69 "MID_PA_E_WHEEL_ROTATION_RR_INVALID_N" 68 "MID_PA_E_WICFL_INVALID_N" 67 "MID_PA_E_WICFR_INVALID_N" 66 "MID_PA_E_WICRL_INVALID_N" 65 "MID_PA_E_WICRR_INVALID_N" 64 "MID_PA_E_YAW_RATE_INVALID_N" 63 "MID_PDUR_E_INIT_FAILED_N" 62 "MID_PDUR_E_PDU_INSTANCE_LOST_N" 61 "MID_COMM_E_NET_START_IND_CHANNEL_0_N" 60 "MID_SPI_E_DMA_TRANSFER_N" 59 "MID_SPI_E_RECEIVE_OVERFLOW_N" 58 "MID_SPI_E_TRANSFER_TIMEOUT_N" 57 "MID_PA_E_VEHDYNINTERVENTION_TIMEOUT_N" 56 "MID_TRAILER_HITCH_PRES_INVALID_N" 55 "MID_PA_E_CL15_STATE_INVALID_N" 54 "MID_PA_E_YAW_RATE_SIGN_INVALID_N" 53 "MID_PA_E_ESP_WIC_FRONT_TIMEOUT_N" 52 "MID_PA_E_SEQ_CALL_FAILURE_N" 51 "MID_PA_E_HMI_FUNCACTIVATION_TIMEOUT_N" 50 "MID_PA_E_LOWBEAM_INVALID_N" 49 "MID_PA_E_ENGINESTART_TIMEOUT_N" 48 "MID_ADC_E_VREF_N" 47 "MID_PA_E_ESP_YAW_TIMEOUT_N" 46 "MID_PA_E_TCM_PRG_TIMEOUT_N" 45 "MID_WDG_E_MODE_SWITCH_FAILED_N" 44 "MID_WDG_E_DISABLE_REJECTED_N" 43 "MID_PA_E_ESP_WHEELDIR_TIMEOUT_N" 42 "MID_PA_E_SWCPA_E_INIT_FAILURE_N" 41 "MID_PA_E_DIR_INDICATOR_INVALID_N" 40 "MID_PA_E_ESP_WIC_TIMEOUT_N" 39 "MID_PA_E_EPS_SWA_TIMEOUT_N" 38 "MID_PA_E_INSTRCLUSTER4_TIMEOUT_N" 37 "MID_PA_E_INSTRCLUSTER5_TIMEOUT_N" 36 "MID_PA_E_INSTRCLUSTER3_TIMEOUT_N" 35 "MID_PA_E_INSTRCLUSTER2_TIMEOUT_N" 34 "MID_PA_E_ASIC_WTD_RESET_N" 33 "MID_PA_E_INSTRCLUSTER1_TIMEOUT_N" 32 "MID_PA_E_ASIC_LOW_VOLT_RESET_N" 31 "MID_PA_E_POWERMODE_TIMEOUT_N" 30 "MID_PA_E_ESP_PS_TIMEOUT_N" 29 "MID_PA_E_ESP_WIC_REAR_TIMEOUT_N" 28 "MID_PA_E_TRAILER_ATTACH_INVALID_N" 27 "MID_PA_E_EXTERNAL_EPS_FAILURE_N" 26 "MID_PA_E_PSX_ACTIVATION_INVALID_N" 25 "MID_PA_E_ESP_WHEELVELO_TIMEOUT_N" 24 "MID_PA_E_ESP_LONGACC_TIMEOUT_N" 23 "MID_PA_E_VEH_DYN_INTERVENTION_INVALID_N" 22 "MID_ZPA_E_PS_MODE_INVALID_N" 21 "MID_ZPA_E_EPS_ERROR_INVALID_N" 20 "MID_ZPA_E1_ESP_PSState_INVALID_N" 19 "MID_ZPA_E2_BdaUss01BlindnessDetect_N" 18 "MID_ZPA_E2_BdaUss02BlindnessDetect_N" 17 "MID_ZPA_E2_BdaUss03BlindnessDetect_N" 16 "MID_ZPA_E2_BdaUss10BlindnessDetect_N" 15 "MID_ZPA_E2_BdaUss05BlindnessDetect_N" 14 "MID_ZPA_E2_BdaUss11BlindnessDetect_N" 13 "MID_ZPA_E2_BdaUss07BlindnessDetect_N" 12 "MID_ZPA_E2_BdaUss12BlindnessDetect_N" 11 "MID_ZPA_E2_BdaUss06BlindnessDetect_N" 10 "MID_ZPA_E2_BdaUss08BlindnessDetect_N" 9 "MID_ZPA_E2_BdaUss13BlindnessDetect_N" 8 "MID_ZPA_E2_BdaUss09BlindnessDetect_N" 7 "MID_ZPA_E2_BdaUss04BlindnessDetect_N" 6 "MID_ZPA_E2_BdaUss14BlindnessDetect_N" 5 "MID_FLS_E_READ_FAILED_N" 4 "MID_FLS_E_COMPARE_FAILED_N" 3 "MID_FLS_E_ERASE_FAILED_N" 2 "MID_FLS_E_WRITE_FAILED_N" 1 "MID_NO_FAULT_N" 0 "MID_INVALID" ;
VAL_ 1486 PARK_sw053_ambTemp 255 "UNKNOWN" ;
VAL_ 1486 PARK_sw053_voltage 255 "UNKNOWN" ;
VAL_ 1486 PARK_sw053_subCode 254 "MID_ADC_E_TOUT_N" 253 "MID_ADC_E_INIT_FAILURE_N" 252 "MID_CAN_E_TIMEOUT_N" 251 "MID_CANIF_E_FULL_TX_BUFFER_N" 250 "MID_CANIF_E_INVALID_DLC_N" 249 "MID_CANIF_E_INVALID_TXPDUID_N" 248 "MID_CANIF_E_STOPPED_N" 247 "MID_CANNM_E_CANIF_TRANSMIT_ERROR_N" 246 "MID_CANNM_E_INIT_FAILED_N" 245 "MID_CANNM_E_NETWORK_TIMEOUT_N" 244 "MID_CANSM_E_BUSOFF_NETWORK_N" 243 "MID_CANTP_E_COM_DIAMANT_N" 242 "MID_ECU_E_EEP_DATAFLASH_LAYOUT_N" 241 "MID_ECU_E_RAM_N" 240 "MID_ECU_E_ROM_N" 239 "MID_FEE_E_LAYOUT_FAILED_N" 238 "MID_NVM_E_CONFIG_FAILED_N" 237 "MID_CAN_DASInvalidData_N" 236 "MID_CAN_C_BUSOFF_N" 235 "MID_NVM_E_INTEGRITY_FAILED_N" 234 "MID_NVM_E_REQ_FAILED_N" 233 "MID_PA_E_ASIC_COM_FAILURE_N" 232 "MID_PA_E_ASIC_HW_FAILURE_N" 231 "MID_PA_E_ENGINE_START_INVALID_N" 230 "MID_PA_E_EPS_STATUS_INVALID_N" 229 "MID_PA_E_GEAR_INVALID_N" 228 "MID_PA_E_LONG_ACC_INVALID_N" 227 "MID_PA_E_OUTSIDE_TEMP_INVALID_N" 226 "MID_CAN_EPASInvalidData_N" 225 "MID_PA_E_SPEED_INVALID_N" 224 "MID_PA_E_SVA_BLOCKED_USS_FL_N" 223 "MID_PA_E_SVA_BLOCKED_USS_FR_N" 222 "MID_PA_E_SVA_BLOCKED_USS_RL_N" 221 "MID_PA_E_SVA_BLOCKED_USS_RR_N" 220 "MID_PA_E_SWA_INVALID_N" 219 "MID_PA_E_SWCPA_APT_MONITOR_FAILURE_N" 218 "MID_PA_E_SWCPA_INHIBIT_HSS_PWRLOCK_N" 217 "MID_PA_E_SWCPA_INIT_FAILURE_N" 216 "MID_PA_E_SWCPA_PARFAILURE_N" 215 "MID_CAN_EPBInvalidData_N" 214 "MID_PA_E_UBAT_HIGH_N" 213 "MID_PA_E_UBAT_LOW_N" 212 "MID_PA_E_USENS_OVERTEMPERATURE_N" 211 "MID_PA_E_USENS_OVERVOLTAGE_N" 210 "MID_PA_E_USENS_SHORT_2_GND_N" 209 "MID_PA_E_USENS_SHORT_2_UBAT_N" 208 "MID_PA_E_USENS_UNDERVOLTAGE_N" 207 "MID_PA_E_USS_01_NO_COM_N" 206 "MID_PA_E_USS_01_OPEN_N" 205 "MID_PA_E_USS_01_RING_TOO_SHORT_N" 204 "MID_PA_E_USS_01_RINGING_TOO_LONG_N" 203 "MID_PA_E_USS_01_SHORT_2_GND_N" 202 "MID_PA_E_USS_01_SHORT_2_USENS_N" 201 "MID_PA_E_USS_01_STATE_COM_VERIFIED_N" 200 "MID_PA_E_USS_01_STATE_OFFSET_N" 199 "MID_PA_E_USS_01_STATE_PROG_N" 198 "MID_PA_E_USS_01_STATE_TYPE_N" 197 "MID_PA_E_USS_02_NO_COM_N" 196 "MID_PA_E_USS_02_OPEN_N" 195 "MID_PA_E_USS_02_RING_TOO_SHORT_N" 194 "MID_PA_E_USS_02_RINGING_TOO_LONG_N" 193 "MID_PA_E_USS_02_SHORT_2_GND_N" 192 "MID_PA_E_USS_02_SHORT_2_USENS_N" 191 "MID_PA_E_USS_02_STATE_COM_VERIFIED_N" 190 "MID_PA_E_USS_02_STATE_OFFSET_N" 189 "MID_PA_E_USS_02_STATE_PROG_N" 188 "MID_PA_E_USS_02_STATE_TYPE_N" 187 "MID_PA_E_USS_03_NO_COM_N" 186 "MID_PA_E_USS_03_OPEN_N" 185 "MID_PA_E_USS_03_RING_TOO_SHORT_N" 184 "MID_PA_E_USS_03_RINGING_TOO_LONG_N" 183 "MID_PA_E_USS_03_SHORT_2_GND_N" 182 "MID_PA_E_USS_03_SHORT_2_USENS_N" 181 "MID_PA_E_USS_03_STATE_COM_VERIFIED_N" 180 "MID_PA_E_USS_03_STATE_OFFSET_N" 179 "MID_PA_E_USS_03_STATE_PROG_N" 178 "MID_PA_E_USS_03_STATE_TYPE_N" 177 "MID_PA_E_USS_04_NO_COM_N" 176 "MID_PA_E_USS_04_OPEN_N" 175 "MID_PA_E_USS_04_RING_TOO_SHORT_N" 174 "MID_PA_E_USS_04_RINGING_TOO_LONG_N" 173 "MID_PA_E_USS_04_SHORT_2_GND_N" 172 "MID_PA_E_USS_04_SHORT_2_USENS_N" 171 "MID_PA_E_USS_04_STATE_COM_VERIFIED_N" 170 "MID_PA_E_USS_04_STATE_OFFSET_N" 169 "MID_PA_E_USS_04_STATE_PROG_N" 168 "MID_PA_E_USS_04_STATE_TYPE_N" 167 "MID_PA_E_USS_05_NO_COM_N" 166 "MID_PA_E_USS_05_OPEN_N" 165 "MID_PA_E_USS_05_RING_TOO_SHORT_N" 164 "MID_PA_E_USS_05_RINGING_TOO_LONG_N" 163 "MID_PA_E_USS_05_SHORT_2_GND_N" 162 "MID_PA_E_USS_05_SHORT_2_USENS_N" 161 "MID_PA_E_USS_05_STATE_COM_VERIFIED_N" 160 "MID_PA_E_USS_05_STATE_OFFSET_N" 159 "MID_PA_E_USS_05_STATE_PROG_N" 158 "MID_PA_E_USS_05_STATE_TYPE_N" 157 "MID_PA_E_USS_06_NO_COM_N" 156 "MID_PA_E_USS_06_OPEN_N" 155 "MID_PA_E_USS_06_RING_TOO_SHORT_N" 154 "MID_PA_E_USS_06_RINGING_TOO_LONG_N" 153 "MID_PA_E_USS_06_SHORT_2_GND_N" 152 "MID_PA_E_USS_06_SHORT_2_USENS_N" 151 "MID_PA_E_USS_06_STATE_COM_VERIFIED_N" 150 "MID_PA_E_USS_06_STATE_OFFSET_N" 149 "MID_PA_E_USS_06_STATE_PROG_N" 148 "MID_PA_E_USS_06_STATE_TYPE_N" 147 "MID_CAN_ESPInvalidData_N" 146 "MID_CAN_GTWInvalidData_N" 145 "MID_CAN_SCCMInvalidData_N" 144 "MID_CAN_DASLossOfCommunication_N" 143 "MID_CAN_EPASLossOfCommunication_N" 142 "MID_CAN_EPBLossOfCommunication_N" 141 "MID_CAN_ESPLossOfCommunication_N" 140 "MID_CAN_GTWLossOfCommunication_N" 139 "MID_CAN_SCCMLossOfCommunication_N" 138 "MID_PA_E_USS_08_NO_COM_N" 137 "MID_PA_E_USS_08_OPEN_N" 136 "MID_PA_E_USS_08_RING_TOO_SHORT_N" 135 "MID_PA_E_USS_08_RINGING_TOO_LONG_N" 134 "MID_PA_E_USS_08_SHORT_2_GND_N" 133 "MID_PA_E_USS_08_SHORT_2_USENS_N" 132 "MID_PA_E_USS_08_STATE_COM_VERIFIED_N" 131 "MID_PA_E_USS_08_STATE_OFFSET_N" 130 "MID_PA_E_USS_08_STATE_PROG_N" 129 "MID_PA_E_USS_08_STATE_TYPE_N" 128 "MID_PA_E_USS_09_NO_COM_N" 127 "MID_PA_E_USS_09_OPEN_N" 126 "MID_PA_E_USS_09_RING_TOO_SHORT_N" 125 "MID_PA_E_USS_09_RINGING_TOO_LONG_N" 124 "MID_PA_E_USS_09_SHORT_2_GND_N" 123 "MID_PA_E_USS_09_SHORT_2_USENS_N" 122 "MID_PA_E_USS_09_STATE_COM_VERIFIED_N" 121 "MID_PA_E_USS_09_STATE_OFFSET_N" 120 "MID_PA_E_USS_09_STATE_PROG_N" 119 "MID_PA_E_USS_09_STATE_TYPE_N" 118 "MID_PA_E_USS_10_NO_COM_N" 117 "MID_PA_E_USS_10_OPEN_N" 116 "MID_PA_E_USS_10_RING_TOO_SHORT_N" 115 "MID_PA_E_USS_10_RINGING_TOO_LONG_N" 114 "MID_PA_E_USS_10_SHORT_2_GND_N" 113 "MID_PA_E_USS_10_SHORT_2_USENS_N" 112 "MID_PA_E_USS_10_STATE_COM_VERIFIED_N" 111 "MID_PA_E_USS_10_STATE_OFFSET_N" 110 "MID_PA_E_USS_10_STATE_PROG_N" 109 "MID_PA_E_USS_10_STATE_TYPE_N" 108 "MID_PA_E_USS_11_NO_COM_N" 107 "MID_PA_E_USS_11_OPEN_N" 106 "MID_PA_E_USS_11_RING_TOO_SHORT_N" 105 "MID_PA_E_USS_11_RINGING_TOO_LONG_N" 104 "MID_PA_E_USS_11_SHORT_2_GND_N" 103 "MID_PA_E_USS_11_SHORT_2_USENS_N" 102 "MID_PA_E_USS_11_STATE_COM_VERIFIED_N" 101 "MID_PA_E_USS_11_STATE_OFFSET_N" 100 "MID_PA_E_USS_11_STATE_PROG_N" 99 "MID_PA_E_USS_11_STATE_TYPE_N" 98 "MID_PA_E_USS_12_NO_COM_N" 97 "MID_PA_E_USS_12_OPEN_N" 96 "MID_PA_E_USS_12_RING_TOO_SHORT_N" 95 "MID_PA_E_USS_12_RINGING_TOO_LONG_N" 94 "MID_PA_E_USS_12_SHORT_2_GND_N" 93 "MID_PA_E_USS_12_SHORT_2_USENS_N" 92 "MID_PA_E_USS_12_STATE_COM_VERIFIED_N" 91 "MID_PA_E_USS_12_STATE_OFFSET_N" 90 "MID_PA_E_USS_12_STATE_PROG_N" 89 "MID_PA_E_USS_12_STATE_TYPE_N" 88 "MID_PA_E_USS_13_NO_COM_N" 87 "MID_PA_E_USS_13_OPEN_N" 86 "MID_PA_E_USS_13_RING_TOO_SHORT_N" 85 "MID_PA_E_USS_13_RINGING_TOO_LONG_N" 84 "MID_PA_E_USS_13_SHORT_2_GND_N" 83 "MID_PA_E_USS_13_SHORT_2_USENS_N" 82 "MID_PA_E_USS_13_STATE_COM_VERIFIED_N" 81 "MID_PA_E_USS_13_STATE_OFFSET_N" 80 "MID_PA_E_USS_13_STATE_PROG_N" 79 "MID_PA_E_USS_13_STATE_TYPE_N" 78 "MID_PA_E_SVA_BLOCKED_USS_ML_N" 77 "MID_PA_E_SVA_BLOCKED_USS_MR_N" 76 "MID_PA_E_WHEEL_DIR_FL_INVALID_N" 75 "MID_PA_E_WHEEL_DIR_FR_INVALID_N" 74 "MID_PA_E_WHEEL_DIR_RL_INVALID_N" 73 "MID_PA_E_WHEEL_DIR_RR_INVALID_N" 72 "MID_PA_E_WHEEL_ROTATION_FL_INVALID_N" 71 "MID_PA_E_WHEEL_ROTATION_FR_INVALID_N" 70 "MID_PA_E_WHEEL_ROTATION_RL_INVALID_N" 69 "MID_PA_E_WHEEL_ROTATION_RR_INVALID_N" 68 "MID_PA_E_WICFL_INVALID_N" 67 "MID_PA_E_WICFR_INVALID_N" 66 "MID_PA_E_WICRL_INVALID_N" 65 "MID_PA_E_WICRR_INVALID_N" 64 "MID_PA_E_YAW_RATE_INVALID_N" 63 "MID_PDUR_E_INIT_FAILED_N" 62 "MID_PDUR_E_PDU_INSTANCE_LOST_N" 61 "MID_COMM_E_NET_START_IND_CHANNEL_0_N" 60 "MID_SPI_E_DMA_TRANSFER_N" 59 "MID_SPI_E_RECEIVE_OVERFLOW_N" 58 "MID_SPI_E_TRANSFER_TIMEOUT_N" 57 "MID_PA_E_VEHDYNINTERVENTION_TIMEOUT_N" 56 "MID_TRAILER_HITCH_PRES_INVALID_N" 55 "MID_PA_E_CL15_STATE_INVALID_N" 54 "MID_PA_E_YAW_RATE_SIGN_INVALID_N" 53 "MID_PA_E_ESP_WIC_FRONT_TIMEOUT_N" 52 "MID_PA_E_SEQ_CALL_FAILURE_N" 51 "MID_PA_E_HMI_FUNCACTIVATION_TIMEOUT_N" 50 "MID_PA_E_LOWBEAM_INVALID_N" 49 "MID_PA_E_ENGINESTART_TIMEOUT_N" 48 "MID_ADC_E_VREF_N" 47 "MID_PA_E_ESP_YAW_TIMEOUT_N" 46 "MID_PA_E_TCM_PRG_TIMEOUT_N" 45 "MID_WDG_E_MODE_SWITCH_FAILED_N" 44 "MID_WDG_E_DISABLE_REJECTED_N" 43 "MID_PA_E_ESP_WHEELDIR_TIMEOUT_N" 42 "MID_PA_E_SWCPA_E_INIT_FAILURE_N" 41 "MID_PA_E_DIR_INDICATOR_INVALID_N" 40 "MID_PA_E_ESP_WIC_TIMEOUT_N" 39 "MID_PA_E_EPS_SWA_TIMEOUT_N" 38 "MID_PA_E_INSTRCLUSTER4_TIMEOUT_N" 37 "MID_PA_E_INSTRCLUSTER5_TIMEOUT_N" 36 "MID_PA_E_INSTRCLUSTER3_TIMEOUT_N" 35 "MID_PA_E_INSTRCLUSTER2_TIMEOUT_N" 34 "MID_PA_E_ASIC_WTD_RESET_N" 33 "MID_PA_E_INSTRCLUSTER1_TIMEOUT_N" 32 "MID_PA_E_ASIC_LOW_VOLT_RESET_N" 31 "MID_PA_E_POWERMODE_TIMEOUT_N" 30 "MID_PA_E_ESP_PS_TIMEOUT_N" 29 "MID_PA_E_ESP_WIC_REAR_TIMEOUT_N" 28 "MID_PA_E_TRAILER_ATTACH_INVALID_N" 27 "MID_PA_E_EXTERNAL_EPS_FAILURE_N" 26 "MID_PA_E_PSX_ACTIVATION_INVALID_N" 25 "MID_PA_E_ESP_WHEELVELO_TIMEOUT_N" 24 "MID_PA_E_ESP_LONGACC_TIMEOUT_N" 23 "MID_PA_E_VEH_DYN_INTERVENTION_INVALID_N" 22 "MID_ZPA_E_PS_MODE_INVALID_N" 21 "MID_ZPA_E_EPS_ERROR_INVALID_N" 20 "MID_ZPA_E1_ESP_PSState_INVALID_N" 19 "MID_ZPA_E2_BdaUss01BlindnessDetect_N" 18 "MID_ZPA_E2_BdaUss02BlindnessDetect_N" 17 "MID_ZPA_E2_BdaUss03BlindnessDetect_N" 16 "MID_ZPA_E2_BdaUss10BlindnessDetect_N" 15 "MID_ZPA_E2_BdaUss05BlindnessDetect_N" 14 "MID_ZPA_E2_BdaUss11BlindnessDetect_N" 13 "MID_ZPA_E2_BdaUss07BlindnessDetect_N" 12 "MID_ZPA_E2_BdaUss12BlindnessDetect_N" 11 "MID_ZPA_E2_BdaUss06BlindnessDetect_N" 10 "MID_ZPA_E2_BdaUss08BlindnessDetect_N" 9 "MID_ZPA_E2_BdaUss13BlindnessDetect_N" 8 "MID_ZPA_E2_BdaUss09BlindnessDetect_N" 7 "MID_ZPA_E2_BdaUss04BlindnessDetect_N" 6 "MID_ZPA_E2_BdaUss14BlindnessDetect_N" 5 "MID_FLS_E_READ_FAILED_N" 4 "MID_FLS_E_COMPARE_FAILED_N" 3 "MID_FLS_E_ERASE_FAILED_N" 2 "MID_FLS_E_WRITE_FAILED_N" 1 "MID_NO_FAULT_N" 0 "MID_INVALID" ;
VAL_ 1486 PARK_sw054_ambTemp 255 "UNKNOWN" ;
VAL_ 1486 PARK_sw054_voltage 255 "UNKNOWN" ;
VAL_ 1486 PARK_sw054_subCode 254 "MID_ADC_E_TOUT_N" 253 "MID_ADC_E_INIT_FAILURE_N" 252 "MID_CAN_E_TIMEOUT_N" 251 "MID_CANIF_E_FULL_TX_BUFFER_N" 250 "MID_CANIF_E_INVALID_DLC_N" 249 "MID_CANIF_E_INVALID_TXPDUID_N" 248 "MID_CANIF_E_STOPPED_N" 247 "MID_CANNM_E_CANIF_TRANSMIT_ERROR_N" 246 "MID_CANNM_E_INIT_FAILED_N" 245 "MID_CANNM_E_NETWORK_TIMEOUT_N" 244 "MID_CANSM_E_BUSOFF_NETWORK_N" 243 "MID_CANTP_E_COM_DIAMANT_N" 242 "MID_ECU_E_EEP_DATAFLASH_LAYOUT_N" 241 "MID_ECU_E_RAM_N" 240 "MID_ECU_E_ROM_N" 239 "MID_FEE_E_LAYOUT_FAILED_N" 238 "MID_NVM_E_CONFIG_FAILED_N" 237 "MID_CAN_DASInvalidData_N" 236 "MID_CAN_C_BUSOFF_N" 235 "MID_NVM_E_INTEGRITY_FAILED_N" 234 "MID_NVM_E_REQ_FAILED_N" 233 "MID_PA_E_ASIC_COM_FAILURE_N" 232 "MID_PA_E_ASIC_HW_FAILURE_N" 231 "MID_PA_E_ENGINE_START_INVALID_N" 230 "MID_PA_E_EPS_STATUS_INVALID_N" 229 "MID_PA_E_GEAR_INVALID_N" 228 "MID_PA_E_LONG_ACC_INVALID_N" 227 "MID_PA_E_OUTSIDE_TEMP_INVALID_N" 226 "MID_CAN_EPASInvalidData_N" 225 "MID_PA_E_SPEED_INVALID_N" 224 "MID_PA_E_SVA_BLOCKED_USS_FL_N" 223 "MID_PA_E_SVA_BLOCKED_USS_FR_N" 222 "MID_PA_E_SVA_BLOCKED_USS_RL_N" 221 "MID_PA_E_SVA_BLOCKED_USS_RR_N" 220 "MID_PA_E_SWA_INVALID_N" 219 "MID_PA_E_SWCPA_APT_MONITOR_FAILURE_N" 218 "MID_PA_E_SWCPA_INHIBIT_HSS_PWRLOCK_N" 217 "MID_PA_E_SWCPA_INIT_FAILURE_N" 216 "MID_PA_E_SWCPA_PARFAILURE_N" 215 "MID_CAN_EPBInvalidData_N" 214 "MID_PA_E_UBAT_HIGH_N" 213 "MID_PA_E_UBAT_LOW_N" 212 "MID_PA_E_USENS_OVERTEMPERATURE_N" 211 "MID_PA_E_USENS_OVERVOLTAGE_N" 210 "MID_PA_E_USENS_SHORT_2_GND_N" 209 "MID_PA_E_USENS_SHORT_2_UBAT_N" 208 "MID_PA_E_USENS_UNDERVOLTAGE_N" 207 "MID_PA_E_USS_01_NO_COM_N" 206 "MID_PA_E_USS_01_OPEN_N" 205 "MID_PA_E_USS_01_RING_TOO_SHORT_N" 204 "MID_PA_E_USS_01_RINGING_TOO_LONG_N" 203 "MID_PA_E_USS_01_SHORT_2_GND_N" 202 "MID_PA_E_USS_01_SHORT_2_USENS_N" 201 "MID_PA_E_USS_01_STATE_COM_VERIFIED_N" 200 "MID_PA_E_USS_01_STATE_OFFSET_N" 199 "MID_PA_E_USS_01_STATE_PROG_N" 198 "MID_PA_E_USS_01_STATE_TYPE_N" 197 "MID_PA_E_USS_02_NO_COM_N" 196 "MID_PA_E_USS_02_OPEN_N" 195 "MID_PA_E_USS_02_RING_TOO_SHORT_N" 194 "MID_PA_E_USS_02_RINGING_TOO_LONG_N" 193 "MID_PA_E_USS_02_SHORT_2_GND_N" 192 "MID_PA_E_USS_02_SHORT_2_USENS_N" 191 "MID_PA_E_USS_02_STATE_COM_VERIFIED_N" 190 "MID_PA_E_USS_02_STATE_OFFSET_N" 189 "MID_PA_E_USS_02_STATE_PROG_N" 188 "MID_PA_E_USS_02_STATE_TYPE_N" 187 "MID_PA_E_USS_03_NO_COM_N" 186 "MID_PA_E_USS_03_OPEN_N" 185 "MID_PA_E_USS_03_RING_TOO_SHORT_N" 184 "MID_PA_E_USS_03_RINGING_TOO_LONG_N" 183 "MID_PA_E_USS_03_SHORT_2_GND_N" 182 "MID_PA_E_USS_03_SHORT_2_USENS_N" 181 "MID_PA_E_USS_03_STATE_COM_VERIFIED_N" 180 "MID_PA_E_USS_03_STATE_OFFSET_N" 179 "MID_PA_E_USS_03_STATE_PROG_N" 178 "MID_PA_E_USS_03_STATE_TYPE_N" 177 "MID_PA_E_USS_04_NO_COM_N" 176 "MID_PA_E_USS_04_OPEN_N" 175 "MID_PA_E_USS_04_RING_TOO_SHORT_N" 174 "MID_PA_E_USS_04_RINGING_TOO_LONG_N" 173 "MID_PA_E_USS_04_SHORT_2_GND_N" 172 "MID_PA_E_USS_04_SHORT_2_USENS_N" 171 "MID_PA_E_USS_04_STATE_COM_VERIFIED_N" 170 "MID_PA_E_USS_04_STATE_OFFSET_N" 169 "MID_PA_E_USS_04_STATE_PROG_N" 168 "MID_PA_E_USS_04_STATE_TYPE_N" 167 "MID_PA_E_USS_05_NO_COM_N" 166 "MID_PA_E_USS_05_OPEN_N" 165 "MID_PA_E_USS_05_RING_TOO_SHORT_N" 164 "MID_PA_E_USS_05_RINGING_TOO_LONG_N" 163 "MID_PA_E_USS_05_SHORT_2_GND_N" 162 "MID_PA_E_USS_05_SHORT_2_USENS_N" 161 "MID_PA_E_USS_05_STATE_COM_VERIFIED_N" 160 "MID_PA_E_USS_05_STATE_OFFSET_N" 159 "MID_PA_E_USS_05_STATE_PROG_N" 158 "MID_PA_E_USS_05_STATE_TYPE_N" 157 "MID_PA_E_USS_06_NO_COM_N" 156 "MID_PA_E_USS_06_OPEN_N" 155 "MID_PA_E_USS_06_RING_TOO_SHORT_N" 154 "MID_PA_E_USS_06_RINGING_TOO_LONG_N" 153 "MID_PA_E_USS_06_SHORT_2_GND_N" 152 "MID_PA_E_USS_06_SHORT_2_USENS_N" 151 "MID_PA_E_USS_06_STATE_COM_VERIFIED_N" 150 "MID_PA_E_USS_06_STATE_OFFSET_N" 149 "MID_PA_E_USS_06_STATE_PROG_N" 148 "MID_PA_E_USS_06_STATE_TYPE_N" 147 "MID_CAN_ESPInvalidData_N" 146 "MID_CAN_GTWInvalidData_N" 145 "MID_CAN_SCCMInvalidData_N" 144 "MID_CAN_DASLossOfCommunication_N" 143 "MID_CAN_EPASLossOfCommunication_N" 142 "MID_CAN_EPBLossOfCommunication_N" 141 "MID_CAN_ESPLossOfCommunication_N" 140 "MID_CAN_GTWLossOfCommunication_N" 139 "MID_CAN_SCCMLossOfCommunication_N" 138 "MID_PA_E_USS_08_NO_COM_N" 137 "MID_PA_E_USS_08_OPEN_N" 136 "MID_PA_E_USS_08_RING_TOO_SHORT_N" 135 "MID_PA_E_USS_08_RINGING_TOO_LONG_N" 134 "MID_PA_E_USS_08_SHORT_2_GND_N" 133 "MID_PA_E_USS_08_SHORT_2_USENS_N" 132 "MID_PA_E_USS_08_STATE_COM_VERIFIED_N" 131 "MID_PA_E_USS_08_STATE_OFFSET_N" 130 "MID_PA_E_USS_08_STATE_PROG_N" 129 "MID_PA_E_USS_08_STATE_TYPE_N" 128 "MID_PA_E_USS_09_NO_COM_N" 127 "MID_PA_E_USS_09_OPEN_N" 126 "MID_PA_E_USS_09_RING_TOO_SHORT_N" 125 "MID_PA_E_USS_09_RINGING_TOO_LONG_N" 124 "MID_PA_E_USS_09_SHORT_2_GND_N" 123 "MID_PA_E_USS_09_SHORT_2_USENS_N" 122 "MID_PA_E_USS_09_STATE_COM_VERIFIED_N" 121 "MID_PA_E_USS_09_STATE_OFFSET_N" 120 "MID_PA_E_USS_09_STATE_PROG_N" 119 "MID_PA_E_USS_09_STATE_TYPE_N" 118 "MID_PA_E_USS_10_NO_COM_N" 117 "MID_PA_E_USS_10_OPEN_N" 116 "MID_PA_E_USS_10_RING_TOO_SHORT_N" 115 "MID_PA_E_USS_10_RINGING_TOO_LONG_N" 114 "MID_PA_E_USS_10_SHORT_2_GND_N" 113 "MID_PA_E_USS_10_SHORT_2_USENS_N" 112 "MID_PA_E_USS_10_STATE_COM_VERIFIED_N" 111 "MID_PA_E_USS_10_STATE_OFFSET_N" 110 "MID_PA_E_USS_10_STATE_PROG_N" 109 "MID_PA_E_USS_10_STATE_TYPE_N" 108 "MID_PA_E_USS_11_NO_COM_N" 107 "MID_PA_E_USS_11_OPEN_N" 106 "MID_PA_E_USS_11_RING_TOO_SHORT_N" 105 "MID_PA_E_USS_11_RINGING_TOO_LONG_N" 104 "MID_PA_E_USS_11_SHORT_2_GND_N" 103 "MID_PA_E_USS_11_SHORT_2_USENS_N" 102 "MID_PA_E_USS_11_STATE_COM_VERIFIED_N" 101 "MID_PA_E_USS_11_STATE_OFFSET_N" 100 "MID_PA_E_USS_11_STATE_PROG_N" 99 "MID_PA_E_USS_11_STATE_TYPE_N" 98 "MID_PA_E_USS_12_NO_COM_N" 97 "MID_PA_E_USS_12_OPEN_N" 96 "MID_PA_E_USS_12_RING_TOO_SHORT_N" 95 "MID_PA_E_USS_12_RINGING_TOO_LONG_N" 94 "MID_PA_E_USS_12_SHORT_2_GND_N" 93 "MID_PA_E_USS_12_SHORT_2_USENS_N" 92 "MID_PA_E_USS_12_STATE_COM_VERIFIED_N" 91 "MID_PA_E_USS_12_STATE_OFFSET_N" 90 "MID_PA_E_USS_12_STATE_PROG_N" 89 "MID_PA_E_USS_12_STATE_TYPE_N" 88 "MID_PA_E_USS_13_NO_COM_N" 87 "MID_PA_E_USS_13_OPEN_N" 86 "MID_PA_E_USS_13_RING_TOO_SHORT_N" 85 "MID_PA_E_USS_13_RINGING_TOO_LONG_N" 84 "MID_PA_E_USS_13_SHORT_2_GND_N" 83 "MID_PA_E_USS_13_SHORT_2_USENS_N" 82 "MID_PA_E_USS_13_STATE_COM_VERIFIED_N" 81 "MID_PA_E_USS_13_STATE_OFFSET_N" 80 "MID_PA_E_USS_13_STATE_PROG_N" 79 "MID_PA_E_USS_13_STATE_TYPE_N" 78 "MID_PA_E_SVA_BLOCKED_USS_ML_N" 77 "MID_PA_E_SVA_BLOCKED_USS_MR_N" 76 "MID_PA_E_WHEEL_DIR_FL_INVALID_N" 75 "MID_PA_E_WHEEL_DIR_FR_INVALID_N" 74 "MID_PA_E_WHEEL_DIR_RL_INVALID_N" 73 "MID_PA_E_WHEEL_DIR_RR_INVALID_N" 72 "MID_PA_E_WHEEL_ROTATION_FL_INVALID_N" 71 "MID_PA_E_WHEEL_ROTATION_FR_INVALID_N" 70 "MID_PA_E_WHEEL_ROTATION_RL_INVALID_N" 69 "MID_PA_E_WHEEL_ROTATION_RR_INVALID_N" 68 "MID_PA_E_WICFL_INVALID_N" 67 "MID_PA_E_WICFR_INVALID_N" 66 "MID_PA_E_WICRL_INVALID_N" 65 "MID_PA_E_WICRR_INVALID_N" 64 "MID_PA_E_YAW_RATE_INVALID_N" 63 "MID_PDUR_E_INIT_FAILED_N" 62 "MID_PDUR_E_PDU_INSTANCE_LOST_N" 61 "MID_COMM_E_NET_START_IND_CHANNEL_0_N" 60 "MID_SPI_E_DMA_TRANSFER_N" 59 "MID_SPI_E_RECEIVE_OVERFLOW_N" 58 "MID_SPI_E_TRANSFER_TIMEOUT_N" 57 "MID_PA_E_VEHDYNINTERVENTION_TIMEOUT_N" 56 "MID_TRAILER_HITCH_PRES_INVALID_N" 55 "MID_PA_E_CL15_STATE_INVALID_N" 54 "MID_PA_E_YAW_RATE_SIGN_INVALID_N" 53 "MID_PA_E_ESP_WIC_FRONT_TIMEOUT_N" 52 "MID_PA_E_SEQ_CALL_FAILURE_N" 51 "MID_PA_E_HMI_FUNCACTIVATION_TIMEOUT_N" 50 "MID_PA_E_LOWBEAM_INVALID_N" 49 "MID_PA_E_ENGINESTART_TIMEOUT_N" 48 "MID_ADC_E_VREF_N" 47 "MID_PA_E_ESP_YAW_TIMEOUT_N" 46 "MID_PA_E_TCM_PRG_TIMEOUT_N" 45 "MID_WDG_E_MODE_SWITCH_FAILED_N" 44 "MID_WDG_E_DISABLE_REJECTED_N" 43 "MID_PA_E_ESP_WHEELDIR_TIMEOUT_N" 42 "MID_PA_E_SWCPA_E_INIT_FAILURE_N" 41 "MID_PA_E_DIR_INDICATOR_INVALID_N" 40 "MID_PA_E_ESP_WIC_TIMEOUT_N" 39 "MID_PA_E_EPS_SWA_TIMEOUT_N" 38 "MID_PA_E_INSTRCLUSTER4_TIMEOUT_N" 37 "MID_PA_E_INSTRCLUSTER5_TIMEOUT_N" 36 "MID_PA_E_INSTRCLUSTER3_TIMEOUT_N" 35 "MID_PA_E_INSTRCLUSTER2_TIMEOUT_N" 34 "MID_PA_E_ASIC_WTD_RESET_N" 33 "MID_PA_E_INSTRCLUSTER1_TIMEOUT_N" 32 "MID_PA_E_ASIC_LOW_VOLT_RESET_N" 31 "MID_PA_E_POWERMODE_TIMEOUT_N" 30 "MID_PA_E_ESP_PS_TIMEOUT_N" 29 "MID_PA_E_ESP_WIC_REAR_TIMEOUT_N" 28 "MID_PA_E_TRAILER_ATTACH_INVALID_N" 27 "MID_PA_E_EXTERNAL_EPS_FAILURE_N" 26 "MID_PA_E_PSX_ACTIVATION_INVALID_N" 25 "MID_PA_E_ESP_WHEELVELO_TIMEOUT_N" 24 "MID_PA_E_ESP_LONGACC_TIMEOUT_N" 23 "MID_PA_E_VEH_DYN_INTERVENTION_INVALID_N" 22 "MID_ZPA_E_PS_MODE_INVALID_N" 21 "MID_ZPA_E_EPS_ERROR_INVALID_N" 20 "MID_ZPA_E1_ESP_PSState_INVALID_N" 19 "MID_ZPA_E2_BdaUss01BlindnessDetect_N" 18 "MID_ZPA_E2_BdaUss02BlindnessDetect_N" 17 "MID_ZPA_E2_BdaUss03BlindnessDetect_N" 16 "MID_ZPA_E2_BdaUss10BlindnessDetect_N" 15 "MID_ZPA_E2_BdaUss05BlindnessDetect_N" 14 "MID_ZPA_E2_BdaUss11BlindnessDetect_N" 13 "MID_ZPA_E2_BdaUss07BlindnessDetect_N" 12 "MID_ZPA_E2_BdaUss12BlindnessDetect_N" 11 "MID_ZPA_E2_BdaUss06BlindnessDetect_N" 10 "MID_ZPA_E2_BdaUss08BlindnessDetect_N" 9 "MID_ZPA_E2_BdaUss13BlindnessDetect_N" 8 "MID_ZPA_E2_BdaUss09BlindnessDetect_N" 7 "MID_ZPA_E2_BdaUss04BlindnessDetect_N" 6 "MID_ZPA_E2_BdaUss14BlindnessDetect_N" 5 "MID_FLS_E_READ_FAILED_N" 4 "MID_FLS_E_COMPARE_FAILED_N" 3 "MID_FLS_E_ERASE_FAILED_N" 2 "MID_FLS_E_WRITE_FAILED_N" 1 "MID_NO_FAULT_N" 0 "MID_INVALID" ;
VAL_ 1486 PARK_sw055_ambTemp 255 "UNKNOWN" ;
VAL_ 1486 PARK_sw055_voltage 255 "UNKNOWN" ;
VAL_ 1486 PARK_sw055_subCode 254 "MID_ADC_E_TOUT_N" 253 "MID_ADC_E_INIT_FAILURE_N" 252 "MID_CAN_E_TIMEOUT_N" 251 "MID_CANIF_E_FULL_TX_BUFFER_N" 250 "MID_CANIF_E_INVALID_DLC_N" 249 "MID_CANIF_E_INVALID_TXPDUID_N" 248 "MID_CANIF_E_STOPPED_N" 247 "MID_CANNM_E_CANIF_TRANSMIT_ERROR_N" 246 "MID_CANNM_E_INIT_FAILED_N" 245 "MID_CANNM_E_NETWORK_TIMEOUT_N" 244 "MID_CANSM_E_BUSOFF_NETWORK_N" 243 "MID_CANTP_E_COM_DIAMANT_N" 242 "MID_ECU_E_EEP_DATAFLASH_LAYOUT_N" 241 "MID_ECU_E_RAM_N" 240 "MID_ECU_E_ROM_N" 239 "MID_FEE_E_LAYOUT_FAILED_N" 238 "MID_NVM_E_CONFIG_FAILED_N" 237 "MID_CAN_DASInvalidData_N" 236 "MID_CAN_C_BUSOFF_N" 235 "MID_NVM_E_INTEGRITY_FAILED_N" 234 "MID_NVM_E_REQ_FAILED_N" 233 "MID_PA_E_ASIC_COM_FAILURE_N" 232 "MID_PA_E_ASIC_HW_FAILURE_N" 231 "MID_PA_E_ENGINE_START_INVALID_N" 230 "MID_PA_E_EPS_STATUS_INVALID_N" 229 "MID_PA_E_GEAR_INVALID_N" 228 "MID_PA_E_LONG_ACC_INVALID_N" 227 "MID_PA_E_OUTSIDE_TEMP_INVALID_N" 226 "MID_CAN_EPASInvalidData_N" 225 "MID_PA_E_SPEED_INVALID_N" 224 "MID_PA_E_SVA_BLOCKED_USS_FL_N" 223 "MID_PA_E_SVA_BLOCKED_USS_FR_N" 222 "MID_PA_E_SVA_BLOCKED_USS_RL_N" 221 "MID_PA_E_SVA_BLOCKED_USS_RR_N" 220 "MID_PA_E_SWA_INVALID_N" 219 "MID_PA_E_SWCPA_APT_MONITOR_FAILURE_N" 218 "MID_PA_E_SWCPA_INHIBIT_HSS_PWRLOCK_N" 217 "MID_PA_E_SWCPA_INIT_FAILURE_N" 216 "MID_PA_E_SWCPA_PARFAILURE_N" 215 "MID_CAN_EPBInvalidData_N" 214 "MID_PA_E_UBAT_HIGH_N" 213 "MID_PA_E_UBAT_LOW_N" 212 "MID_PA_E_USENS_OVERTEMPERATURE_N" 211 "MID_PA_E_USENS_OVERVOLTAGE_N" 210 "MID_PA_E_USENS_SHORT_2_GND_N" 209 "MID_PA_E_USENS_SHORT_2_UBAT_N" 208 "MID_PA_E_USENS_UNDERVOLTAGE_N" 207 "MID_PA_E_USS_01_NO_COM_N" 206 "MID_PA_E_USS_01_OPEN_N" 205 "MID_PA_E_USS_01_RING_TOO_SHORT_N" 204 "MID_PA_E_USS_01_RINGING_TOO_LONG_N" 203 "MID_PA_E_USS_01_SHORT_2_GND_N" 202 "MID_PA_E_USS_01_SHORT_2_USENS_N" 201 "MID_PA_E_USS_01_STATE_COM_VERIFIED_N" 200 "MID_PA_E_USS_01_STATE_OFFSET_N" 199 "MID_PA_E_USS_01_STATE_PROG_N" 198 "MID_PA_E_USS_01_STATE_TYPE_N" 197 "MID_PA_E_USS_02_NO_COM_N" 196 "MID_PA_E_USS_02_OPEN_N" 195 "MID_PA_E_USS_02_RING_TOO_SHORT_N" 194 "MID_PA_E_USS_02_RINGING_TOO_LONG_N" 193 "MID_PA_E_USS_02_SHORT_2_GND_N" 192 "MID_PA_E_USS_02_SHORT_2_USENS_N" 191 "MID_PA_E_USS_02_STATE_COM_VERIFIED_N" 190 "MID_PA_E_USS_02_STATE_OFFSET_N" 189 "MID_PA_E_USS_02_STATE_PROG_N" 188 "MID_PA_E_USS_02_STATE_TYPE_N" 187 "MID_PA_E_USS_03_NO_COM_N" 186 "MID_PA_E_USS_03_OPEN_N" 185 "MID_PA_E_USS_03_RING_TOO_SHORT_N" 184 "MID_PA_E_USS_03_RINGING_TOO_LONG_N" 183 "MID_PA_E_USS_03_SHORT_2_GND_N" 182 "MID_PA_E_USS_03_SHORT_2_USENS_N" 181 "MID_PA_E_USS_03_STATE_COM_VERIFIED_N" 180 "MID_PA_E_USS_03_STATE_OFFSET_N" 179 "MID_PA_E_USS_03_STATE_PROG_N" 178 "MID_PA_E_USS_03_STATE_TYPE_N" 177 "MID_PA_E_USS_04_NO_COM_N" 176 "MID_PA_E_USS_04_OPEN_N" 175 "MID_PA_E_USS_04_RING_TOO_SHORT_N" 174 "MID_PA_E_USS_04_RINGING_TOO_LONG_N" 173 "MID_PA_E_USS_04_SHORT_2_GND_N" 172 "MID_PA_E_USS_04_SHORT_2_USENS_N" 171 "MID_PA_E_USS_04_STATE_COM_VERIFIED_N" 170 "MID_PA_E_USS_04_STATE_OFFSET_N" 169 "MID_PA_E_USS_04_STATE_PROG_N" 168 "MID_PA_E_USS_04_STATE_TYPE_N" 167 "MID_PA_E_USS_05_NO_COM_N" 166 "MID_PA_E_USS_05_OPEN_N" 165 "MID_PA_E_USS_05_RING_TOO_SHORT_N" 164 "MID_PA_E_USS_05_RINGING_TOO_LONG_N" 163 "MID_PA_E_USS_05_SHORT_2_GND_N" 162 "MID_PA_E_USS_05_SHORT_2_USENS_N" 161 "MID_PA_E_USS_05_STATE_COM_VERIFIED_N" 160 "MID_PA_E_USS_05_STATE_OFFSET_N" 159 "MID_PA_E_USS_05_STATE_PROG_N" 158 "MID_PA_E_USS_05_STATE_TYPE_N" 157 "MID_PA_E_USS_06_NO_COM_N" 156 "MID_PA_E_USS_06_OPEN_N" 155 "MID_PA_E_USS_06_RING_TOO_SHORT_N" 154 "MID_PA_E_USS_06_RINGING_TOO_LONG_N" 153 "MID_PA_E_USS_06_SHORT_2_GND_N" 152 "MID_PA_E_USS_06_SHORT_2_USENS_N" 151 "MID_PA_E_USS_06_STATE_COM_VERIFIED_N" 150 "MID_PA_E_USS_06_STATE_OFFSET_N" 149 "MID_PA_E_USS_06_STATE_PROG_N" 148 "MID_PA_E_USS_06_STATE_TYPE_N" 147 "MID_CAN_ESPInvalidData_N" 146 "MID_CAN_GTWInvalidData_N" 145 "MID_CAN_SCCMInvalidData_N" 144 "MID_CAN_DASLossOfCommunication_N" 143 "MID_CAN_EPASLossOfCommunication_N" 142 "MID_CAN_EPBLossOfCommunication_N" 141 "MID_CAN_ESPLossOfCommunication_N" 140 "MID_CAN_GTWLossOfCommunication_N" 139 "MID_CAN_SCCMLossOfCommunication_N" 138 "MID_PA_E_USS_08_NO_COM_N" 137 "MID_PA_E_USS_08_OPEN_N" 136 "MID_PA_E_USS_08_RING_TOO_SHORT_N" 135 "MID_PA_E_USS_08_RINGING_TOO_LONG_N" 134 "MID_PA_E_USS_08_SHORT_2_GND_N" 133 "MID_PA_E_USS_08_SHORT_2_USENS_N" 132 "MID_PA_E_USS_08_STATE_COM_VERIFIED_N" 131 "MID_PA_E_USS_08_STATE_OFFSET_N" 130 "MID_PA_E_USS_08_STATE_PROG_N" 129 "MID_PA_E_USS_08_STATE_TYPE_N" 128 "MID_PA_E_USS_09_NO_COM_N" 127 "MID_PA_E_USS_09_OPEN_N" 126 "MID_PA_E_USS_09_RING_TOO_SHORT_N" 125 "MID_PA_E_USS_09_RINGING_TOO_LONG_N" 124 "MID_PA_E_USS_09_SHORT_2_GND_N" 123 "MID_PA_E_USS_09_SHORT_2_USENS_N" 122 "MID_PA_E_USS_09_STATE_COM_VERIFIED_N" 121 "MID_PA_E_USS_09_STATE_OFFSET_N" 120 "MID_PA_E_USS_09_STATE_PROG_N" 119 "MID_PA_E_USS_09_STATE_TYPE_N" 118 "MID_PA_E_USS_10_NO_COM_N" 117 "MID_PA_E_USS_10_OPEN_N" 116 "MID_PA_E_USS_10_RING_TOO_SHORT_N" 115 "MID_PA_E_USS_10_RINGING_TOO_LONG_N" 114 "MID_PA_E_USS_10_SHORT_2_GND_N" 113 "MID_PA_E_USS_10_SHORT_2_USENS_N" 112 "MID_PA_E_USS_10_STATE_COM_VERIFIED_N" 111 "MID_PA_E_USS_10_STATE_OFFSET_N" 110 "MID_PA_E_USS_10_STATE_PROG_N" 109 "MID_PA_E_USS_10_STATE_TYPE_N" 108 "MID_PA_E_USS_11_NO_COM_N" 107 "MID_PA_E_USS_11_OPEN_N" 106 "MID_PA_E_USS_11_RING_TOO_SHORT_N" 105 "MID_PA_E_USS_11_RINGING_TOO_LONG_N" 104 "MID_PA_E_USS_11_SHORT_2_GND_N" 103 "MID_PA_E_USS_11_SHORT_2_USENS_N" 102 "MID_PA_E_USS_11_STATE_COM_VERIFIED_N" 101 "MID_PA_E_USS_11_STATE_OFFSET_N" 100 "MID_PA_E_USS_11_STATE_PROG_N" 99 "MID_PA_E_USS_11_STATE_TYPE_N" 98 "MID_PA_E_USS_12_NO_COM_N" 97 "MID_PA_E_USS_12_OPEN_N" 96 "MID_PA_E_USS_12_RING_TOO_SHORT_N" 95 "MID_PA_E_USS_12_RINGING_TOO_LONG_N" 94 "MID_PA_E_USS_12_SHORT_2_GND_N" 93 "MID_PA_E_USS_12_SHORT_2_USENS_N" 92 "MID_PA_E_USS_12_STATE_COM_VERIFIED_N" 91 "MID_PA_E_USS_12_STATE_OFFSET_N" 90 "MID_PA_E_USS_12_STATE_PROG_N" 89 "MID_PA_E_USS_12_STATE_TYPE_N" 88 "MID_PA_E_USS_13_NO_COM_N" 87 "MID_PA_E_USS_13_OPEN_N" 86 "MID_PA_E_USS_13_RING_TOO_SHORT_N" 85 "MID_PA_E_USS_13_RINGING_TOO_LONG_N" 84 "MID_PA_E_USS_13_SHORT_2_GND_N" 83 "MID_PA_E_USS_13_SHORT_2_USENS_N" 82 "MID_PA_E_USS_13_STATE_COM_VERIFIED_N" 81 "MID_PA_E_USS_13_STATE_OFFSET_N" 80 "MID_PA_E_USS_13_STATE_PROG_N" 79 "MID_PA_E_USS_13_STATE_TYPE_N" 78 "MID_PA_E_SVA_BLOCKED_USS_ML_N" 77 "MID_PA_E_SVA_BLOCKED_USS_MR_N" 76 "MID_PA_E_WHEEL_DIR_FL_INVALID_N" 75 "MID_PA_E_WHEEL_DIR_FR_INVALID_N" 74 "MID_PA_E_WHEEL_DIR_RL_INVALID_N" 73 "MID_PA_E_WHEEL_DIR_RR_INVALID_N" 72 "MID_PA_E_WHEEL_ROTATION_FL_INVALID_N" 71 "MID_PA_E_WHEEL_ROTATION_FR_INVALID_N" 70 "MID_PA_E_WHEEL_ROTATION_RL_INVALID_N" 69 "MID_PA_E_WHEEL_ROTATION_RR_INVALID_N" 68 "MID_PA_E_WICFL_INVALID_N" 67 "MID_PA_E_WICFR_INVALID_N" 66 "MID_PA_E_WICRL_INVALID_N" 65 "MID_PA_E_WICRR_INVALID_N" 64 "MID_PA_E_YAW_RATE_INVALID_N" 63 "MID_PDUR_E_INIT_FAILED_N" 62 "MID_PDUR_E_PDU_INSTANCE_LOST_N" 61 "MID_COMM_E_NET_START_IND_CHANNEL_0_N" 60 "MID_SPI_E_DMA_TRANSFER_N" 59 "MID_SPI_E_RECEIVE_OVERFLOW_N" 58 "MID_SPI_E_TRANSFER_TIMEOUT_N" 57 "MID_PA_E_VEHDYNINTERVENTION_TIMEOUT_N" 56 "MID_TRAILER_HITCH_PRES_INVALID_N" 55 "MID_PA_E_CL15_STATE_INVALID_N" 54 "MID_PA_E_YAW_RATE_SIGN_INVALID_N" 53 "MID_PA_E_ESP_WIC_FRONT_TIMEOUT_N" 52 "MID_PA_E_SEQ_CALL_FAILURE_N" 51 "MID_PA_E_HMI_FUNCACTIVATION_TIMEOUT_N" 50 "MID_PA_E_LOWBEAM_INVALID_N" 49 "MID_PA_E_ENGINESTART_TIMEOUT_N" 48 "MID_ADC_E_VREF_N" 47 "MID_PA_E_ESP_YAW_TIMEOUT_N" 46 "MID_PA_E_TCM_PRG_TIMEOUT_N" 45 "MID_WDG_E_MODE_SWITCH_FAILED_N" 44 "MID_WDG_E_DISABLE_REJECTED_N" 43 "MID_PA_E_ESP_WHEELDIR_TIMEOUT_N" 42 "MID_PA_E_SWCPA_E_INIT_FAILURE_N" 41 "MID_PA_E_DIR_INDICATOR_INVALID_N" 40 "MID_PA_E_ESP_WIC_TIMEOUT_N" 39 "MID_PA_E_EPS_SWA_TIMEOUT_N" 38 "MID_PA_E_INSTRCLUSTER4_TIMEOUT_N" 37 "MID_PA_E_INSTRCLUSTER5_TIMEOUT_N" 36 "MID_PA_E_INSTRCLUSTER3_TIMEOUT_N" 35 "MID_PA_E_INSTRCLUSTER2_TIMEOUT_N" 34 "MID_PA_E_ASIC_WTD_RESET_N" 33 "MID_PA_E_INSTRCLUSTER1_TIMEOUT_N" 32 "MID_PA_E_ASIC_LOW_VOLT_RESET_N" 31 "MID_PA_E_POWERMODE_TIMEOUT_N" 30 "MID_PA_E_ESP_PS_TIMEOUT_N" 29 "MID_PA_E_ESP_WIC_REAR_TIMEOUT_N" 28 "MID_PA_E_TRAILER_ATTACH_INVALID_N" 27 "MID_PA_E_EXTERNAL_EPS_FAILURE_N" 26 "MID_PA_E_PSX_ACTIVATION_INVALID_N" 25 "MID_PA_E_ESP_WHEELVELO_TIMEOUT_N" 24 "MID_PA_E_ESP_LONGACC_TIMEOUT_N" 23 "MID_PA_E_VEH_DYN_INTERVENTION_INVALID_N" 22 "MID_ZPA_E_PS_MODE_INVALID_N" 21 "MID_ZPA_E_EPS_ERROR_INVALID_N" 20 "MID_ZPA_E1_ESP_PSState_INVALID_N" 19 "MID_ZPA_E2_BdaUss01BlindnessDetect_N" 18 "MID_ZPA_E2_BdaUss02BlindnessDetect_N" 17 "MID_ZPA_E2_BdaUss03BlindnessDetect_N" 16 "MID_ZPA_E2_BdaUss10BlindnessDetect_N" 15 "MID_ZPA_E2_BdaUss05BlindnessDetect_N" 14 "MID_ZPA_E2_BdaUss11BlindnessDetect_N" 13 "MID_ZPA_E2_BdaUss07BlindnessDetect_N" 12 "MID_ZPA_E2_BdaUss12BlindnessDetect_N" 11 "MID_ZPA_E2_BdaUss06BlindnessDetect_N" 10 "MID_ZPA_E2_BdaUss08BlindnessDetect_N" 9 "MID_ZPA_E2_BdaUss13BlindnessDetect_N" 8 "MID_ZPA_E2_BdaUss09BlindnessDetect_N" 7 "MID_ZPA_E2_BdaUss04BlindnessDetect_N" 6 "MID_ZPA_E2_BdaUss14BlindnessDetect_N" 5 "MID_FLS_E_READ_FAILED_N" 4 "MID_FLS_E_COMPARE_FAILED_N" 3 "MID_FLS_E_ERASE_FAILED_N" 2 "MID_FLS_E_WRITE_FAILED_N" 1 "MID_NO_FAULT_N" 0 "MID_INVALID" ;
VAL_ 1486 PARK_sw056_ambTemp 255 "UNKNOWN" ;
VAL_ 1486 PARK_sw056_voltage 255 "UNKNOWN" ;
VAL_ 1486 PARK_sw056_subCode 254 "MID_ADC_E_TOUT_N" 253 "MID_ADC_E_INIT_FAILURE_N" 252 "MID_CAN_E_TIMEOUT_N" 251 "MID_CANIF_E_FULL_TX_BUFFER_N" 250 "MID_CANIF_E_INVALID_DLC_N" 249 "MID_CANIF_E_INVALID_TXPDUID_N" 248 "MID_CANIF_E_STOPPED_N" 247 "MID_CANNM_E_CANIF_TRANSMIT_ERROR_N" 246 "MID_CANNM_E_INIT_FAILED_N" 245 "MID_CANNM_E_NETWORK_TIMEOUT_N" 244 "MID_CANSM_E_BUSOFF_NETWORK_N" 243 "MID_CANTP_E_COM_DIAMANT_N" 242 "MID_ECU_E_EEP_DATAFLASH_LAYOUT_N" 241 "MID_ECU_E_RAM_N" 240 "MID_ECU_E_ROM_N" 239 "MID_FEE_E_LAYOUT_FAILED_N" 238 "MID_NVM_E_CONFIG_FAILED_N" 237 "MID_CAN_DASInvalidData_N" 236 "MID_CAN_C_BUSOFF_N" 235 "MID_NVM_E_INTEGRITY_FAILED_N" 234 "MID_NVM_E_REQ_FAILED_N" 233 "MID_PA_E_ASIC_COM_FAILURE_N" 232 "MID_PA_E_ASIC_HW_FAILURE_N" 231 "MID_PA_E_ENGINE_START_INVALID_N" 230 "MID_PA_E_EPS_STATUS_INVALID_N" 229 "MID_PA_E_GEAR_INVALID_N" 228 "MID_PA_E_LONG_ACC_INVALID_N" 227 "MID_PA_E_OUTSIDE_TEMP_INVALID_N" 226 "MID_CAN_EPASInvalidData_N" 225 "MID_PA_E_SPEED_INVALID_N" 224 "MID_PA_E_SVA_BLOCKED_USS_FL_N" 223 "MID_PA_E_SVA_BLOCKED_USS_FR_N" 222 "MID_PA_E_SVA_BLOCKED_USS_RL_N" 221 "MID_PA_E_SVA_BLOCKED_USS_RR_N" 220 "MID_PA_E_SWA_INVALID_N" 219 "MID_PA_E_SWCPA_APT_MONITOR_FAILURE_N" 218 "MID_PA_E_SWCPA_INHIBIT_HSS_PWRLOCK_N" 217 "MID_PA_E_SWCPA_INIT_FAILURE_N" 216 "MID_PA_E_SWCPA_PARFAILURE_N" 215 "MID_CAN_EPBInvalidData_N" 214 "MID_PA_E_UBAT_HIGH_N" 213 "MID_PA_E_UBAT_LOW_N" 212 "MID_PA_E_USENS_OVERTEMPERATURE_N" 211 "MID_PA_E_USENS_OVERVOLTAGE_N" 210 "MID_PA_E_USENS_SHORT_2_GND_N" 209 "MID_PA_E_USENS_SHORT_2_UBAT_N" 208 "MID_PA_E_USENS_UNDERVOLTAGE_N" 207 "MID_PA_E_USS_01_NO_COM_N" 206 "MID_PA_E_USS_01_OPEN_N" 205 "MID_PA_E_USS_01_RING_TOO_SHORT_N" 204 "MID_PA_E_USS_01_RINGING_TOO_LONG_N" 203 "MID_PA_E_USS_01_SHORT_2_GND_N" 202 "MID_PA_E_USS_01_SHORT_2_USENS_N" 201 "MID_PA_E_USS_01_STATE_COM_VERIFIED_N" 200 "MID_PA_E_USS_01_STATE_OFFSET_N" 199 "MID_PA_E_USS_01_STATE_PROG_N" 198 "MID_PA_E_USS_01_STATE_TYPE_N" 197 "MID_PA_E_USS_02_NO_COM_N" 196 "MID_PA_E_USS_02_OPEN_N" 195 "MID_PA_E_USS_02_RING_TOO_SHORT_N" 194 "MID_PA_E_USS_02_RINGING_TOO_LONG_N" 193 "MID_PA_E_USS_02_SHORT_2_GND_N" 192 "MID_PA_E_USS_02_SHORT_2_USENS_N" 191 "MID_PA_E_USS_02_STATE_COM_VERIFIED_N" 190 "MID_PA_E_USS_02_STATE_OFFSET_N" 189 "MID_PA_E_USS_02_STATE_PROG_N" 188 "MID_PA_E_USS_02_STATE_TYPE_N" 187 "MID_PA_E_USS_03_NO_COM_N" 186 "MID_PA_E_USS_03_OPEN_N" 185 "MID_PA_E_USS_03_RING_TOO_SHORT_N" 184 "MID_PA_E_USS_03_RINGING_TOO_LONG_N" 183 "MID_PA_E_USS_03_SHORT_2_GND_N" 182 "MID_PA_E_USS_03_SHORT_2_USENS_N" 181 "MID_PA_E_USS_03_STATE_COM_VERIFIED_N" 180 "MID_PA_E_USS_03_STATE_OFFSET_N" 179 "MID_PA_E_USS_03_STATE_PROG_N" 178 "MID_PA_E_USS_03_STATE_TYPE_N" 177 "MID_PA_E_USS_04_NO_COM_N" 176 "MID_PA_E_USS_04_OPEN_N" 175 "MID_PA_E_USS_04_RING_TOO_SHORT_N" 174 "MID_PA_E_USS_04_RINGING_TOO_LONG_N" 173 "MID_PA_E_USS_04_SHORT_2_GND_N" 172 "MID_PA_E_USS_04_SHORT_2_USENS_N" 171 "MID_PA_E_USS_04_STATE_COM_VERIFIED_N" 170 "MID_PA_E_USS_04_STATE_OFFSET_N" 169 "MID_PA_E_USS_04_STATE_PROG_N" 168 "MID_PA_E_USS_04_STATE_TYPE_N" 167 "MID_PA_E_USS_05_NO_COM_N" 166 "MID_PA_E_USS_05_OPEN_N" 165 "MID_PA_E_USS_05_RING_TOO_SHORT_N" 164 "MID_PA_E_USS_05_RINGING_TOO_LONG_N" 163 "MID_PA_E_USS_05_SHORT_2_GND_N" 162 "MID_PA_E_USS_05_SHORT_2_USENS_N" 161 "MID_PA_E_USS_05_STATE_COM_VERIFIED_N" 160 "MID_PA_E_USS_05_STATE_OFFSET_N" 159 "MID_PA_E_USS_05_STATE_PROG_N" 158 "MID_PA_E_USS_05_STATE_TYPE_N" 157 "MID_PA_E_USS_06_NO_COM_N" 156 "MID_PA_E_USS_06_OPEN_N" 155 "MID_PA_E_USS_06_RING_TOO_SHORT_N" 154 "MID_PA_E_USS_06_RINGING_TOO_LONG_N" 153 "MID_PA_E_USS_06_SHORT_2_GND_N" 152 "MID_PA_E_USS_06_SHORT_2_USENS_N" 151 "MID_PA_E_USS_06_STATE_COM_VERIFIED_N" 150 "MID_PA_E_USS_06_STATE_OFFSET_N" 149 "MID_PA_E_USS_06_STATE_PROG_N" 148 "MID_PA_E_USS_06_STATE_TYPE_N" 147 "MID_CAN_ESPInvalidData_N" 146 "MID_CAN_GTWInvalidData_N" 145 "MID_CAN_SCCMInvalidData_N" 144 "MID_CAN_DASLossOfCommunication_N" 143 "MID_CAN_EPASLossOfCommunication_N" 142 "MID_CAN_EPBLossOfCommunication_N" 141 "MID_CAN_ESPLossOfCommunication_N" 140 "MID_CAN_GTWLossOfCommunication_N" 139 "MID_CAN_SCCMLossOfCommunication_N" 138 "MID_PA_E_USS_08_NO_COM_N" 137 "MID_PA_E_USS_08_OPEN_N" 136 "MID_PA_E_USS_08_RING_TOO_SHORT_N" 135 "MID_PA_E_USS_08_RINGING_TOO_LONG_N" 134 "MID_PA_E_USS_08_SHORT_2_GND_N" 133 "MID_PA_E_USS_08_SHORT_2_USENS_N" 132 "MID_PA_E_USS_08_STATE_COM_VERIFIED_N" 131 "MID_PA_E_USS_08_STATE_OFFSET_N" 130 "MID_PA_E_USS_08_STATE_PROG_N" 129 "MID_PA_E_USS_08_STATE_TYPE_N" 128 "MID_PA_E_USS_09_NO_COM_N" 127 "MID_PA_E_USS_09_OPEN_N" 126 "MID_PA_E_USS_09_RING_TOO_SHORT_N" 125 "MID_PA_E_USS_09_RINGING_TOO_LONG_N" 124 "MID_PA_E_USS_09_SHORT_2_GND_N" 123 "MID_PA_E_USS_09_SHORT_2_USENS_N" 122 "MID_PA_E_USS_09_STATE_COM_VERIFIED_N" 121 "MID_PA_E_USS_09_STATE_OFFSET_N" 120 "MID_PA_E_USS_09_STATE_PROG_N" 119 "MID_PA_E_USS_09_STATE_TYPE_N" 118 "MID_PA_E_USS_10_NO_COM_N" 117 "MID_PA_E_USS_10_OPEN_N" 116 "MID_PA_E_USS_10_RING_TOO_SHORT_N" 115 "MID_PA_E_USS_10_RINGING_TOO_LONG_N" 114 "MID_PA_E_USS_10_SHORT_2_GND_N" 113 "MID_PA_E_USS_10_SHORT_2_USENS_N" 112 "MID_PA_E_USS_10_STATE_COM_VERIFIED_N" 111 "MID_PA_E_USS_10_STATE_OFFSET_N" 110 "MID_PA_E_USS_10_STATE_PROG_N" 109 "MID_PA_E_USS_10_STATE_TYPE_N" 108 "MID_PA_E_USS_11_NO_COM_N" 107 "MID_PA_E_USS_11_OPEN_N" 106 "MID_PA_E_USS_11_RING_TOO_SHORT_N" 105 "MID_PA_E_USS_11_RINGING_TOO_LONG_N" 104 "MID_PA_E_USS_11_SHORT_2_GND_N" 103 "MID_PA_E_USS_11_SHORT_2_USENS_N" 102 "MID_PA_E_USS_11_STATE_COM_VERIFIED_N" 101 "MID_PA_E_USS_11_STATE_OFFSET_N" 100 "MID_PA_E_USS_11_STATE_PROG_N" 99 "MID_PA_E_USS_11_STATE_TYPE_N" 98 "MID_PA_E_USS_12_NO_COM_N" 97 "MID_PA_E_USS_12_OPEN_N" 96 "MID_PA_E_USS_12_RING_TOO_SHORT_N" 95 "MID_PA_E_USS_12_RINGING_TOO_LONG_N" 94 "MID_PA_E_USS_12_SHORT_2_GND_N" 93 "MID_PA_E_USS_12_SHORT_2_USENS_N" 92 "MID_PA_E_USS_12_STATE_COM_VERIFIED_N" 91 "MID_PA_E_USS_12_STATE_OFFSET_N" 90 "MID_PA_E_USS_12_STATE_PROG_N" 89 "MID_PA_E_USS_12_STATE_TYPE_N" 88 "MID_PA_E_USS_13_NO_COM_N" 87 "MID_PA_E_USS_13_OPEN_N" 86 "MID_PA_E_USS_13_RING_TOO_SHORT_N" 85 "MID_PA_E_USS_13_RINGING_TOO_LONG_N" 84 "MID_PA_E_USS_13_SHORT_2_GND_N" 83 "MID_PA_E_USS_13_SHORT_2_USENS_N" 82 "MID_PA_E_USS_13_STATE_COM_VERIFIED_N" 81 "MID_PA_E_USS_13_STATE_OFFSET_N" 80 "MID_PA_E_USS_13_STATE_PROG_N" 79 "MID_PA_E_USS_13_STATE_TYPE_N" 78 "MID_PA_E_SVA_BLOCKED_USS_ML_N" 77 "MID_PA_E_SVA_BLOCKED_USS_MR_N" 76 "MID_PA_E_WHEEL_DIR_FL_INVALID_N" 75 "MID_PA_E_WHEEL_DIR_FR_INVALID_N" 74 "MID_PA_E_WHEEL_DIR_RL_INVALID_N" 73 "MID_PA_E_WHEEL_DIR_RR_INVALID_N" 72 "MID_PA_E_WHEEL_ROTATION_FL_INVALID_N" 71 "MID_PA_E_WHEEL_ROTATION_FR_INVALID_N" 70 "MID_PA_E_WHEEL_ROTATION_RL_INVALID_N" 69 "MID_PA_E_WHEEL_ROTATION_RR_INVALID_N" 68 "MID_PA_E_WICFL_INVALID_N" 67 "MID_PA_E_WICFR_INVALID_N" 66 "MID_PA_E_WICRL_INVALID_N" 65 "MID_PA_E_WICRR_INVALID_N" 64 "MID_PA_E_YAW_RATE_INVALID_N" 63 "MID_PDUR_E_INIT_FAILED_N" 62 "MID_PDUR_E_PDU_INSTANCE_LOST_N" 61 "MID_COMM_E_NET_START_IND_CHANNEL_0_N" 60 "MID_SPI_E_DMA_TRANSFER_N" 59 "MID_SPI_E_RECEIVE_OVERFLOW_N" 58 "MID_SPI_E_TRANSFER_TIMEOUT_N" 57 "MID_PA_E_VEHDYNINTERVENTION_TIMEOUT_N" 56 "MID_TRAILER_HITCH_PRES_INVALID_N" 55 "MID_PA_E_CL15_STATE_INVALID_N" 54 "MID_PA_E_YAW_RATE_SIGN_INVALID_N" 53 "MID_PA_E_ESP_WIC_FRONT_TIMEOUT_N" 52 "MID_PA_E_SEQ_CALL_FAILURE_N" 51 "MID_PA_E_HMI_FUNCACTIVATION_TIMEOUT_N" 50 "MID_PA_E_LOWBEAM_INVALID_N" 49 "MID_PA_E_ENGINESTART_TIMEOUT_N" 48 "MID_ADC_E_VREF_N" 47 "MID_PA_E_ESP_YAW_TIMEOUT_N" 46 "MID_PA_E_TCM_PRG_TIMEOUT_N" 45 "MID_WDG_E_MODE_SWITCH_FAILED_N" 44 "MID_WDG_E_DISABLE_REJECTED_N" 43 "MID_PA_E_ESP_WHEELDIR_TIMEOUT_N" 42 "MID_PA_E_SWCPA_E_INIT_FAILURE_N" 41 "MID_PA_E_DIR_INDICATOR_INVALID_N" 40 "MID_PA_E_ESP_WIC_TIMEOUT_N" 39 "MID_PA_E_EPS_SWA_TIMEOUT_N" 38 "MID_PA_E_INSTRCLUSTER4_TIMEOUT_N" 37 "MID_PA_E_INSTRCLUSTER5_TIMEOUT_N" 36 "MID_PA_E_INSTRCLUSTER3_TIMEOUT_N" 35 "MID_PA_E_INSTRCLUSTER2_TIMEOUT_N" 34 "MID_PA_E_ASIC_WTD_RESET_N" 33 "MID_PA_E_INSTRCLUSTER1_TIMEOUT_N" 32 "MID_PA_E_ASIC_LOW_VOLT_RESET_N" 31 "MID_PA_E_POWERMODE_TIMEOUT_N" 30 "MID_PA_E_ESP_PS_TIMEOUT_N" 29 "MID_PA_E_ESP_WIC_REAR_TIMEOUT_N" 28 "MID_PA_E_TRAILER_ATTACH_INVALID_N" 27 "MID_PA_E_EXTERNAL_EPS_FAILURE_N" 26 "MID_PA_E_PSX_ACTIVATION_INVALID_N" 25 "MID_PA_E_ESP_WHEELVELO_TIMEOUT_N" 24 "MID_PA_E_ESP_LONGACC_TIMEOUT_N" 23 "MID_PA_E_VEH_DYN_INTERVENTION_INVALID_N" 22 "MID_ZPA_E_PS_MODE_INVALID_N" 21 "MID_ZPA_E_EPS_ERROR_INVALID_N" 20 "MID_ZPA_E1_ESP_PSState_INVALID_N" 19 "MID_ZPA_E2_BdaUss01BlindnessDetect_N" 18 "MID_ZPA_E2_BdaUss02BlindnessDetect_N" 17 "MID_ZPA_E2_BdaUss03BlindnessDetect_N" 16 "MID_ZPA_E2_BdaUss10BlindnessDetect_N" 15 "MID_ZPA_E2_BdaUss05BlindnessDetect_N" 14 "MID_ZPA_E2_BdaUss11BlindnessDetect_N" 13 "MID_ZPA_E2_BdaUss07BlindnessDetect_N" 12 "MID_ZPA_E2_BdaUss12BlindnessDetect_N" 11 "MID_ZPA_E2_BdaUss06BlindnessDetect_N" 10 "MID_ZPA_E2_BdaUss08BlindnessDetect_N" 9 "MID_ZPA_E2_BdaUss13BlindnessDetect_N" 8 "MID_ZPA_E2_BdaUss09BlindnessDetect_N" 7 "MID_ZPA_E2_BdaUss04BlindnessDetect_N" 6 "MID_ZPA_E2_BdaUss14BlindnessDetect_N" 5 "MID_FLS_E_READ_FAILED_N" 4 "MID_FLS_E_COMPARE_FAILED_N" 3 "MID_FLS_E_ERASE_FAILED_N" 2 "MID_FLS_E_WRITE_FAILED_N" 1 "MID_NO_FAULT_N" 0 "MID_INVALID" ;
VAL_ 1486 PARK_sw057_ambTemp 255 "UNKNOWN" ;
VAL_ 1486 PARK_sw057_voltage 255 "UNKNOWN" ;
VAL_ 1486 PARK_sw057_subCode 254 "MID_ADC_E_TOUT_N" 253 "MID_ADC_E_INIT_FAILURE_N" 252 "MID_CAN_E_TIMEOUT_N" 251 "MID_CANIF_E_FULL_TX_BUFFER_N" 250 "MID_CANIF_E_INVALID_DLC_N" 249 "MID_CANIF_E_INVALID_TXPDUID_N" 248 "MID_CANIF_E_STOPPED_N" 247 "MID_CANNM_E_CANIF_TRANSMIT_ERROR_N" 246 "MID_CANNM_E_INIT_FAILED_N" 245 "MID_CANNM_E_NETWORK_TIMEOUT_N" 244 "MID_CANSM_E_BUSOFF_NETWORK_N" 243 "MID_CANTP_E_COM_DIAMANT_N" 242 "MID_ECU_E_EEP_DATAFLASH_LAYOUT_N" 241 "MID_ECU_E_RAM_N" 240 "MID_ECU_E_ROM_N" 239 "MID_FEE_E_LAYOUT_FAILED_N" 238 "MID_NVM_E_CONFIG_FAILED_N" 237 "MID_CAN_DASInvalidData_N" 236 "MID_CAN_C_BUSOFF_N" 235 "MID_NVM_E_INTEGRITY_FAILED_N" 234 "MID_NVM_E_REQ_FAILED_N" 233 "MID_PA_E_ASIC_COM_FAILURE_N" 232 "MID_PA_E_ASIC_HW_FAILURE_N" 231 "MID_PA_E_ENGINE_START_INVALID_N" 230 "MID_PA_E_EPS_STATUS_INVALID_N" 229 "MID_PA_E_GEAR_INVALID_N" 228 "MID_PA_E_LONG_ACC_INVALID_N" 227 "MID_PA_E_OUTSIDE_TEMP_INVALID_N" 226 "MID_CAN_EPASInvalidData_N" 225 "MID_PA_E_SPEED_INVALID_N" 224 "MID_PA_E_SVA_BLOCKED_USS_FL_N" 223 "MID_PA_E_SVA_BLOCKED_USS_FR_N" 222 "MID_PA_E_SVA_BLOCKED_USS_RL_N" 221 "MID_PA_E_SVA_BLOCKED_USS_RR_N" 220 "MID_PA_E_SWA_INVALID_N" 219 "MID_PA_E_SWCPA_APT_MONITOR_FAILURE_N" 218 "MID_PA_E_SWCPA_INHIBIT_HSS_PWRLOCK_N" 217 "MID_PA_E_SWCPA_INIT_FAILURE_N" 216 "MID_PA_E_SWCPA_PARFAILURE_N" 215 "MID_CAN_EPBInvalidData_N" 214 "MID_PA_E_UBAT_HIGH_N" 213 "MID_PA_E_UBAT_LOW_N" 212 "MID_PA_E_USENS_OVERTEMPERATURE_N" 211 "MID_PA_E_USENS_OVERVOLTAGE_N" 210 "MID_PA_E_USENS_SHORT_2_GND_N" 209 "MID_PA_E_USENS_SHORT_2_UBAT_N" 208 "MID_PA_E_USENS_UNDERVOLTAGE_N" 207 "MID_PA_E_USS_01_NO_COM_N" 206 "MID_PA_E_USS_01_OPEN_N" 205 "MID_PA_E_USS_01_RING_TOO_SHORT_N" 204 "MID_PA_E_USS_01_RINGING_TOO_LONG_N" 203 "MID_PA_E_USS_01_SHORT_2_GND_N" 202 "MID_PA_E_USS_01_SHORT_2_USENS_N" 201 "MID_PA_E_USS_01_STATE_COM_VERIFIED_N" 200 "MID_PA_E_USS_01_STATE_OFFSET_N" 199 "MID_PA_E_USS_01_STATE_PROG_N" 198 "MID_PA_E_USS_01_STATE_TYPE_N" 197 "MID_PA_E_USS_02_NO_COM_N" 196 "MID_PA_E_USS_02_OPEN_N" 195 "MID_PA_E_USS_02_RING_TOO_SHORT_N" 194 "MID_PA_E_USS_02_RINGING_TOO_LONG_N" 193 "MID_PA_E_USS_02_SHORT_2_GND_N" 192 "MID_PA_E_USS_02_SHORT_2_USENS_N" 191 "MID_PA_E_USS_02_STATE_COM_VERIFIED_N" 190 "MID_PA_E_USS_02_STATE_OFFSET_N" 189 "MID_PA_E_USS_02_STATE_PROG_N" 188 "MID_PA_E_USS_02_STATE_TYPE_N" 187 "MID_PA_E_USS_03_NO_COM_N" 186 "MID_PA_E_USS_03_OPEN_N" 185 "MID_PA_E_USS_03_RING_TOO_SHORT_N" 184 "MID_PA_E_USS_03_RINGING_TOO_LONG_N" 183 "MID_PA_E_USS_03_SHORT_2_GND_N" 182 "MID_PA_E_USS_03_SHORT_2_USENS_N" 181 "MID_PA_E_USS_03_STATE_COM_VERIFIED_N" 180 "MID_PA_E_USS_03_STATE_OFFSET_N" 179 "MID_PA_E_USS_03_STATE_PROG_N" 178 "MID_PA_E_USS_03_STATE_TYPE_N" 177 "MID_PA_E_USS_04_NO_COM_N" 176 "MID_PA_E_USS_04_OPEN_N" 175 "MID_PA_E_USS_04_RING_TOO_SHORT_N" 174 "MID_PA_E_USS_04_RINGING_TOO_LONG_N" 173 "MID_PA_E_USS_04_SHORT_2_GND_N" 172 "MID_PA_E_USS_04_SHORT_2_USENS_N" 171 "MID_PA_E_USS_04_STATE_COM_VERIFIED_N" 170 "MID_PA_E_USS_04_STATE_OFFSET_N" 169 "MID_PA_E_USS_04_STATE_PROG_N" 168 "MID_PA_E_USS_04_STATE_TYPE_N" 167 "MID_PA_E_USS_05_NO_COM_N" 166 "MID_PA_E_USS_05_OPEN_N" 165 "MID_PA_E_USS_05_RING_TOO_SHORT_N" 164 "MID_PA_E_USS_05_RINGING_TOO_LONG_N" 163 "MID_PA_E_USS_05_SHORT_2_GND_N" 162 "MID_PA_E_USS_05_SHORT_2_USENS_N" 161 "MID_PA_E_USS_05_STATE_COM_VERIFIED_N" 160 "MID_PA_E_USS_05_STATE_OFFSET_N" 159 "MID_PA_E_USS_05_STATE_PROG_N" 158 "MID_PA_E_USS_05_STATE_TYPE_N" 157 "MID_PA_E_USS_06_NO_COM_N" 156 "MID_PA_E_USS_06_OPEN_N" 155 "MID_PA_E_USS_06_RING_TOO_SHORT_N" 154 "MID_PA_E_USS_06_RINGING_TOO_LONG_N" 153 "MID_PA_E_USS_06_SHORT_2_GND_N" 152 "MID_PA_E_USS_06_SHORT_2_USENS_N" 151 "MID_PA_E_USS_06_STATE_COM_VERIFIED_N" 150 "MID_PA_E_USS_06_STATE_OFFSET_N" 149 "MID_PA_E_USS_06_STATE_PROG_N" 148 "MID_PA_E_USS_06_STATE_TYPE_N" 147 "MID_CAN_ESPInvalidData_N" 146 "MID_CAN_GTWInvalidData_N" 145 "MID_CAN_SCCMInvalidData_N" 144 "MID_CAN_DASLossOfCommunication_N" 143 "MID_CAN_EPASLossOfCommunication_N" 142 "MID_CAN_EPBLossOfCommunication_N" 141 "MID_CAN_ESPLossOfCommunication_N" 140 "MID_CAN_GTWLossOfCommunication_N" 139 "MID_CAN_SCCMLossOfCommunication_N" 138 "MID_PA_E_USS_08_NO_COM_N" 137 "MID_PA_E_USS_08_OPEN_N" 136 "MID_PA_E_USS_08_RING_TOO_SHORT_N" 135 "MID_PA_E_USS_08_RINGING_TOO_LONG_N" 134 "MID_PA_E_USS_08_SHORT_2_GND_N" 133 "MID_PA_E_USS_08_SHORT_2_USENS_N" 132 "MID_PA_E_USS_08_STATE_COM_VERIFIED_N" 131 "MID_PA_E_USS_08_STATE_OFFSET_N" 130 "MID_PA_E_USS_08_STATE_PROG_N" 129 "MID_PA_E_USS_08_STATE_TYPE_N" 128 "MID_PA_E_USS_09_NO_COM_N" 127 "MID_PA_E_USS_09_OPEN_N" 126 "MID_PA_E_USS_09_RING_TOO_SHORT_N" 125 "MID_PA_E_USS_09_RINGING_TOO_LONG_N" 124 "MID_PA_E_USS_09_SHORT_2_GND_N" 123 "MID_PA_E_USS_09_SHORT_2_USENS_N" 122 "MID_PA_E_USS_09_STATE_COM_VERIFIED_N" 121 "MID_PA_E_USS_09_STATE_OFFSET_N" 120 "MID_PA_E_USS_09_STATE_PROG_N" 119 "MID_PA_E_USS_09_STATE_TYPE_N" 118 "MID_PA_E_USS_10_NO_COM_N" 117 "MID_PA_E_USS_10_OPEN_N" 116 "MID_PA_E_USS_10_RING_TOO_SHORT_N" 115 "MID_PA_E_USS_10_RINGING_TOO_LONG_N" 114 "MID_PA_E_USS_10_SHORT_2_GND_N" 113 "MID_PA_E_USS_10_SHORT_2_USENS_N" 112 "MID_PA_E_USS_10_STATE_COM_VERIFIED_N" 111 "MID_PA_E_USS_10_STATE_OFFSET_N" 110 "MID_PA_E_USS_10_STATE_PROG_N" 109 "MID_PA_E_USS_10_STATE_TYPE_N" 108 "MID_PA_E_USS_11_NO_COM_N" 107 "MID_PA_E_USS_11_OPEN_N" 106 "MID_PA_E_USS_11_RING_TOO_SHORT_N" 105 "MID_PA_E_USS_11_RINGING_TOO_LONG_N" 104 "MID_PA_E_USS_11_SHORT_2_GND_N" 103 "MID_PA_E_USS_11_SHORT_2_USENS_N" 102 "MID_PA_E_USS_11_STATE_COM_VERIFIED_N" 101 "MID_PA_E_USS_11_STATE_OFFSET_N" 100 "MID_PA_E_USS_11_STATE_PROG_N" 99 "MID_PA_E_USS_11_STATE_TYPE_N" 98 "MID_PA_E_USS_12_NO_COM_N" 97 "MID_PA_E_USS_12_OPEN_N" 96 "MID_PA_E_USS_12_RING_TOO_SHORT_N" 95 "MID_PA_E_USS_12_RINGING_TOO_LONG_N" 94 "MID_PA_E_USS_12_SHORT_2_GND_N" 93 "MID_PA_E_USS_12_SHORT_2_USENS_N" 92 "MID_PA_E_USS_12_STATE_COM_VERIFIED_N" 91 "MID_PA_E_USS_12_STATE_OFFSET_N" 90 "MID_PA_E_USS_12_STATE_PROG_N" 89 "MID_PA_E_USS_12_STATE_TYPE_N" 88 "MID_PA_E_USS_13_NO_COM_N" 87 "MID_PA_E_USS_13_OPEN_N" 86 "MID_PA_E_USS_13_RING_TOO_SHORT_N" 85 "MID_PA_E_USS_13_RINGING_TOO_LONG_N" 84 "MID_PA_E_USS_13_SHORT_2_GND_N" 83 "MID_PA_E_USS_13_SHORT_2_USENS_N" 82 "MID_PA_E_USS_13_STATE_COM_VERIFIED_N" 81 "MID_PA_E_USS_13_STATE_OFFSET_N" 80 "MID_PA_E_USS_13_STATE_PROG_N" 79 "MID_PA_E_USS_13_STATE_TYPE_N" 78 "MID_PA_E_SVA_BLOCKED_USS_ML_N" 77 "MID_PA_E_SVA_BLOCKED_USS_MR_N" 76 "MID_PA_E_WHEEL_DIR_FL_INVALID_N" 75 "MID_PA_E_WHEEL_DIR_FR_INVALID_N" 74 "MID_PA_E_WHEEL_DIR_RL_INVALID_N" 73 "MID_PA_E_WHEEL_DIR_RR_INVALID_N" 72 "MID_PA_E_WHEEL_ROTATION_FL_INVALID_N" 71 "MID_PA_E_WHEEL_ROTATION_FR_INVALID_N" 70 "MID_PA_E_WHEEL_ROTATION_RL_INVALID_N" 69 "MID_PA_E_WHEEL_ROTATION_RR_INVALID_N" 68 "MID_PA_E_WICFL_INVALID_N" 67 "MID_PA_E_WICFR_INVALID_N" 66 "MID_PA_E_WICRL_INVALID_N" 65 "MID_PA_E_WICRR_INVALID_N" 64 "MID_PA_E_YAW_RATE_INVALID_N" 63 "MID_PDUR_E_INIT_FAILED_N" 62 "MID_PDUR_E_PDU_INSTANCE_LOST_N" 61 "MID_COMM_E_NET_START_IND_CHANNEL_0_N" 60 "MID_SPI_E_DMA_TRANSFER_N" 59 "MID_SPI_E_RECEIVE_OVERFLOW_N" 58 "MID_SPI_E_TRANSFER_TIMEOUT_N" 57 "MID_PA_E_VEHDYNINTERVENTION_TIMEOUT_N" 56 "MID_TRAILER_HITCH_PRES_INVALID_N" 55 "MID_PA_E_CL15_STATE_INVALID_N" 54 "MID_PA_E_YAW_RATE_SIGN_INVALID_N" 53 "MID_PA_E_ESP_WIC_FRONT_TIMEOUT_N" 52 "MID_PA_E_SEQ_CALL_FAILURE_N" 51 "MID_PA_E_HMI_FUNCACTIVATION_TIMEOUT_N" 50 "MID_PA_E_LOWBEAM_INVALID_N" 49 "MID_PA_E_ENGINESTART_TIMEOUT_N" 48 "MID_ADC_E_VREF_N" 47 "MID_PA_E_ESP_YAW_TIMEOUT_N" 46 "MID_PA_E_TCM_PRG_TIMEOUT_N" 45 "MID_WDG_E_MODE_SWITCH_FAILED_N" 44 "MID_WDG_E_DISABLE_REJECTED_N" 43 "MID_PA_E_ESP_WHEELDIR_TIMEOUT_N" 42 "MID_PA_E_SWCPA_E_INIT_FAILURE_N" 41 "MID_PA_E_DIR_INDICATOR_INVALID_N" 40 "MID_PA_E_ESP_WIC_TIMEOUT_N" 39 "MID_PA_E_EPS_SWA_TIMEOUT_N" 38 "MID_PA_E_INSTRCLUSTER4_TIMEOUT_N" 37 "MID_PA_E_INSTRCLUSTER5_TIMEOUT_N" 36 "MID_PA_E_INSTRCLUSTER3_TIMEOUT_N" 35 "MID_PA_E_INSTRCLUSTER2_TIMEOUT_N" 34 "MID_PA_E_ASIC_WTD_RESET_N" 33 "MID_PA_E_INSTRCLUSTER1_TIMEOUT_N" 32 "MID_PA_E_ASIC_LOW_VOLT_RESET_N" 31 "MID_PA_E_POWERMODE_TIMEOUT_N" 30 "MID_PA_E_ESP_PS_TIMEOUT_N" 29 "MID_PA_E_ESP_WIC_REAR_TIMEOUT_N" 28 "MID_PA_E_TRAILER_ATTACH_INVALID_N" 27 "MID_PA_E_EXTERNAL_EPS_FAILURE_N" 26 "MID_PA_E_PSX_ACTIVATION_INVALID_N" 25 "MID_PA_E_ESP_WHEELVELO_TIMEOUT_N" 24 "MID_PA_E_ESP_LONGACC_TIMEOUT_N" 23 "MID_PA_E_VEH_DYN_INTERVENTION_INVALID_N" 22 "MID_ZPA_E_PS_MODE_INVALID_N" 21 "MID_ZPA_E_EPS_ERROR_INVALID_N" 20 "MID_ZPA_E1_ESP_PSState_INVALID_N" 19 "MID_ZPA_E2_BdaUss01BlindnessDetect_N" 18 "MID_ZPA_E2_BdaUss02BlindnessDetect_N" 17 "MID_ZPA_E2_BdaUss03BlindnessDetect_N" 16 "MID_ZPA_E2_BdaUss10BlindnessDetect_N" 15 "MID_ZPA_E2_BdaUss05BlindnessDetect_N" 14 "MID_ZPA_E2_BdaUss11BlindnessDetect_N" 13 "MID_ZPA_E2_BdaUss07BlindnessDetect_N" 12 "MID_ZPA_E2_BdaUss12BlindnessDetect_N" 11 "MID_ZPA_E2_BdaUss06BlindnessDetect_N" 10 "MID_ZPA_E2_BdaUss08BlindnessDetect_N" 9 "MID_ZPA_E2_BdaUss13BlindnessDetect_N" 8 "MID_ZPA_E2_BdaUss09BlindnessDetect_N" 7 "MID_ZPA_E2_BdaUss04BlindnessDetect_N" 6 "MID_ZPA_E2_BdaUss14BlindnessDetect_N" 5 "MID_FLS_E_READ_FAILED_N" 4 "MID_FLS_E_COMPARE_FAILED_N" 3 "MID_FLS_E_ERASE_FAILED_N" 2 "MID_FLS_E_WRITE_FAILED_N" 1 "MID_NO_FAULT_N" 0 "MID_INVALID" ;
VAL_ 1486 PARK_sw058_ambTemp 255 "UNKNOWN" ;
VAL_ 1486 PARK_sw058_voltage 255 "UNKNOWN" ;
VAL_ 1486 PARK_sw058_subCode 254 "MID_ADC_E_TOUT_N" 253 "MID_ADC_E_INIT_FAILURE_N" 252 "MID_CAN_E_TIMEOUT_N" 251 "MID_CANIF_E_FULL_TX_BUFFER_N" 250 "MID_CANIF_E_INVALID_DLC_N" 249 "MID_CANIF_E_INVALID_TXPDUID_N" 248 "MID_CANIF_E_STOPPED_N" 247 "MID_CANNM_E_CANIF_TRANSMIT_ERROR_N" 246 "MID_CANNM_E_INIT_FAILED_N" 245 "MID_CANNM_E_NETWORK_TIMEOUT_N" 244 "MID_CANSM_E_BUSOFF_NETWORK_N" 243 "MID_CANTP_E_COM_DIAMANT_N" 242 "MID_ECU_E_EEP_DATAFLASH_LAYOUT_N" 241 "MID_ECU_E_RAM_N" 240 "MID_ECU_E_ROM_N" 239 "MID_FEE_E_LAYOUT_FAILED_N" 238 "MID_NVM_E_CONFIG_FAILED_N" 237 "MID_CAN_DASInvalidData_N" 236 "MID_CAN_C_BUSOFF_N" 235 "MID_NVM_E_INTEGRITY_FAILED_N" 234 "MID_NVM_E_REQ_FAILED_N" 233 "MID_PA_E_ASIC_COM_FAILURE_N" 232 "MID_PA_E_ASIC_HW_FAILURE_N" 231 "MID_PA_E_ENGINE_START_INVALID_N" 230 "MID_PA_E_EPS_STATUS_INVALID_N" 229 "MID_PA_E_GEAR_INVALID_N" 228 "MID_PA_E_LONG_ACC_INVALID_N" 227 "MID_PA_E_OUTSIDE_TEMP_INVALID_N" 226 "MID_CAN_EPASInvalidData_N" 225 "MID_PA_E_SPEED_INVALID_N" 224 "MID_PA_E_SVA_BLOCKED_USS_FL_N" 223 "MID_PA_E_SVA_BLOCKED_USS_FR_N" 222 "MID_PA_E_SVA_BLOCKED_USS_RL_N" 221 "MID_PA_E_SVA_BLOCKED_USS_RR_N" 220 "MID_PA_E_SWA_INVALID_N" 219 "MID_PA_E_SWCPA_APT_MONITOR_FAILURE_N" 218 "MID_PA_E_SWCPA_INHIBIT_HSS_PWRLOCK_N" 217 "MID_PA_E_SWCPA_INIT_FAILURE_N" 216 "MID_PA_E_SWCPA_PARFAILURE_N" 215 "MID_CAN_EPBInvalidData_N" 214 "MID_PA_E_UBAT_HIGH_N" 213 "MID_PA_E_UBAT_LOW_N" 212 "MID_PA_E_USENS_OVERTEMPERATURE_N" 211 "MID_PA_E_USENS_OVERVOLTAGE_N" 210 "MID_PA_E_USENS_SHORT_2_GND_N" 209 "MID_PA_E_USENS_SHORT_2_UBAT_N" 208 "MID_PA_E_USENS_UNDERVOLTAGE_N" 207 "MID_PA_E_USS_01_NO_COM_N" 206 "MID_PA_E_USS_01_OPEN_N" 205 "MID_PA_E_USS_01_RING_TOO_SHORT_N" 204 "MID_PA_E_USS_01_RINGING_TOO_LONG_N" 203 "MID_PA_E_USS_01_SHORT_2_GND_N" 202 "MID_PA_E_USS_01_SHORT_2_USENS_N" 201 "MID_PA_E_USS_01_STATE_COM_VERIFIED_N" 200 "MID_PA_E_USS_01_STATE_OFFSET_N" 199 "MID_PA_E_USS_01_STATE_PROG_N" 198 "MID_PA_E_USS_01_STATE_TYPE_N" 197 "MID_PA_E_USS_02_NO_COM_N" 196 "MID_PA_E_USS_02_OPEN_N" 195 "MID_PA_E_USS_02_RING_TOO_SHORT_N" 194 "MID_PA_E_USS_02_RINGING_TOO_LONG_N" 193 "MID_PA_E_USS_02_SHORT_2_GND_N" 192 "MID_PA_E_USS_02_SHORT_2_USENS_N" 191 "MID_PA_E_USS_02_STATE_COM_VERIFIED_N" 190 "MID_PA_E_USS_02_STATE_OFFSET_N" 189 "MID_PA_E_USS_02_STATE_PROG_N" 188 "MID_PA_E_USS_02_STATE_TYPE_N" 187 "MID_PA_E_USS_03_NO_COM_N" 186 "MID_PA_E_USS_03_OPEN_N" 185 "MID_PA_E_USS_03_RING_TOO_SHORT_N" 184 "MID_PA_E_USS_03_RINGING_TOO_LONG_N" 183 "MID_PA_E_USS_03_SHORT_2_GND_N" 182 "MID_PA_E_USS_03_SHORT_2_USENS_N" 181 "MID_PA_E_USS_03_STATE_COM_VERIFIED_N" 180 "MID_PA_E_USS_03_STATE_OFFSET_N" 179 "MID_PA_E_USS_03_STATE_PROG_N" 178 "MID_PA_E_USS_03_STATE_TYPE_N" 177 "MID_PA_E_USS_04_NO_COM_N" 176 "MID_PA_E_USS_04_OPEN_N" 175 "MID_PA_E_USS_04_RING_TOO_SHORT_N" 174 "MID_PA_E_USS_04_RINGING_TOO_LONG_N" 173 "MID_PA_E_USS_04_SHORT_2_GND_N" 172 "MID_PA_E_USS_04_SHORT_2_USENS_N" 171 "MID_PA_E_USS_04_STATE_COM_VERIFIED_N" 170 "MID_PA_E_USS_04_STATE_OFFSET_N" 169 "MID_PA_E_USS_04_STATE_PROG_N" 168 "MID_PA_E_USS_04_STATE_TYPE_N" 167 "MID_PA_E_USS_05_NO_COM_N" 166 "MID_PA_E_USS_05_OPEN_N" 165 "MID_PA_E_USS_05_RING_TOO_SHORT_N" 164 "MID_PA_E_USS_05_RINGING_TOO_LONG_N" 163 "MID_PA_E_USS_05_SHORT_2_GND_N" 162 "MID_PA_E_USS_05_SHORT_2_USENS_N" 161 "MID_PA_E_USS_05_STATE_COM_VERIFIED_N" 160 "MID_PA_E_USS_05_STATE_OFFSET_N" 159 "MID_PA_E_USS_05_STATE_PROG_N" 158 "MID_PA_E_USS_05_STATE_TYPE_N" 157 "MID_PA_E_USS_06_NO_COM_N" 156 "MID_PA_E_USS_06_OPEN_N" 155 "MID_PA_E_USS_06_RING_TOO_SHORT_N" 154 "MID_PA_E_USS_06_RINGING_TOO_LONG_N" 153 "MID_PA_E_USS_06_SHORT_2_GND_N" 152 "MID_PA_E_USS_06_SHORT_2_USENS_N" 151 "MID_PA_E_USS_06_STATE_COM_VERIFIED_N" 150 "MID_PA_E_USS_06_STATE_OFFSET_N" 149 "MID_PA_E_USS_06_STATE_PROG_N" 148 "MID_PA_E_USS_06_STATE_TYPE_N" 147 "MID_CAN_ESPInvalidData_N" 146 "MID_CAN_GTWInvalidData_N" 145 "MID_CAN_SCCMInvalidData_N" 144 "MID_CAN_DASLossOfCommunication_N" 143 "MID_CAN_EPASLossOfCommunication_N" 142 "MID_CAN_EPBLossOfCommunication_N" 141 "MID_CAN_ESPLossOfCommunication_N" 140 "MID_CAN_GTWLossOfCommunication_N" 139 "MID_CAN_SCCMLossOfCommunication_N" 138 "MID_PA_E_USS_08_NO_COM_N" 137 "MID_PA_E_USS_08_OPEN_N" 136 "MID_PA_E_USS_08_RING_TOO_SHORT_N" 135 "MID_PA_E_USS_08_RINGING_TOO_LONG_N" 134 "MID_PA_E_USS_08_SHORT_2_GND_N" 133 "MID_PA_E_USS_08_SHORT_2_USENS_N" 132 "MID_PA_E_USS_08_STATE_COM_VERIFIED_N" 131 "MID_PA_E_USS_08_STATE_OFFSET_N" 130 "MID_PA_E_USS_08_STATE_PROG_N" 129 "MID_PA_E_USS_08_STATE_TYPE_N" 128 "MID_PA_E_USS_09_NO_COM_N" 127 "MID_PA_E_USS_09_OPEN_N" 126 "MID_PA_E_USS_09_RING_TOO_SHORT_N" 125 "MID_PA_E_USS_09_RINGING_TOO_LONG_N" 124 "MID_PA_E_USS_09_SHORT_2_GND_N" 123 "MID_PA_E_USS_09_SHORT_2_USENS_N" 122 "MID_PA_E_USS_09_STATE_COM_VERIFIED_N" 121 "MID_PA_E_USS_09_STATE_OFFSET_N" 120 "MID_PA_E_USS_09_STATE_PROG_N" 119 "MID_PA_E_USS_09_STATE_TYPE_N" 118 "MID_PA_E_USS_10_NO_COM_N" 117 "MID_PA_E_USS_10_OPEN_N" 116 "MID_PA_E_USS_10_RING_TOO_SHORT_N" 115 "MID_PA_E_USS_10_RINGING_TOO_LONG_N" 114 "MID_PA_E_USS_10_SHORT_2_GND_N" 113 "MID_PA_E_USS_10_SHORT_2_USENS_N" 112 "MID_PA_E_USS_10_STATE_COM_VERIFIED_N" 111 "MID_PA_E_USS_10_STATE_OFFSET_N" 110 "MID_PA_E_USS_10_STATE_PROG_N" 109 "MID_PA_E_USS_10_STATE_TYPE_N" 108 "MID_PA_E_USS_11_NO_COM_N" 107 "MID_PA_E_USS_11_OPEN_N" 106 "MID_PA_E_USS_11_RING_TOO_SHORT_N" 105 "MID_PA_E_USS_11_RINGING_TOO_LONG_N" 104 "MID_PA_E_USS_11_SHORT_2_GND_N" 103 "MID_PA_E_USS_11_SHORT_2_USENS_N" 102 "MID_PA_E_USS_11_STATE_COM_VERIFIED_N" 101 "MID_PA_E_USS_11_STATE_OFFSET_N" 100 "MID_PA_E_USS_11_STATE_PROG_N" 99 "MID_PA_E_USS_11_STATE_TYPE_N" 98 "MID_PA_E_USS_12_NO_COM_N" 97 "MID_PA_E_USS_12_OPEN_N" 96 "MID_PA_E_USS_12_RING_TOO_SHORT_N" 95 "MID_PA_E_USS_12_RINGING_TOO_LONG_N" 94 "MID_PA_E_USS_12_SHORT_2_GND_N" 93 "MID_PA_E_USS_12_SHORT_2_USENS_N" 92 "MID_PA_E_USS_12_STATE_COM_VERIFIED_N" 91 "MID_PA_E_USS_12_STATE_OFFSET_N" 90 "MID_PA_E_USS_12_STATE_PROG_N" 89 "MID_PA_E_USS_12_STATE_TYPE_N" 88 "MID_PA_E_USS_13_NO_COM_N" 87 "MID_PA_E_USS_13_OPEN_N" 86 "MID_PA_E_USS_13_RING_TOO_SHORT_N" 85 "MID_PA_E_USS_13_RINGING_TOO_LONG_N" 84 "MID_PA_E_USS_13_SHORT_2_GND_N" 83 "MID_PA_E_USS_13_SHORT_2_USENS_N" 82 "MID_PA_E_USS_13_STATE_COM_VERIFIED_N" 81 "MID_PA_E_USS_13_STATE_OFFSET_N" 80 "MID_PA_E_USS_13_STATE_PROG_N" 79 "MID_PA_E_USS_13_STATE_TYPE_N" 78 "MID_PA_E_SVA_BLOCKED_USS_ML_N" 77 "MID_PA_E_SVA_BLOCKED_USS_MR_N" 76 "MID_PA_E_WHEEL_DIR_FL_INVALID_N" 75 "MID_PA_E_WHEEL_DIR_FR_INVALID_N" 74 "MID_PA_E_WHEEL_DIR_RL_INVALID_N" 73 "MID_PA_E_WHEEL_DIR_RR_INVALID_N" 72 "MID_PA_E_WHEEL_ROTATION_FL_INVALID_N" 71 "MID_PA_E_WHEEL_ROTATION_FR_INVALID_N" 70 "MID_PA_E_WHEEL_ROTATION_RL_INVALID_N" 69 "MID_PA_E_WHEEL_ROTATION_RR_INVALID_N" 68 "MID_PA_E_WICFL_INVALID_N" 67 "MID_PA_E_WICFR_INVALID_N" 66 "MID_PA_E_WICRL_INVALID_N" 65 "MID_PA_E_WICRR_INVALID_N" 64 "MID_PA_E_YAW_RATE_INVALID_N" 63 "MID_PDUR_E_INIT_FAILED_N" 62 "MID_PDUR_E_PDU_INSTANCE_LOST_N" 61 "MID_COMM_E_NET_START_IND_CHANNEL_0_N" 60 "MID_SPI_E_DMA_TRANSFER_N" 59 "MID_SPI_E_RECEIVE_OVERFLOW_N" 58 "MID_SPI_E_TRANSFER_TIMEOUT_N" 57 "MID_PA_E_VEHDYNINTERVENTION_TIMEOUT_N" 56 "MID_TRAILER_HITCH_PRES_INVALID_N" 55 "MID_PA_E_CL15_STATE_INVALID_N" 54 "MID_PA_E_YAW_RATE_SIGN_INVALID_N" 53 "MID_PA_E_ESP_WIC_FRONT_TIMEOUT_N" 52 "MID_PA_E_SEQ_CALL_FAILURE_N" 51 "MID_PA_E_HMI_FUNCACTIVATION_TIMEOUT_N" 50 "MID_PA_E_LOWBEAM_INVALID_N" 49 "MID_PA_E_ENGINESTART_TIMEOUT_N" 48 "MID_ADC_E_VREF_N" 47 "MID_PA_E_ESP_YAW_TIMEOUT_N" 46 "MID_PA_E_TCM_PRG_TIMEOUT_N" 45 "MID_WDG_E_MODE_SWITCH_FAILED_N" 44 "MID_WDG_E_DISABLE_REJECTED_N" 43 "MID_PA_E_ESP_WHEELDIR_TIMEOUT_N" 42 "MID_PA_E_SWCPA_E_INIT_FAILURE_N" 41 "MID_PA_E_DIR_INDICATOR_INVALID_N" 40 "MID_PA_E_ESP_WIC_TIMEOUT_N" 39 "MID_PA_E_EPS_SWA_TIMEOUT_N" 38 "MID_PA_E_INSTRCLUSTER4_TIMEOUT_N" 37 "MID_PA_E_INSTRCLUSTER5_TIMEOUT_N" 36 "MID_PA_E_INSTRCLUSTER3_TIMEOUT_N" 35 "MID_PA_E_INSTRCLUSTER2_TIMEOUT_N" 34 "MID_PA_E_ASIC_WTD_RESET_N" 33 "MID_PA_E_INSTRCLUSTER1_TIMEOUT_N" 32 "MID_PA_E_ASIC_LOW_VOLT_RESET_N" 31 "MID_PA_E_POWERMODE_TIMEOUT_N" 30 "MID_PA_E_ESP_PS_TIMEOUT_N" 29 "MID_PA_E_ESP_WIC_REAR_TIMEOUT_N" 28 "MID_PA_E_TRAILER_ATTACH_INVALID_N" 27 "MID_PA_E_EXTERNAL_EPS_FAILURE_N" 26 "MID_PA_E_PSX_ACTIVATION_INVALID_N" 25 "MID_PA_E_ESP_WHEELVELO_TIMEOUT_N" 24 "MID_PA_E_ESP_LONGACC_TIMEOUT_N" 23 "MID_PA_E_VEH_DYN_INTERVENTION_INVALID_N" 22 "MID_ZPA_E_PS_MODE_INVALID_N" 21 "MID_ZPA_E_EPS_ERROR_INVALID_N" 20 "MID_ZPA_E1_ESP_PSState_INVALID_N" 19 "MID_ZPA_E2_BdaUss01BlindnessDetect_N" 18 "MID_ZPA_E2_BdaUss02BlindnessDetect_N" 17 "MID_ZPA_E2_BdaUss03BlindnessDetect_N" 16 "MID_ZPA_E2_BdaUss10BlindnessDetect_N" 15 "MID_ZPA_E2_BdaUss05BlindnessDetect_N" 14 "MID_ZPA_E2_BdaUss11BlindnessDetect_N" 13 "MID_ZPA_E2_BdaUss07BlindnessDetect_N" 12 "MID_ZPA_E2_BdaUss12BlindnessDetect_N" 11 "MID_ZPA_E2_BdaUss06BlindnessDetect_N" 10 "MID_ZPA_E2_BdaUss08BlindnessDetect_N" 9 "MID_ZPA_E2_BdaUss13BlindnessDetect_N" 8 "MID_ZPA_E2_BdaUss09BlindnessDetect_N" 7 "MID_ZPA_E2_BdaUss04BlindnessDetect_N" 6 "MID_ZPA_E2_BdaUss14BlindnessDetect_N" 5 "MID_FLS_E_READ_FAILED_N" 4 "MID_FLS_E_COMPARE_FAILED_N" 3 "MID_FLS_E_ERASE_FAILED_N" 2 "MID_FLS_E_WRITE_FAILED_N" 1 "MID_NO_FAULT_N" 0 "MID_INVALID" ;
VAL_ 1486 PARK_sw059_ambTemp 255 "UNKNOWN" ;
VAL_ 1486 PARK_sw059_voltage 255 "UNKNOWN" ;
VAL_ 1486 PARK_sw059_subCode 254 "MID_ADC_E_TOUT_N" 253 "MID_ADC_E_INIT_FAILURE_N" 252 "MID_CAN_E_TIMEOUT_N" 251 "MID_CANIF_E_FULL_TX_BUFFER_N" 250 "MID_CANIF_E_INVALID_DLC_N" 249 "MID_CANIF_E_INVALID_TXPDUID_N" 248 "MID_CANIF_E_STOPPED_N" 247 "MID_CANNM_E_CANIF_TRANSMIT_ERROR_N" 246 "MID_CANNM_E_INIT_FAILED_N" 245 "MID_CANNM_E_NETWORK_TIMEOUT_N" 244 "MID_CANSM_E_BUSOFF_NETWORK_N" 243 "MID_CANTP_E_COM_DIAMANT_N" 242 "MID_ECU_E_EEP_DATAFLASH_LAYOUT_N" 241 "MID_ECU_E_RAM_N" 240 "MID_ECU_E_ROM_N" 239 "MID_FEE_E_LAYOUT_FAILED_N" 238 "MID_NVM_E_CONFIG_FAILED_N" 237 "MID_CAN_DASInvalidData_N" 236 "MID_CAN_C_BUSOFF_N" 235 "MID_NVM_E_INTEGRITY_FAILED_N" 234 "MID_NVM_E_REQ_FAILED_N" 233 "MID_PA_E_ASIC_COM_FAILURE_N" 232 "MID_PA_E_ASIC_HW_FAILURE_N" 231 "MID_PA_E_ENGINE_START_INVALID_N" 230 "MID_PA_E_EPS_STATUS_INVALID_N" 229 "MID_PA_E_GEAR_INVALID_N" 228 "MID_PA_E_LONG_ACC_INVALID_N" 227 "MID_PA_E_OUTSIDE_TEMP_INVALID_N" 226 "MID_CAN_EPASInvalidData_N" 225 "MID_PA_E_SPEED_INVALID_N" 224 "MID_PA_E_SVA_BLOCKED_USS_FL_N" 223 "MID_PA_E_SVA_BLOCKED_USS_FR_N" 222 "MID_PA_E_SVA_BLOCKED_USS_RL_N" 221 "MID_PA_E_SVA_BLOCKED_USS_RR_N" 220 "MID_PA_E_SWA_INVALID_N" 219 "MID_PA_E_SWCPA_APT_MONITOR_FAILURE_N" 218 "MID_PA_E_SWCPA_INHIBIT_HSS_PWRLOCK_N" 217 "MID_PA_E_SWCPA_INIT_FAILURE_N" 216 "MID_PA_E_SWCPA_PARFAILURE_N" 215 "MID_CAN_EPBInvalidData_N" 214 "MID_PA_E_UBAT_HIGH_N" 213 "MID_PA_E_UBAT_LOW_N" 212 "MID_PA_E_USENS_OVERTEMPERATURE_N" 211 "MID_PA_E_USENS_OVERVOLTAGE_N" 210 "MID_PA_E_USENS_SHORT_2_GND_N" 209 "MID_PA_E_USENS_SHORT_2_UBAT_N" 208 "MID_PA_E_USENS_UNDERVOLTAGE_N" 207 "MID_PA_E_USS_01_NO_COM_N" 206 "MID_PA_E_USS_01_OPEN_N" 205 "MID_PA_E_USS_01_RING_TOO_SHORT_N" 204 "MID_PA_E_USS_01_RINGING_TOO_LONG_N" 203 "MID_PA_E_USS_01_SHORT_2_GND_N" 202 "MID_PA_E_USS_01_SHORT_2_USENS_N" 201 "MID_PA_E_USS_01_STATE_COM_VERIFIED_N" 200 "MID_PA_E_USS_01_STATE_OFFSET_N" 199 "MID_PA_E_USS_01_STATE_PROG_N" 198 "MID_PA_E_USS_01_STATE_TYPE_N" 197 "MID_PA_E_USS_02_NO_COM_N" 196 "MID_PA_E_USS_02_OPEN_N" 195 "MID_PA_E_USS_02_RING_TOO_SHORT_N" 194 "MID_PA_E_USS_02_RINGING_TOO_LONG_N" 193 "MID_PA_E_USS_02_SHORT_2_GND_N" 192 "MID_PA_E_USS_02_SHORT_2_USENS_N" 191 "MID_PA_E_USS_02_STATE_COM_VERIFIED_N" 190 "MID_PA_E_USS_02_STATE_OFFSET_N" 189 "MID_PA_E_USS_02_STATE_PROG_N" 188 "MID_PA_E_USS_02_STATE_TYPE_N" 187 "MID_PA_E_USS_03_NO_COM_N" 186 "MID_PA_E_USS_03_OPEN_N" 185 "MID_PA_E_USS_03_RING_TOO_SHORT_N" 184 "MID_PA_E_USS_03_RINGING_TOO_LONG_N" 183 "MID_PA_E_USS_03_SHORT_2_GND_N" 182 "MID_PA_E_USS_03_SHORT_2_USENS_N" 181 "MID_PA_E_USS_03_STATE_COM_VERIFIED_N" 180 "MID_PA_E_USS_03_STATE_OFFSET_N" 179 "MID_PA_E_USS_03_STATE_PROG_N" 178 "MID_PA_E_USS_03_STATE_TYPE_N" 177 "MID_PA_E_USS_04_NO_COM_N" 176 "MID_PA_E_USS_04_OPEN_N" 175 "MID_PA_E_USS_04_RING_TOO_SHORT_N" 174 "MID_PA_E_USS_04_RINGING_TOO_LONG_N" 173 "MID_PA_E_USS_04_SHORT_2_GND_N" 172 "MID_PA_E_USS_04_SHORT_2_USENS_N" 171 "MID_PA_E_USS_04_STATE_COM_VERIFIED_N" 170 "MID_PA_E_USS_04_STATE_OFFSET_N" 169 "MID_PA_E_USS_04_STATE_PROG_N" 168 "MID_PA_E_USS_04_STATE_TYPE_N" 167 "MID_PA_E_USS_05_NO_COM_N" 166 "MID_PA_E_USS_05_OPEN_N" 165 "MID_PA_E_USS_05_RING_TOO_SHORT_N" 164 "MID_PA_E_USS_05_RINGING_TOO_LONG_N" 163 "MID_PA_E_USS_05_SHORT_2_GND_N" 162 "MID_PA_E_USS_05_SHORT_2_USENS_N" 161 "MID_PA_E_USS_05_STATE_COM_VERIFIED_N" 160 "MID_PA_E_USS_05_STATE_OFFSET_N" 159 "MID_PA_E_USS_05_STATE_PROG_N" 158 "MID_PA_E_USS_05_STATE_TYPE_N" 157 "MID_PA_E_USS_06_NO_COM_N" 156 "MID_PA_E_USS_06_OPEN_N" 155 "MID_PA_E_USS_06_RING_TOO_SHORT_N" 154 "MID_PA_E_USS_06_RINGING_TOO_LONG_N" 153 "MID_PA_E_USS_06_SHORT_2_GND_N" 152 "MID_PA_E_USS_06_SHORT_2_USENS_N" 151 "MID_PA_E_USS_06_STATE_COM_VERIFIED_N" 150 "MID_PA_E_USS_06_STATE_OFFSET_N" 149 "MID_PA_E_USS_06_STATE_PROG_N" 148 "MID_PA_E_USS_06_STATE_TYPE_N" 147 "MID_CAN_ESPInvalidData_N" 146 "MID_CAN_GTWInvalidData_N" 145 "MID_CAN_SCCMInvalidData_N" 144 "MID_CAN_DASLossOfCommunication_N" 143 "MID_CAN_EPASLossOfCommunication_N" 142 "MID_CAN_EPBLossOfCommunication_N" 141 "MID_CAN_ESPLossOfCommunication_N" 140 "MID_CAN_GTWLossOfCommunication_N" 139 "MID_CAN_SCCMLossOfCommunication_N" 138 "MID_PA_E_USS_08_NO_COM_N" 137 "MID_PA_E_USS_08_OPEN_N" 136 "MID_PA_E_USS_08_RING_TOO_SHORT_N" 135 "MID_PA_E_USS_08_RINGING_TOO_LONG_N" 134 "MID_PA_E_USS_08_SHORT_2_GND_N" 133 "MID_PA_E_USS_08_SHORT_2_USENS_N" 132 "MID_PA_E_USS_08_STATE_COM_VERIFIED_N" 131 "MID_PA_E_USS_08_STATE_OFFSET_N" 130 "MID_PA_E_USS_08_STATE_PROG_N" 129 "MID_PA_E_USS_08_STATE_TYPE_N" 128 "MID_PA_E_USS_09_NO_COM_N" 127 "MID_PA_E_USS_09_OPEN_N" 126 "MID_PA_E_USS_09_RING_TOO_SHORT_N" 125 "MID_PA_E_USS_09_RINGING_TOO_LONG_N" 124 "MID_PA_E_USS_09_SHORT_2_GND_N" 123 "MID_PA_E_USS_09_SHORT_2_USENS_N" 122 "MID_PA_E_USS_09_STATE_COM_VERIFIED_N" 121 "MID_PA_E_USS_09_STATE_OFFSET_N" 120 "MID_PA_E_USS_09_STATE_PROG_N" 119 "MID_PA_E_USS_09_STATE_TYPE_N" 118 "MID_PA_E_USS_10_NO_COM_N" 117 "MID_PA_E_USS_10_OPEN_N" 116 "MID_PA_E_USS_10_RING_TOO_SHORT_N" 115 "MID_PA_E_USS_10_RINGING_TOO_LONG_N" 114 "MID_PA_E_USS_10_SHORT_2_GND_N" 113 "MID_PA_E_USS_10_SHORT_2_USENS_N" 112 "MID_PA_E_USS_10_STATE_COM_VERIFIED_N" 111 "MID_PA_E_USS_10_STATE_OFFSET_N" 110 "MID_PA_E_USS_10_STATE_PROG_N" 109 "MID_PA_E_USS_10_STATE_TYPE_N" 108 "MID_PA_E_USS_11_NO_COM_N" 107 "MID_PA_E_USS_11_OPEN_N" 106 "MID_PA_E_USS_11_RING_TOO_SHORT_N" 105 "MID_PA_E_USS_11_RINGING_TOO_LONG_N" 104 "MID_PA_E_USS_11_SHORT_2_GND_N" 103 "MID_PA_E_USS_11_SHORT_2_USENS_N" 102 "MID_PA_E_USS_11_STATE_COM_VERIFIED_N" 101 "MID_PA_E_USS_11_STATE_OFFSET_N" 100 "MID_PA_E_USS_11_STATE_PROG_N" 99 "MID_PA_E_USS_11_STATE_TYPE_N" 98 "MID_PA_E_USS_12_NO_COM_N" 97 "MID_PA_E_USS_12_OPEN_N" 96 "MID_PA_E_USS_12_RING_TOO_SHORT_N" 95 "MID_PA_E_USS_12_RINGING_TOO_LONG_N" 94 "MID_PA_E_USS_12_SHORT_2_GND_N" 93 "MID_PA_E_USS_12_SHORT_2_USENS_N" 92 "MID_PA_E_USS_12_STATE_COM_VERIFIED_N" 91 "MID_PA_E_USS_12_STATE_OFFSET_N" 90 "MID_PA_E_USS_12_STATE_PROG_N" 89 "MID_PA_E_USS_12_STATE_TYPE_N" 88 "MID_PA_E_USS_13_NO_COM_N" 87 "MID_PA_E_USS_13_OPEN_N" 86 "MID_PA_E_USS_13_RING_TOO_SHORT_N" 85 "MID_PA_E_USS_13_RINGING_TOO_LONG_N" 84 "MID_PA_E_USS_13_SHORT_2_GND_N" 83 "MID_PA_E_USS_13_SHORT_2_USENS_N" 82 "MID_PA_E_USS_13_STATE_COM_VERIFIED_N" 81 "MID_PA_E_USS_13_STATE_OFFSET_N" 80 "MID_PA_E_USS_13_STATE_PROG_N" 79 "MID_PA_E_USS_13_STATE_TYPE_N" 78 "MID_PA_E_SVA_BLOCKED_USS_ML_N" 77 "MID_PA_E_SVA_BLOCKED_USS_MR_N" 76 "MID_PA_E_WHEEL_DIR_FL_INVALID_N" 75 "MID_PA_E_WHEEL_DIR_FR_INVALID_N" 74 "MID_PA_E_WHEEL_DIR_RL_INVALID_N" 73 "MID_PA_E_WHEEL_DIR_RR_INVALID_N" 72 "MID_PA_E_WHEEL_ROTATION_FL_INVALID_N" 71 "MID_PA_E_WHEEL_ROTATION_FR_INVALID_N" 70 "MID_PA_E_WHEEL_ROTATION_RL_INVALID_N" 69 "MID_PA_E_WHEEL_ROTATION_RR_INVALID_N" 68 "MID_PA_E_WICFL_INVALID_N" 67 "MID_PA_E_WICFR_INVALID_N" 66 "MID_PA_E_WICRL_INVALID_N" 65 "MID_PA_E_WICRR_INVALID_N" 64 "MID_PA_E_YAW_RATE_INVALID_N" 63 "MID_PDUR_E_INIT_FAILED_N" 62 "MID_PDUR_E_PDU_INSTANCE_LOST_N" 61 "MID_COMM_E_NET_START_IND_CHANNEL_0_N" 60 "MID_SPI_E_DMA_TRANSFER_N" 59 "MID_SPI_E_RECEIVE_OVERFLOW_N" 58 "MID_SPI_E_TRANSFER_TIMEOUT_N" 57 "MID_PA_E_VEHDYNINTERVENTION_TIMEOUT_N" 56 "MID_TRAILER_HITCH_PRES_INVALID_N" 55 "MID_PA_E_CL15_STATE_INVALID_N" 54 "MID_PA_E_YAW_RATE_SIGN_INVALID_N" 53 "MID_PA_E_ESP_WIC_FRONT_TIMEOUT_N" 52 "MID_PA_E_SEQ_CALL_FAILURE_N" 51 "MID_PA_E_HMI_FUNCACTIVATION_TIMEOUT_N" 50 "MID_PA_E_LOWBEAM_INVALID_N" 49 "MID_PA_E_ENGINESTART_TIMEOUT_N" 48 "MID_ADC_E_VREF_N" 47 "MID_PA_E_ESP_YAW_TIMEOUT_N" 46 "MID_PA_E_TCM_PRG_TIMEOUT_N" 45 "MID_WDG_E_MODE_SWITCH_FAILED_N" 44 "MID_WDG_E_DISABLE_REJECTED_N" 43 "MID_PA_E_ESP_WHEELDIR_TIMEOUT_N" 42 "MID_PA_E_SWCPA_E_INIT_FAILURE_N" 41 "MID_PA_E_DIR_INDICATOR_INVALID_N" 40 "MID_PA_E_ESP_WIC_TIMEOUT_N" 39 "MID_PA_E_EPS_SWA_TIMEOUT_N" 38 "MID_PA_E_INSTRCLUSTER4_TIMEOUT_N" 37 "MID_PA_E_INSTRCLUSTER5_TIMEOUT_N" 36 "MID_PA_E_INSTRCLUSTER3_TIMEOUT_N" 35 "MID_PA_E_INSTRCLUSTER2_TIMEOUT_N" 34 "MID_PA_E_ASIC_WTD_RESET_N" 33 "MID_PA_E_INSTRCLUSTER1_TIMEOUT_N" 32 "MID_PA_E_ASIC_LOW_VOLT_RESET_N" 31 "MID_PA_E_POWERMODE_TIMEOUT_N" 30 "MID_PA_E_ESP_PS_TIMEOUT_N" 29 "MID_PA_E_ESP_WIC_REAR_TIMEOUT_N" 28 "MID_PA_E_TRAILER_ATTACH_INVALID_N" 27 "MID_PA_E_EXTERNAL_EPS_FAILURE_N" 26 "MID_PA_E_PSX_ACTIVATION_INVALID_N" 25 "MID_PA_E_ESP_WHEELVELO_TIMEOUT_N" 24 "MID_PA_E_ESP_LONGACC_TIMEOUT_N" 23 "MID_PA_E_VEH_DYN_INTERVENTION_INVALID_N" 22 "MID_ZPA_E_PS_MODE_INVALID_N" 21 "MID_ZPA_E_EPS_ERROR_INVALID_N" 20 "MID_ZPA_E1_ESP_PSState_INVALID_N" 19 "MID_ZPA_E2_BdaUss01BlindnessDetect_N" 18 "MID_ZPA_E2_BdaUss02BlindnessDetect_N" 17 "MID_ZPA_E2_BdaUss03BlindnessDetect_N" 16 "MID_ZPA_E2_BdaUss10BlindnessDetect_N" 15 "MID_ZPA_E2_BdaUss05BlindnessDetect_N" 14 "MID_ZPA_E2_BdaUss11BlindnessDetect_N" 13 "MID_ZPA_E2_BdaUss07BlindnessDetect_N" 12 "MID_ZPA_E2_BdaUss12BlindnessDetect_N" 11 "MID_ZPA_E2_BdaUss06BlindnessDetect_N" 10 "MID_ZPA_E2_BdaUss08BlindnessDetect_N" 9 "MID_ZPA_E2_BdaUss13BlindnessDetect_N" 8 "MID_ZPA_E2_BdaUss09BlindnessDetect_N" 7 "MID_ZPA_E2_BdaUss04BlindnessDetect_N" 6 "MID_ZPA_E2_BdaUss14BlindnessDetect_N" 5 "MID_FLS_E_READ_FAILED_N" 4 "MID_FLS_E_COMPARE_FAILED_N" 3 "MID_FLS_E_ERASE_FAILED_N" 2 "MID_FLS_E_WRITE_FAILED_N" 1 "MID_NO_FAULT_N" 0 "MID_INVALID" ;
VAL_ 1486 PARK_sw060_ambTemp 255 "UNKNOWN" ;
VAL_ 1486 PARK_sw060_voltage 255 "UNKNOWN" ;
